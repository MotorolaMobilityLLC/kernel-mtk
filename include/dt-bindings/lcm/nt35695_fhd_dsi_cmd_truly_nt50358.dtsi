/*
 * Copyright (C) 2016 MediaTek Inc.
 *
 * This program is free software; you can redistribute it and/or modify
 * it under the terms of the GNU General Public License version 2 as
 * published by the Free Software Foundation.
 *
 * This program is distributed in the hope that it will be useful,
 * but WITHOUT ANY WARRANTY; without even the implied warranty of
 * MERCHANTABILITY or FITNESS FOR A PARTICULAR PURPOSE.
 * See http://www.gnu.org/licenses/gpl-2.0.html for more details.
 */

#include "lcm_define.h"

/ {
	/* LCM standardization */
	lcm_params {
		compatible = "mediatek,lcm_params-nt35695_fhd_dsi_cmd_truly_nt50358_drv";

		lcm_params-types = <2 0 0 0>;
		/* type, ctrl, lcm_if, lcm_cmd_if */
		lcm_params-resolution = <1080 1920>;
		/* width, height */
		lcm_params-io_select_mode;

		lcm_params-dbi-port;
		lcm_params-dbi-clock_freq;
		lcm_params-dbi-data_width;
		lcm_params-dbi-data_format;
		/* color_order, trans_seq, padding, format, width */
		lcm_params-dbi-cpu_write_bits;
		lcm_params-dbi-io_driving_current;
		lcm_params-dbi-msb_io_driving_current;
		lcm_params-dbi-ctrl_io_driving_current;

		lcm_params-dbi-te_mode;
		lcm_params-dbi-te_edge_polarity;
		lcm_params-dbi-te_hs_delay_cnt;
		lcm_params-dbi-te_vs_width_cnt;
		lcm_params-dbi-te_vs_width_cnt_div;

		lcm_params-dbi-serial-params0;
		/* cs_polarity, clk_polarity, clk_phase, is_non_dbi_mode, clock_base, clock_div */
		lcm_params-dbi-serial-params1;
		/* css, csh, rd_1st, rd_2nd, wr_1st, wr_2nd */
		lcm_params-dbi-serial-params2;
		/* sif_1st_pol, sif_sck_def, sif_3wire, sif_sdi sif_div2, sif_hw_cs */
		lcm_params-dbi-parallel-params0;
		/* write_setup, write_hold, write_wait, read_setup */
		lcm_params-dbi-parallel-params1;
		/* read_hold, read_latency, wait_period, cs_high_width */

		lcm_params-dpi-mipi_pll_clk_ref;
		lcm_params-dpi-mipi_pll_clk_div1;
		lcm_params-dpi-mipi_pll_clk_div2;
		lcm_params-dpi-mipi_pll_clk_fbk_div;

		lcm_params-dpi-dpi_clk_div;
		lcm_params-dpi-dpi_clk_duty;
		lcm_params-dpi-PLL_CLOCK;
		lcm_params-dpi-dpi_clock;
		lcm_params-dpi-ssc_disable;
		lcm_params-dpi-ssc_range;

		lcm_params-dpi-width;
		lcm_params-dpi-height;
		lcm_params-dpi-bg_width;
		lcm_params-dpi-bg_height;

		lcm_params-dpi-clk_pol;
		lcm_params-dpi-de_pol;
		lcm_params-dpi-vsync_pol;
		lcm_params-dpi-hsync_pol;
		lcm_params-dpi-hsync_pulse_width;
		lcm_params-dpi-hsync_back_porch;
		lcm_params-dpi-hsync_front_porch;
		lcm_params-dpi-vsync_pulse_width;
		lcm_params-dpi-vsync_back_porch;
		lcm_params-dpi-vsync_front_porch;

		lcm_params-dpi-format;
		lcm_params-dpi-rgb_order;
		lcm_params-dpi-is_serial_output;
		lcm_params-dpi-i2x_en;
		lcm_params-dpi-i2x_edge;
		lcm_params-dpi-embsync;
		lcm_params-dpi-lvds_tx_en;
		lcm_params-dpi-bit_swap;
		lcm_params-dpi-intermediat_buffer_num;
		lcm_params-dpi-io_driving_current;
		lcm_params-dpi-lsb_io_driving_current;

		lcm_params-dsi-mode = <0>;
		lcm_params-dsi-switch_mode = <1>;
		lcm_params-dsi-DSI_WMEM_CONTI;
		lcm_params-dsi-DSI_RMEM_CONTI;
		lcm_params-dsi-VC_NUM;
		lcm_params-dsi-lane_num = <4>;
		lcm_params-dsi-data_format = <0 0 0 2>;
		/* color_order, trans_seq, padding, format */
		lcm_params-dsi-intermediat_buffer_num;
		lcm_params-dsi-ps = <2>;
		lcm_params-dsi-word_count;
		lcm_params-dsi-packet_size = <256>;

		lcm_params-dsi-vertical_sync_active = <2>;
		lcm_params-dsi-vertical_backporch = <8>;
		lcm_params-dsi-vertical_frontporch = <10>;
		lcm_params-dsi-vertical_frontporch_for_low_power;
		lcm_params-dsi-vertical_active_line = <1920>;
		lcm_params-dsi-horizontal_sync_active = <10>;
		lcm_params-dsi-horizontal_backporch = <20>;
		lcm_params-dsi-horizontal_frontporch = <40>;
		lcm_params-dsi-horizontal_blanking_pixel;
		lcm_params-dsi-horizontal_active_pixel = <1080>;
		lcm_params-dsi-horizontal_bllp;
		lcm_params-dsi-line_byte;
		lcm_params-dsi-horizontal_sync_active_byte;
		lcm_params-dsi-horizontal_backportch_byte;
		lcm_params-dsi-horizontal_frontporch_byte;
		lcm_params-dsi-rgb_byte;
		lcm_params-dsi-horizontal_sync_active_word_count;
		lcm_params-dsi-horizontal_backporch_word_count;
		lcm_params-dsi-horizontal_frontporch_word_count;

		lcm_params-dsi-HS_TRAIL;
		lcm_params-dsi-ZERO;
		lcm_params-dsi-HS_PRPR;
		lcm_params-dsi-LPX;
		lcm_params-dsi-TA_SACK;
		lcm_params-dsi-TA_GET;
		lcm_params-dsi-TA_SURE;
		lcm_params-dsi-TA_GO;
		lcm_params-dsi-CLK_TRAIL;
		lcm_params-dsi-CLK_ZERO;
		lcm_params-dsi-LPX_WAIT;
		lcm_params-dsi-CONT_DET;
		lcm_params-dsi-CLK_HS_PRPR;
		lcm_params-dsi-CLK_HS_POST = <36>;
		lcm_params-dsi-DA_HS_EXIT;
		lcm_params-dsi-CLK_HS_EXIT;

		lcm_params-dsi-pll_select;
		lcm_params-dsi-pll_div1;
		lcm_params-dsi-pll_div2;
		lcm_params-dsi-fbk_div;
		lcm_params-dsi-fbk_sel;
		lcm_params-dsi-rg_bir;
		lcm_params-dsi-rg_bic;
		lcm_params-dsi-rg_bp;
		lcm_params-dsi-pll_clock = <420>;
		lcm_params-dsi-dsi_clock;
		lcm_params-dsi-ssc_disable = <1>;
		lcm_params-dsi-ssc_range;
		lcm_params-dsi-compatibility_for_nvk;
		lcm_params-dsi-cont_clock;

		lcm_params-dsi-ufoe_enable;
		lcm_params-dsi-ufoe_params;
		/* compress_ratio, lr_mode_en, vlc_disable, vlc_config */
		lcm_params-dsi-edp_panel;

		lcm_params-dsi-customization_esd_check_enable = <0>;
		lcm_params-dsi-esd_check_enable = <1>;

		lcm_params-dsi-lcm_int_te_monitor;
		lcm_params-dsi-lcm_int_te_period;
		lcm_params-dsi-lcm_ext_te_monitor;
		lcm_params-dsi-lcm_ext_te_enable;

		lcm_params-dsi-noncont_clock;
		lcm_params-dsi-noncont_clock_period;
		lcm_params-dsi-clk_lp_per_line_enable = <0>;

		lcm_params-dsi-lcm_esd_check_table0 = <0x53 0x01 0x24 0x0>;
		/* cmd, count, para_list[0], para_list[1] */
		lcm_params-dsi-lcm_esd_check_table1;
		lcm_params-dsi-lcm_esd_check_table2;

		lcm_params-dsi-switch_mode_enable = <0>;
		lcm_params-dsi-dual_dsi_type;
		lcm_params-dsi-lane_swap_en;
		lcm_params-dsi-lane_swap0;
		/* lane_swap[0][0~5] */
		lcm_params-dsi-lane_swap1;
		/* lane_swap[1][0~5] */
		lcm_params-dsi-vertical_vfp_lp;
		lcm_params-physical_width = <74>;
		lcm_params-physical_height = <132>;
		lcm_params-physical_width_um = <74520>;
		lcm_params-physical_height_um = <132480>;
		lcm_params-od_table_size;
		lcm_params-od_table;
	};

	lcm_ops {
		compatible = "mediatek,lcm_ops-nt35695_fhd_dsi_cmd_truly_nt50358_drv";

		init = <LCM_FUNC_UTIL LCM_UTIL_RESET 1 LCM_UTIL_RESET_LOW>,
			<LCM_FUNC_GPIO LCM_GPIO_MODE 1 LCM_GPIO_MODE_00>,
			<LCM_FUNC_GPIO LCM_GPIO_DIR 1 LCM_GPIO_DIR_OUT>,
			<LCM_FUNC_GPIO LCM_GPIO_OUT 1 LCM_GPIO_OUT_ONE>,
			<LCM_FUNC_UTIL LCM_UTIL_MDELAY 1 5>,
			<LCM_FUNC_I2C LCM_I2C_WRITE 2 0x00 0x0E>,
			<LCM_FUNC_I2C LCM_I2C_WRITE 2 0x01 0x0E>,
			<LCM_FUNC_UTIL LCM_UTIL_RESET 1 LCM_UTIL_RESET_HIGH>,
			<LCM_FUNC_UTIL LCM_UTIL_MDELAY 1 1>,
			<LCM_FUNC_UTIL LCM_UTIL_RESET 1 LCM_UTIL_RESET_LOW>,
			<LCM_FUNC_UTIL LCM_UTIL_MDELAY 1 10>,
			<LCM_FUNC_UTIL LCM_UTIL_RESET 1 LCM_UTIL_RESET_HIGH>,
			<LCM_FUNC_UTIL LCM_UTIL_MDELAY 1 10>,
			<LCM_FUNC_CMD LCM_UTIL_WRITE_CMD_V2 3 0xFF 1 0x24>,
			<LCM_FUNC_CMD LCM_UTIL_WRITE_CMD_V2 3 0xFB 1 0x01>,
			<LCM_FUNC_CMD LCM_UTIL_WRITE_CMD_V2 3 0x2D 1 0x08>,
			<LCM_FUNC_CMD LCM_UTIL_WRITE_CMD_V2 3 0xFF 1 0x24>,
			<LCM_FUNC_CMD LCM_UTIL_WRITE_CMD_V2 3 0x6E 1 0x10>,
			<LCM_FUNC_CMD LCM_UTIL_WRITE_CMD_V2 3 0xFB 1 0x01>,
			<LCM_FUNC_CMD LCM_UTIL_WRITE_CMD_V2 3 0xFF 1 0x10>,
			<LCM_FUNC_CMD LCM_UTIL_WRITE_CMD_V2 3 0xFF 1 0x10>,
			<LCM_FUNC_UTIL LCM_UTIL_UDELAY 1 1>,
			<LCM_FUNC_CMD LCM_UTIL_WRITE_CMD_V2 3 0xBB 1 0x10>,
			<LCM_FUNC_CMD LCM_UTIL_WRITE_CMD_V2 7 0x3B 5 0x03 0x0A 0x0A 0x0A 0x0A>,
			<LCM_FUNC_CMD LCM_UTIL_WRITE_CMD_V2 3 0x53 1 0x24>,
			<LCM_FUNC_CMD LCM_UTIL_WRITE_CMD_V2 3 0x55 1 0x00>,
			<LCM_FUNC_CMD LCM_UTIL_WRITE_CMD_V2 3 0x5E 1 0x00>,
			<LCM_FUNC_CMD LCM_UTIL_WRITE_CMD_V2 3 0xFF 1 0x24>,
			<LCM_FUNC_UTIL LCM_UTIL_UDELAY 1 1>,
			<LCM_FUNC_CMD LCM_UTIL_WRITE_CMD_V2 3 0xFB 1 0x01>,
			<LCM_FUNC_CMD LCM_UTIL_WRITE_CMD_V2 3 0x9D 1 0xB0>,
			<LCM_FUNC_CMD LCM_UTIL_WRITE_CMD_V2 3 0x72 1 0x00>,
			<LCM_FUNC_CMD LCM_UTIL_WRITE_CMD_V2 3 0x93 1 0x04>,
			<LCM_FUNC_CMD LCM_UTIL_WRITE_CMD_V2 3 0x94 1 0x04>,
			<LCM_FUNC_CMD LCM_UTIL_WRITE_CMD_V2 3 0x9B 1 0x0F>,
			<LCM_FUNC_CMD LCM_UTIL_WRITE_CMD_V2 3 0x8A 1 0x33>,
			<LCM_FUNC_CMD LCM_UTIL_WRITE_CMD_V2 3 0x86 1 0x1B>,
			<LCM_FUNC_CMD LCM_UTIL_WRITE_CMD_V2 3 0x87 1 0x39>,
			<LCM_FUNC_CMD LCM_UTIL_WRITE_CMD_V2 3 0x88 1 0x1B>,
			<LCM_FUNC_CMD LCM_UTIL_WRITE_CMD_V2 3 0x89 1 0x39>,
			<LCM_FUNC_CMD LCM_UTIL_WRITE_CMD_V2 3 0x8B 1 0xF4>,
			<LCM_FUNC_CMD LCM_UTIL_WRITE_CMD_V2 3 0x8C 1 0x01>,
			<LCM_FUNC_CMD LCM_UTIL_WRITE_CMD_V2 3 0x90 1 0x95>,
			<LCM_FUNC_CMD LCM_UTIL_WRITE_CMD_V2 3 0x91 1 0xC8>,
			<LCM_FUNC_CMD LCM_UTIL_WRITE_CMD_V2 3 0x92 1 0x95>,
			<LCM_FUNC_CMD LCM_UTIL_WRITE_CMD_V2 3 0x93 1 0x02>,
			<LCM_FUNC_CMD LCM_UTIL_WRITE_CMD_V2 3 0x94 1 0x08>,
			<LCM_FUNC_CMD LCM_UTIL_WRITE_CMD_V2 3 0x95 1 0x2B>,
			<LCM_FUNC_CMD LCM_UTIL_WRITE_CMD_V2 3 0x96 1 0x95>,
			<LCM_FUNC_CMD LCM_UTIL_WRITE_CMD_V2 3 0xDE 1 0xFF>,
			<LCM_FUNC_CMD LCM_UTIL_WRITE_CMD_V2 3 0xDF 1 0x82>,
			<LCM_FUNC_CMD LCM_UTIL_WRITE_CMD_V2 3 0x00 1 0x0F>,
			<LCM_FUNC_CMD LCM_UTIL_WRITE_CMD_V2 3 0x01 1 0x00>,
			<LCM_FUNC_CMD LCM_UTIL_WRITE_CMD_V2 3 0x02 1 0x00>,
			<LCM_FUNC_CMD LCM_UTIL_WRITE_CMD_V2 3 0x03 1 0x00>,
			<LCM_FUNC_CMD LCM_UTIL_WRITE_CMD_V2 3 0x04 1 0x0B>,
			<LCM_FUNC_CMD LCM_UTIL_WRITE_CMD_V2 3 0x05 1 0x0C>,
			<LCM_FUNC_CMD LCM_UTIL_WRITE_CMD_V2 3 0x06 1 0x00>,
			<LCM_FUNC_CMD LCM_UTIL_WRITE_CMD_V2 3 0x07 1 0x00>,
			<LCM_FUNC_CMD LCM_UTIL_WRITE_CMD_V2 3 0x08 1 0x00>,
			<LCM_FUNC_CMD LCM_UTIL_WRITE_CMD_V2 3 0x09 1 0x00>,
			<LCM_FUNC_CMD LCM_UTIL_WRITE_CMD_V2 3 0x0A 1 0X03>,
			<LCM_FUNC_CMD LCM_UTIL_WRITE_CMD_V2 3 0x0B 1 0X04>,
			<LCM_FUNC_CMD LCM_UTIL_WRITE_CMD_V2 3 0x0C 1 0x01>,
			<LCM_FUNC_CMD LCM_UTIL_WRITE_CMD_V2 3 0x0D 1 0x13>,
			<LCM_FUNC_CMD LCM_UTIL_WRITE_CMD_V2 3 0x0E 1 0x15>,
			<LCM_FUNC_CMD LCM_UTIL_WRITE_CMD_V2 3 0x0F 1 0x17>,
			<LCM_FUNC_CMD LCM_UTIL_WRITE_CMD_V2 3 0x10 1 0x0F>,
			<LCM_FUNC_CMD LCM_UTIL_WRITE_CMD_V2 3 0x11 1 0x00>,
			<LCM_FUNC_CMD LCM_UTIL_WRITE_CMD_V2 3 0x12 1 0x00>,
			<LCM_FUNC_CMD LCM_UTIL_WRITE_CMD_V2 3 0x13 1 0x00>,
			<LCM_FUNC_CMD LCM_UTIL_WRITE_CMD_V2 3 0x14 1 0x0B>,
			<LCM_FUNC_CMD LCM_UTIL_WRITE_CMD_V2 3 0x15 1 0x0C>,
			<LCM_FUNC_CMD LCM_UTIL_WRITE_CMD_V2 3 0x16 1 0x00>,
			<LCM_FUNC_CMD LCM_UTIL_WRITE_CMD_V2 3 0x17 1 0x00>,
			<LCM_FUNC_CMD LCM_UTIL_WRITE_CMD_V2 3 0x18 1 0x00>,
			<LCM_FUNC_CMD LCM_UTIL_WRITE_CMD_V2 3 0x19 1 0x00>,
			<LCM_FUNC_CMD LCM_UTIL_WRITE_CMD_V2 3 0x1A 1 0x03>,
			<LCM_FUNC_CMD LCM_UTIL_WRITE_CMD_V2 3 0x1B 1 0X04>,
			<LCM_FUNC_CMD LCM_UTIL_WRITE_CMD_V2 3 0x1C 1 0x01>,
			<LCM_FUNC_CMD LCM_UTIL_WRITE_CMD_V2 3 0x1D 1 0x13>,
			<LCM_FUNC_CMD LCM_UTIL_WRITE_CMD_V2 3 0x1E 1 0x15>,
			<LCM_FUNC_CMD LCM_UTIL_WRITE_CMD_V2 3 0x1F 1 0x17>,
			<LCM_FUNC_CMD LCM_UTIL_WRITE_CMD_V2 3 0x20 1 0x09>,
			<LCM_FUNC_CMD LCM_UTIL_WRITE_CMD_V2 3 0x21 1 0x01>,
			<LCM_FUNC_CMD LCM_UTIL_WRITE_CMD_V2 3 0x22 1 0x00>,
			<LCM_FUNC_CMD LCM_UTIL_WRITE_CMD_V2 3 0x23 1 0x00>,
			<LCM_FUNC_CMD LCM_UTIL_WRITE_CMD_V2 3 0x24 1 0x00>,
			<LCM_FUNC_CMD LCM_UTIL_WRITE_CMD_V2 3 0x25 1 0x6D>,
			<LCM_FUNC_CMD LCM_UTIL_WRITE_CMD_V2 3 0x26 1 0x00>,
			<LCM_FUNC_CMD LCM_UTIL_WRITE_CMD_V2 3 0x27 1 0x00>,
			<LCM_FUNC_CMD LCM_UTIL_WRITE_CMD_V2 3 0x2F 1 0x02>,
			<LCM_FUNC_CMD LCM_UTIL_WRITE_CMD_V2 3 0x30 1 0x04>,
			<LCM_FUNC_CMD LCM_UTIL_WRITE_CMD_V2 3 0x31 1 0x49>,
			<LCM_FUNC_CMD LCM_UTIL_WRITE_CMD_V2 3 0x32 1 0x23>,
			<LCM_FUNC_CMD LCM_UTIL_WRITE_CMD_V2 3 0x33 1 0x01>,
			<LCM_FUNC_CMD LCM_UTIL_WRITE_CMD_V2 3 0x34 1 0x00>,
			<LCM_FUNC_CMD LCM_UTIL_WRITE_CMD_V2 3 0x35 1 0x83>,
			<LCM_FUNC_CMD LCM_UTIL_WRITE_CMD_V2 3 0x36 1 0x00>,
			<LCM_FUNC_CMD LCM_UTIL_WRITE_CMD_V2 3 0x37 1 0x2D>,
			<LCM_FUNC_CMD LCM_UTIL_WRITE_CMD_V2 3 0x38 1 0x08>,
			<LCM_FUNC_CMD LCM_UTIL_WRITE_CMD_V2 3 0x39 1 0x00>,
			<LCM_FUNC_CMD LCM_UTIL_WRITE_CMD_V2 3 0x3A 1 0x83>,
			<LCM_FUNC_CMD LCM_UTIL_WRITE_CMD_V2 3 0x29 1 0x58>,
			<LCM_FUNC_CMD LCM_UTIL_WRITE_CMD_V2 3 0x2A 1 0x16>,
			<LCM_FUNC_CMD LCM_UTIL_WRITE_CMD_V2 3 0x5B 1 0x00>,
			<LCM_FUNC_CMD LCM_UTIL_WRITE_CMD_V2 3 0x5F 1 0x75>,
			<LCM_FUNC_CMD LCM_UTIL_WRITE_CMD_V2 3 0x63 1 0x00>,
			<LCM_FUNC_CMD LCM_UTIL_WRITE_CMD_V2 3 0x67 1 0x04>,
			<LCM_FUNC_CMD LCM_UTIL_WRITE_CMD_V2 3 0x74 1 0x14>,
			<LCM_FUNC_CMD LCM_UTIL_WRITE_CMD_V2 3 0x75 1 0x1F>,
			<LCM_FUNC_CMD LCM_UTIL_WRITE_CMD_V2 3 0x7B 1 0x80>,
			<LCM_FUNC_CMD LCM_UTIL_WRITE_CMD_V2 3 0x7C 1 0xD8>,
			<LCM_FUNC_CMD LCM_UTIL_WRITE_CMD_V2 3 0x7D 1 0x60>,
			<LCM_FUNC_CMD LCM_UTIL_WRITE_CMD_V2 3 0x7E 1 0x14>,
			<LCM_FUNC_CMD LCM_UTIL_WRITE_CMD_V2 3 0x7F 1 0x1F>,
			<LCM_FUNC_CMD LCM_UTIL_WRITE_CMD_V2 3 0x80 1 0x00>,
			<LCM_FUNC_CMD LCM_UTIL_WRITE_CMD_V2 3 0x81 1 0x06>,
			<LCM_FUNC_CMD LCM_UTIL_WRITE_CMD_V2 3 0x82 1 0x03>,
			<LCM_FUNC_CMD LCM_UTIL_WRITE_CMD_V2 3 0x83 1 0x00>,
			<LCM_FUNC_CMD LCM_UTIL_WRITE_CMD_V2 3 0x84 1 0x03>,
			<LCM_FUNC_CMD LCM_UTIL_WRITE_CMD_V2 3 0x85 1 0x07>,
			<LCM_FUNC_CMD LCM_UTIL_WRITE_CMD_V2 3 0x74 1 0x10>,
			<LCM_FUNC_CMD LCM_UTIL_WRITE_CMD_V2 3 0x75 1 0x19>,
			<LCM_FUNC_CMD LCM_UTIL_WRITE_CMD_V2 3 0x76 1 0x06>,
			<LCM_FUNC_CMD LCM_UTIL_WRITE_CMD_V2 3 0x77 1 0x03>,
			<LCM_FUNC_CMD LCM_UTIL_WRITE_CMD_V2 3 0x78 1 0x00>,
			<LCM_FUNC_CMD LCM_UTIL_WRITE_CMD_V2 3 0x79 1 0x00>,
			<LCM_FUNC_CMD LCM_UTIL_WRITE_CMD_V2 3 0x99 1 0x33>,
			<LCM_FUNC_CMD LCM_UTIL_WRITE_CMD_V2 3 0x98 1 0x00>,
			<LCM_FUNC_CMD LCM_UTIL_WRITE_CMD_V2 3 0xB3 1 0x28>,
			<LCM_FUNC_CMD LCM_UTIL_WRITE_CMD_V2 3 0xB4 1 0x05>,
			<LCM_FUNC_CMD LCM_UTIL_WRITE_CMD_V2 3 0xB5 1 0x10>,
			<LCM_FUNC_CMD LCM_UTIL_WRITE_CMD_V2 3 0xFF 1 0x20>,
			<LCM_FUNC_UTIL LCM_UTIL_UDELAY 1 1>,
			<LCM_FUNC_CMD LCM_UTIL_WRITE_CMD_V2 3 0x00 1 0x01>,
			<LCM_FUNC_CMD LCM_UTIL_WRITE_CMD_V2 3 0x01 1 0x55>,
			<LCM_FUNC_CMD LCM_UTIL_WRITE_CMD_V2 3 0x02 1 0x45>,
			<LCM_FUNC_CMD LCM_UTIL_WRITE_CMD_V2 3 0x03 1 0x55>,
			<LCM_FUNC_CMD LCM_UTIL_WRITE_CMD_V2 3 0x05 1 0x50>,
			<LCM_FUNC_CMD LCM_UTIL_WRITE_CMD_V2 3 0x06 1 0x9E>,
			<LCM_FUNC_CMD LCM_UTIL_WRITE_CMD_V2 3 0x07 1 0xA8>,
			<LCM_FUNC_CMD LCM_UTIL_WRITE_CMD_V2 3 0x08 1 0x0C>,
			<LCM_FUNC_CMD LCM_UTIL_WRITE_CMD_V2 3 0x0B 1 0x96>,
			<LCM_FUNC_CMD LCM_UTIL_WRITE_CMD_V2 3 0x0C 1 0x96>,
			<LCM_FUNC_CMD LCM_UTIL_WRITE_CMD_V2 3 0x0E 1 0x00>,
			<LCM_FUNC_CMD LCM_UTIL_WRITE_CMD_V2 3 0x0F 1 0x00>,
			<LCM_FUNC_CMD LCM_UTIL_WRITE_CMD_V2 3 0x11 1 0x29>,
			<LCM_FUNC_CMD LCM_UTIL_WRITE_CMD_V2 3 0x12 1 0x29>,
			<LCM_FUNC_CMD LCM_UTIL_WRITE_CMD_V2 3 0x13 1 0x03>,
			<LCM_FUNC_CMD LCM_UTIL_WRITE_CMD_V2 3 0x14 1 0x0A>,
			<LCM_FUNC_CMD LCM_UTIL_WRITE_CMD_V2 3 0x15 1 0x99>,
			<LCM_FUNC_CMD LCM_UTIL_WRITE_CMD_V2 3 0x16 1 0x99>,
			<LCM_FUNC_CMD LCM_UTIL_WRITE_CMD_V2 3 0x6D 1 0x68>,
			<LCM_FUNC_CMD LCM_UTIL_WRITE_CMD_V2 3 0x58 1 0x05>,
			<LCM_FUNC_CMD LCM_UTIL_WRITE_CMD_V2 3 0x59 1 0x05>,
			<LCM_FUNC_CMD LCM_UTIL_WRITE_CMD_V2 3 0x5A 1 0x05>,
			<LCM_FUNC_CMD LCM_UTIL_WRITE_CMD_V2 3 0x5B 1 0x05>,
			<LCM_FUNC_CMD LCM_UTIL_WRITE_CMD_V2 3 0x5C 1 0x00>,
			<LCM_FUNC_CMD LCM_UTIL_WRITE_CMD_V2 3 0x5D 1 0x00>,
			<LCM_FUNC_CMD LCM_UTIL_WRITE_CMD_V2 3 0x5E 1 0x00>,
			<LCM_FUNC_CMD LCM_UTIL_WRITE_CMD_V2 3 0x5F 1 0x00>,
			<LCM_FUNC_CMD LCM_UTIL_WRITE_CMD_V2 3 0x1B 1 0x39>,
			<LCM_FUNC_CMD LCM_UTIL_WRITE_CMD_V2 3 0x1C 1 0x39>,
			<LCM_FUNC_CMD LCM_UTIL_WRITE_CMD_V2 3 0x1D 1 0x47>,
			<LCM_FUNC_CMD LCM_UTIL_WRITE_CMD_V2 3 0xFF 1 0x20>,
			<LCM_FUNC_UTIL LCM_UTIL_UDELAY 1 1>,
			<LCM_FUNC_CMD LCM_UTIL_WRITE_CMD_V2 3 0x75 1 0x00>,
			<LCM_FUNC_CMD LCM_UTIL_WRITE_CMD_V2 3 0x76 1 0x00>,
			<LCM_FUNC_CMD LCM_UTIL_WRITE_CMD_V2 3 0x77 1 0x00>,
			<LCM_FUNC_CMD LCM_UTIL_WRITE_CMD_V2 3 0x78 1 0x3e>,
			<LCM_FUNC_CMD LCM_UTIL_WRITE_CMD_V2 3 0x79 1 0x00>,
			<LCM_FUNC_CMD LCM_UTIL_WRITE_CMD_V2 3 0x7A 1 0x6f>,
			<LCM_FUNC_CMD LCM_UTIL_WRITE_CMD_V2 3 0x7B 1 0x00>,
			<LCM_FUNC_CMD LCM_UTIL_WRITE_CMD_V2 3 0x7C 1 0x8f>,
			<LCM_FUNC_CMD LCM_UTIL_WRITE_CMD_V2 3 0x7D 1 0x00>,
			<LCM_FUNC_CMD LCM_UTIL_WRITE_CMD_V2 3 0x7E 1 0xa7>,
			<LCM_FUNC_CMD LCM_UTIL_WRITE_CMD_V2 3 0x7F 1 0x00>,
			<LCM_FUNC_CMD LCM_UTIL_WRITE_CMD_V2 3 0x80 1 0xbc>,
			<LCM_FUNC_CMD LCM_UTIL_WRITE_CMD_V2 3 0x81 1 0x00>,
			<LCM_FUNC_CMD LCM_UTIL_WRITE_CMD_V2 3 0x82 1 0xce>,
			<LCM_FUNC_CMD LCM_UTIL_WRITE_CMD_V2 3 0x83 1 0x00>,
			<LCM_FUNC_CMD LCM_UTIL_WRITE_CMD_V2 3 0x84 1 0xdd>,
			<LCM_FUNC_CMD LCM_UTIL_WRITE_CMD_V2 3 0x85 1 0x00>,
			<LCM_FUNC_CMD LCM_UTIL_WRITE_CMD_V2 3 0x86 1 0xec>,
			<LCM_FUNC_CMD LCM_UTIL_WRITE_CMD_V2 3 0x87 1 0x01>,
			<LCM_FUNC_CMD LCM_UTIL_WRITE_CMD_V2 3 0x88 1 0x1a>,
			<LCM_FUNC_CMD LCM_UTIL_WRITE_CMD_V2 3 0x89 1 0x01>,
			<LCM_FUNC_CMD LCM_UTIL_WRITE_CMD_V2 3 0x8A 1 0x3e>,
			<LCM_FUNC_CMD LCM_UTIL_WRITE_CMD_V2 3 0x8B 1 0x01>,
			<LCM_FUNC_CMD LCM_UTIL_WRITE_CMD_V2 3 0x8C 1 0x76>,
			<LCM_FUNC_CMD LCM_UTIL_WRITE_CMD_V2 3 0x8D 1 0x01>,
			<LCM_FUNC_CMD LCM_UTIL_WRITE_CMD_V2 3 0x8E 1 0xa3>,
			<LCM_FUNC_CMD LCM_UTIL_WRITE_CMD_V2 3 0x8F 1 0x01>,
			<LCM_FUNC_CMD LCM_UTIL_WRITE_CMD_V2 3 0x90 1 0xe9>,
			<LCM_FUNC_CMD LCM_UTIL_WRITE_CMD_V2 3 0x91 1 0x02>,
			<LCM_FUNC_CMD LCM_UTIL_WRITE_CMD_V2 3 0x92 1 0x20>,
			<LCM_FUNC_CMD LCM_UTIL_WRITE_CMD_V2 3 0x93 1 0x02>,
			<LCM_FUNC_CMD LCM_UTIL_WRITE_CMD_V2 3 0x94 1 0x22>,
			<LCM_FUNC_CMD LCM_UTIL_WRITE_CMD_V2 3 0x95 1 0x02>,
			<LCM_FUNC_CMD LCM_UTIL_WRITE_CMD_V2 3 0x96 1 0x56>,
			<LCM_FUNC_CMD LCM_UTIL_WRITE_CMD_V2 3 0x97 1 0x02>,
			<LCM_FUNC_CMD LCM_UTIL_WRITE_CMD_V2 3 0x98 1 0x8f>,
			<LCM_FUNC_CMD LCM_UTIL_WRITE_CMD_V2 3 0x99 1 0x02>,
			<LCM_FUNC_CMD LCM_UTIL_WRITE_CMD_V2 3 0x9A 1 0xb2>,
			<LCM_FUNC_CMD LCM_UTIL_WRITE_CMD_V2 3 0x9B 1 0x02>,
			<LCM_FUNC_CMD LCM_UTIL_WRITE_CMD_V2 3 0x9C 1 0xe2>,
			<LCM_FUNC_CMD LCM_UTIL_WRITE_CMD_V2 3 0x9D 1 0x03>,
			<LCM_FUNC_CMD LCM_UTIL_WRITE_CMD_V2 3 0x9E 1 0x02>,
			<LCM_FUNC_CMD LCM_UTIL_WRITE_CMD_V2 3 0x9F 1 0x03>,
			<LCM_FUNC_CMD LCM_UTIL_WRITE_CMD_V2 3 0xA0 1 0x2d>,
			<LCM_FUNC_CMD LCM_UTIL_WRITE_CMD_V2 3 0xA2 1 0x03>,
			<LCM_FUNC_CMD LCM_UTIL_WRITE_CMD_V2 3 0xA3 1 0x3a>,
			<LCM_FUNC_CMD LCM_UTIL_WRITE_CMD_V2 3 0xA4 1 0x03>,
			<LCM_FUNC_CMD LCM_UTIL_WRITE_CMD_V2 3 0xA5 1 0x48>,
			<LCM_FUNC_CMD LCM_UTIL_WRITE_CMD_V2 3 0xA6 1 0x03>,
			<LCM_FUNC_CMD LCM_UTIL_WRITE_CMD_V2 3 0xA7 1 0x58>,
			<LCM_FUNC_CMD LCM_UTIL_WRITE_CMD_V2 3 0xA9 1 0x03>,
			<LCM_FUNC_CMD LCM_UTIL_WRITE_CMD_V2 3 0xAA 1 0x6a>,
			<LCM_FUNC_CMD LCM_UTIL_WRITE_CMD_V2 3 0xAB 1 0x03>,
			<LCM_FUNC_CMD LCM_UTIL_WRITE_CMD_V2 3 0xAC 1 0x80>,
			<LCM_FUNC_CMD LCM_UTIL_WRITE_CMD_V2 3 0xAD 1 0x03>,
			<LCM_FUNC_CMD LCM_UTIL_WRITE_CMD_V2 3 0xAE 1 0x9d>,
			<LCM_FUNC_CMD LCM_UTIL_WRITE_CMD_V2 3 0xAF 1 0x03>,
			<LCM_FUNC_CMD LCM_UTIL_WRITE_CMD_V2 3 0xB0 1 0xb7>,
			<LCM_FUNC_CMD LCM_UTIL_WRITE_CMD_V2 3 0xB1 1 0x03>,
			<LCM_FUNC_CMD LCM_UTIL_WRITE_CMD_V2 3 0xB2 1 0xFF>,
			<LCM_FUNC_CMD LCM_UTIL_WRITE_CMD_V2 3 0xB3 1 0x00>,
			<LCM_FUNC_CMD LCM_UTIL_WRITE_CMD_V2 3 0xB4 1 0x00>,
			<LCM_FUNC_CMD LCM_UTIL_WRITE_CMD_V2 3 0xB5 1 0x00>,
			<LCM_FUNC_CMD LCM_UTIL_WRITE_CMD_V2 3 0xB6 1 0x3e>,
			<LCM_FUNC_CMD LCM_UTIL_WRITE_CMD_V2 3 0xB7 1 0x00>,
			<LCM_FUNC_CMD LCM_UTIL_WRITE_CMD_V2 3 0xB8 1 0x6f>,
			<LCM_FUNC_CMD LCM_UTIL_WRITE_CMD_V2 3 0xB9 1 0x00>,
			<LCM_FUNC_CMD LCM_UTIL_WRITE_CMD_V2 3 0xBA 1 0x8f>,
			<LCM_FUNC_CMD LCM_UTIL_WRITE_CMD_V2 3 0xBB 1 0x00>,
			<LCM_FUNC_CMD LCM_UTIL_WRITE_CMD_V2 3 0xBC 1 0xa7>,
			<LCM_FUNC_CMD LCM_UTIL_WRITE_CMD_V2 3 0xBD 1 0x00>,
			<LCM_FUNC_CMD LCM_UTIL_WRITE_CMD_V2 3 0xBE 1 0xbc>,
			<LCM_FUNC_CMD LCM_UTIL_WRITE_CMD_V2 3 0xBF 1 0x00>,
			<LCM_FUNC_CMD LCM_UTIL_WRITE_CMD_V2 3 0xC0 1 0xce>,
			<LCM_FUNC_CMD LCM_UTIL_WRITE_CMD_V2 3 0xC1 1 0x00>,
			<LCM_FUNC_CMD LCM_UTIL_WRITE_CMD_V2 3 0xC2 1 0xdd>,
			<LCM_FUNC_CMD LCM_UTIL_WRITE_CMD_V2 3 0xC3 1 0x00>,
			<LCM_FUNC_CMD LCM_UTIL_WRITE_CMD_V2 3 0xC4 1 0xec>,
			<LCM_FUNC_CMD LCM_UTIL_WRITE_CMD_V2 3 0xC5 1 0x01>,
			<LCM_FUNC_CMD LCM_UTIL_WRITE_CMD_V2 3 0xC6 1 0x1a>,
			<LCM_FUNC_CMD LCM_UTIL_WRITE_CMD_V2 3 0xC7 1 0x01>,
			<LCM_FUNC_CMD LCM_UTIL_WRITE_CMD_V2 3 0xC8 1 0x3e>,
			<LCM_FUNC_CMD LCM_UTIL_WRITE_CMD_V2 3 0xC9 1 0x01>,
			<LCM_FUNC_CMD LCM_UTIL_WRITE_CMD_V2 3 0xCA 1 0x76>,
			<LCM_FUNC_CMD LCM_UTIL_WRITE_CMD_V2 3 0xCB 1 0x01>,
			<LCM_FUNC_CMD LCM_UTIL_WRITE_CMD_V2 3 0xCC 1 0xa3>,
			<LCM_FUNC_CMD LCM_UTIL_WRITE_CMD_V2 3 0xCD 1 0x01>,
			<LCM_FUNC_CMD LCM_UTIL_WRITE_CMD_V2 3 0xCE 1 0xe9>,
			<LCM_FUNC_CMD LCM_UTIL_WRITE_CMD_V2 3 0xCF 1 0x02>,
			<LCM_FUNC_CMD LCM_UTIL_WRITE_CMD_V2 3 0xD0 1 0x20>,
			<LCM_FUNC_CMD LCM_UTIL_WRITE_CMD_V2 3 0xD1 1 0x02>,
			<LCM_FUNC_CMD LCM_UTIL_WRITE_CMD_V2 3 0xD2 1 0x22>,
			<LCM_FUNC_CMD LCM_UTIL_WRITE_CMD_V2 3 0xD3 1 0x02>,
			<LCM_FUNC_CMD LCM_UTIL_WRITE_CMD_V2 3 0xD4 1 0x56>,
			<LCM_FUNC_CMD LCM_UTIL_WRITE_CMD_V2 3 0xD5 1 0x02>,
			<LCM_FUNC_CMD LCM_UTIL_WRITE_CMD_V2 3 0xD6 1 0x8f>,
			<LCM_FUNC_CMD LCM_UTIL_WRITE_CMD_V2 3 0xD7 1 0x02>,
			<LCM_FUNC_CMD LCM_UTIL_WRITE_CMD_V2 3 0xD8 1 0xb2>,
			<LCM_FUNC_CMD LCM_UTIL_WRITE_CMD_V2 3 0xD9 1 0x02>,
			<LCM_FUNC_CMD LCM_UTIL_WRITE_CMD_V2 3 0xDA 1 0xe2>,
			<LCM_FUNC_CMD LCM_UTIL_WRITE_CMD_V2 3 0xDB 1 0x03>,
			<LCM_FUNC_CMD LCM_UTIL_WRITE_CMD_V2 3 0xDC 1 0x02>,
			<LCM_FUNC_CMD LCM_UTIL_WRITE_CMD_V2 3 0xDD 1 0x03>,
			<LCM_FUNC_CMD LCM_UTIL_WRITE_CMD_V2 3 0xDE 1 0x2d>,
			<LCM_FUNC_CMD LCM_UTIL_WRITE_CMD_V2 3 0xDF 1 0x03>,
			<LCM_FUNC_CMD LCM_UTIL_WRITE_CMD_V2 3 0xE0 1 0x3a>,
			<LCM_FUNC_CMD LCM_UTIL_WRITE_CMD_V2 3 0xE1 1 0x03>,
			<LCM_FUNC_CMD LCM_UTIL_WRITE_CMD_V2 3 0xE2 1 0x48>,
			<LCM_FUNC_CMD LCM_UTIL_WRITE_CMD_V2 3 0xE3 1 0x03>,
			<LCM_FUNC_CMD LCM_UTIL_WRITE_CMD_V2 3 0xE4 1 0x58>,
			<LCM_FUNC_CMD LCM_UTIL_WRITE_CMD_V2 3 0xE5 1 0x03>,
			<LCM_FUNC_CMD LCM_UTIL_WRITE_CMD_V2 3 0xE6 1 0x6a>,
			<LCM_FUNC_CMD LCM_UTIL_WRITE_CMD_V2 3 0xE7 1 0x03>,
			<LCM_FUNC_CMD LCM_UTIL_WRITE_CMD_V2 3 0xE8 1 0x80>,
			<LCM_FUNC_CMD LCM_UTIL_WRITE_CMD_V2 3 0xE9 1 0x03>,
			<LCM_FUNC_CMD LCM_UTIL_WRITE_CMD_V2 3 0xEA 1 0x9d>,
			<LCM_FUNC_CMD LCM_UTIL_WRITE_CMD_V2 3 0xEB 1 0x03>,
			<LCM_FUNC_CMD LCM_UTIL_WRITE_CMD_V2 3 0xEC 1 0xb7>,
			<LCM_FUNC_CMD LCM_UTIL_WRITE_CMD_V2 3 0xED 1 0x03>,
			<LCM_FUNC_CMD LCM_UTIL_WRITE_CMD_V2 3 0xEE 1 0xFF>,
			<LCM_FUNC_CMD LCM_UTIL_WRITE_CMD_V2 3 0xEF 1 0x00>,
			<LCM_FUNC_CMD LCM_UTIL_WRITE_CMD_V2 3 0xF0 1 0x00>,
			<LCM_FUNC_CMD LCM_UTIL_WRITE_CMD_V2 3 0xF1 1 0x00>,
			<LCM_FUNC_CMD LCM_UTIL_WRITE_CMD_V2 3 0xF2 1 0x3e>,
			<LCM_FUNC_CMD LCM_UTIL_WRITE_CMD_V2 3 0xF3 1 0x00>,
			<LCM_FUNC_CMD LCM_UTIL_WRITE_CMD_V2 3 0xF4 1 0x6f>,
			<LCM_FUNC_CMD LCM_UTIL_WRITE_CMD_V2 3 0xF5 1 0x00>,
			<LCM_FUNC_CMD LCM_UTIL_WRITE_CMD_V2 3 0xF6 1 0x8f>,
			<LCM_FUNC_CMD LCM_UTIL_WRITE_CMD_V2 3 0xF7 1 0x00>,
			<LCM_FUNC_CMD LCM_UTIL_WRITE_CMD_V2 3 0xF8 1 0xa7>,
			<LCM_FUNC_CMD LCM_UTIL_WRITE_CMD_V2 3 0xF9 1 0x00>,
			<LCM_FUNC_CMD LCM_UTIL_WRITE_CMD_V2 3 0xFA 1 0xbc>,
			<LCM_FUNC_CMD LCM_UTIL_WRITE_CMD_V2 3 0xFF 1 0x21>,
			<LCM_FUNC_UTIL LCM_UTIL_UDELAY 1 1>,
			<LCM_FUNC_CMD LCM_UTIL_WRITE_CMD_V2 3 0x00 1 0x00>,
			<LCM_FUNC_CMD LCM_UTIL_WRITE_CMD_V2 3 0x01 1 0xce>,
			<LCM_FUNC_CMD LCM_UTIL_WRITE_CMD_V2 3 0x02 1 0x00>,
			<LCM_FUNC_CMD LCM_UTIL_WRITE_CMD_V2 3 0x03 1 0xdd>,
			<LCM_FUNC_CMD LCM_UTIL_WRITE_CMD_V2 3 0x04 1 0x00>,
			<LCM_FUNC_CMD LCM_UTIL_WRITE_CMD_V2 3 0x05 1 0xec>,
			<LCM_FUNC_CMD LCM_UTIL_WRITE_CMD_V2 3 0x06 1 0x01>,
			<LCM_FUNC_CMD LCM_UTIL_WRITE_CMD_V2 3 0x07 1 0x1a>,
			<LCM_FUNC_CMD LCM_UTIL_WRITE_CMD_V2 3 0x08 1 0x01>,
			<LCM_FUNC_CMD LCM_UTIL_WRITE_CMD_V2 3 0x09 1 0x3e>,
			<LCM_FUNC_CMD LCM_UTIL_WRITE_CMD_V2 3 0x0A 1 0x01>,
			<LCM_FUNC_CMD LCM_UTIL_WRITE_CMD_V2 3 0x0B 1 0x76>,
			<LCM_FUNC_CMD LCM_UTIL_WRITE_CMD_V2 3 0x0C 1 0x01>,
			<LCM_FUNC_CMD LCM_UTIL_WRITE_CMD_V2 3 0x0D 1 0xa3>,
			<LCM_FUNC_CMD LCM_UTIL_WRITE_CMD_V2 3 0x0E 1 0x01>,
			<LCM_FUNC_CMD LCM_UTIL_WRITE_CMD_V2 3 0x0F 1 0xe9>,
			<LCM_FUNC_CMD LCM_UTIL_WRITE_CMD_V2 3 0x10 1 0x02>,
			<LCM_FUNC_CMD LCM_UTIL_WRITE_CMD_V2 3 0x11 1 0x20>,
			<LCM_FUNC_CMD LCM_UTIL_WRITE_CMD_V2 3 0x12 1 0x02>,
			<LCM_FUNC_CMD LCM_UTIL_WRITE_CMD_V2 3 0x13 1 0x22>,
			<LCM_FUNC_CMD LCM_UTIL_WRITE_CMD_V2 3 0x14 1 0x02>,
			<LCM_FUNC_CMD LCM_UTIL_WRITE_CMD_V2 3 0x15 1 0x56>,
			<LCM_FUNC_CMD LCM_UTIL_WRITE_CMD_V2 3 0x16 1 0x02>,
			<LCM_FUNC_CMD LCM_UTIL_WRITE_CMD_V2 3 0x17 1 0x8f>,
			<LCM_FUNC_CMD LCM_UTIL_WRITE_CMD_V2 3 0x18 1 0x02>,
			<LCM_FUNC_CMD LCM_UTIL_WRITE_CMD_V2 3 0x19 1 0xb2>,
			<LCM_FUNC_CMD LCM_UTIL_WRITE_CMD_V2 3 0x1A 1 0x02>,
			<LCM_FUNC_CMD LCM_UTIL_WRITE_CMD_V2 3 0x1B 1 0xe2>,
			<LCM_FUNC_CMD LCM_UTIL_WRITE_CMD_V2 3 0x1C 1 0x03>,
			<LCM_FUNC_CMD LCM_UTIL_WRITE_CMD_V2 3 0x1D 1 0x02>,
			<LCM_FUNC_CMD LCM_UTIL_WRITE_CMD_V2 3 0x1E 1 0x03>,
			<LCM_FUNC_CMD LCM_UTIL_WRITE_CMD_V2 3 0x1F 1 0x2d>,
			<LCM_FUNC_CMD LCM_UTIL_WRITE_CMD_V2 3 0x20 1 0x03>,
			<LCM_FUNC_CMD LCM_UTIL_WRITE_CMD_V2 3 0x21 1 0x3a>,
			<LCM_FUNC_CMD LCM_UTIL_WRITE_CMD_V2 3 0x22 1 0x03>,
			<LCM_FUNC_CMD LCM_UTIL_WRITE_CMD_V2 3 0x23 1 0x48>,
			<LCM_FUNC_CMD LCM_UTIL_WRITE_CMD_V2 3 0x24 1 0x03>,
			<LCM_FUNC_CMD LCM_UTIL_WRITE_CMD_V2 3 0x25 1 0x58>,
			<LCM_FUNC_CMD LCM_UTIL_WRITE_CMD_V2 3 0x26 1 0x03>,
			<LCM_FUNC_CMD LCM_UTIL_WRITE_CMD_V2 3 0x27 1 0x6a>,
			<LCM_FUNC_CMD LCM_UTIL_WRITE_CMD_V2 3 0x28 1 0x03>,
			<LCM_FUNC_CMD LCM_UTIL_WRITE_CMD_V2 3 0x29 1 0x80>,
			<LCM_FUNC_CMD LCM_UTIL_WRITE_CMD_V2 3 0x2A 1 0x03>,
			<LCM_FUNC_CMD LCM_UTIL_WRITE_CMD_V2 3 0x2B 1 0x9d>,
			<LCM_FUNC_CMD LCM_UTIL_WRITE_CMD_V2 3 0x2D 1 0x03>,
			<LCM_FUNC_CMD LCM_UTIL_WRITE_CMD_V2 3 0x2F 1 0xb7>,
			<LCM_FUNC_CMD LCM_UTIL_WRITE_CMD_V2 3 0x30 1 0x03>,
			<LCM_FUNC_CMD LCM_UTIL_WRITE_CMD_V2 3 0x31 1 0xFF>,
			<LCM_FUNC_CMD LCM_UTIL_WRITE_CMD_V2 3 0x32 1 0x00>,
			<LCM_FUNC_CMD LCM_UTIL_WRITE_CMD_V2 3 0x33 1 0x00>,
			<LCM_FUNC_CMD LCM_UTIL_WRITE_CMD_V2 3 0x34 1 0x00>,
			<LCM_FUNC_CMD LCM_UTIL_WRITE_CMD_V2 3 0x35 1 0x3e>,
			<LCM_FUNC_CMD LCM_UTIL_WRITE_CMD_V2 3 0x36 1 0x00>,
			<LCM_FUNC_CMD LCM_UTIL_WRITE_CMD_V2 3 0x37 1 0x6f>,
			<LCM_FUNC_CMD LCM_UTIL_WRITE_CMD_V2 3 0x38 1 0x00>,
			<LCM_FUNC_CMD LCM_UTIL_WRITE_CMD_V2 3 0x39 1 0x8f>,
			<LCM_FUNC_CMD LCM_UTIL_WRITE_CMD_V2 3 0x3A 1 0x00>,
			<LCM_FUNC_CMD LCM_UTIL_WRITE_CMD_V2 3 0x3B 1 0xa7>,
			<LCM_FUNC_CMD LCM_UTIL_WRITE_CMD_V2 3 0x3D 1 0x00>,
			<LCM_FUNC_CMD LCM_UTIL_WRITE_CMD_V2 3 0x3F 1 0xbc>,
			<LCM_FUNC_CMD LCM_UTIL_WRITE_CMD_V2 3 0x40 1 0x00>,
			<LCM_FUNC_CMD LCM_UTIL_WRITE_CMD_V2 3 0x41 1 0xce>,
			<LCM_FUNC_CMD LCM_UTIL_WRITE_CMD_V2 3 0x42 1 0x00>,
			<LCM_FUNC_CMD LCM_UTIL_WRITE_CMD_V2 3 0x43 1 0xdd>,
			<LCM_FUNC_CMD LCM_UTIL_WRITE_CMD_V2 3 0x44 1 0x00>,
			<LCM_FUNC_CMD LCM_UTIL_WRITE_CMD_V2 3 0x45 1 0xec>,
			<LCM_FUNC_CMD LCM_UTIL_WRITE_CMD_V2 3 0x46 1 0x01>,
			<LCM_FUNC_CMD LCM_UTIL_WRITE_CMD_V2 3 0x47 1 0x1a>,
			<LCM_FUNC_CMD LCM_UTIL_WRITE_CMD_V2 3 0x48 1 0x01>,
			<LCM_FUNC_CMD LCM_UTIL_WRITE_CMD_V2 3 0x49 1 0x3e>,
			<LCM_FUNC_CMD LCM_UTIL_WRITE_CMD_V2 3 0x4A 1 0x01>,
			<LCM_FUNC_CMD LCM_UTIL_WRITE_CMD_V2 3 0x4B 1 0x76>,
			<LCM_FUNC_CMD LCM_UTIL_WRITE_CMD_V2 3 0x4C 1 0x01>,
			<LCM_FUNC_CMD LCM_UTIL_WRITE_CMD_V2 3 0x4D 1 0xa3>,
			<LCM_FUNC_CMD LCM_UTIL_WRITE_CMD_V2 3 0x4E 1 0x01>,
			<LCM_FUNC_CMD LCM_UTIL_WRITE_CMD_V2 3 0x4F 1 0xe9>,
			<LCM_FUNC_CMD LCM_UTIL_WRITE_CMD_V2 3 0x50 1 0x02>,
			<LCM_FUNC_CMD LCM_UTIL_WRITE_CMD_V2 3 0x51 1 0x20>,
			<LCM_FUNC_CMD LCM_UTIL_WRITE_CMD_V2 3 0x52 1 0x02>,
			<LCM_FUNC_CMD LCM_UTIL_WRITE_CMD_V2 3 0x53 1 0x22>,
			<LCM_FUNC_CMD LCM_UTIL_WRITE_CMD_V2 3 0x54 1 0x02>,
			<LCM_FUNC_CMD LCM_UTIL_WRITE_CMD_V2 3 0x55 1 0x56>,
			<LCM_FUNC_CMD LCM_UTIL_WRITE_CMD_V2 3 0x56 1 0x02>,
			<LCM_FUNC_CMD LCM_UTIL_WRITE_CMD_V2 3 0x58 1 0x8f>,
			<LCM_FUNC_CMD LCM_UTIL_WRITE_CMD_V2 3 0x59 1 0x02>,
			<LCM_FUNC_CMD LCM_UTIL_WRITE_CMD_V2 3 0x5A 1 0xb2>,
			<LCM_FUNC_CMD LCM_UTIL_WRITE_CMD_V2 3 0x5B 1 0x02>,
			<LCM_FUNC_CMD LCM_UTIL_WRITE_CMD_V2 3 0x5C 1 0xe2>,
			<LCM_FUNC_CMD LCM_UTIL_WRITE_CMD_V2 3 0x5D 1 0x03>,
			<LCM_FUNC_CMD LCM_UTIL_WRITE_CMD_V2 3 0x5E 1 0x02>,
			<LCM_FUNC_CMD LCM_UTIL_WRITE_CMD_V2 3 0x5F 1 0x03>,
			<LCM_FUNC_CMD LCM_UTIL_WRITE_CMD_V2 3 0x60 1 0x2d>,
			<LCM_FUNC_CMD LCM_UTIL_WRITE_CMD_V2 3 0x61 1 0x03>,
			<LCM_FUNC_CMD LCM_UTIL_WRITE_CMD_V2 3 0x62 1 0x3a>,
			<LCM_FUNC_CMD LCM_UTIL_WRITE_CMD_V2 3 0x63 1 0x03>,
			<LCM_FUNC_CMD LCM_UTIL_WRITE_CMD_V2 3 0x64 1 0x48>,
			<LCM_FUNC_CMD LCM_UTIL_WRITE_CMD_V2 3 0x65 1 0x03>,
			<LCM_FUNC_CMD LCM_UTIL_WRITE_CMD_V2 3 0x66 1 0x58>,
			<LCM_FUNC_CMD LCM_UTIL_WRITE_CMD_V2 3 0x67 1 0x03>,
			<LCM_FUNC_CMD LCM_UTIL_WRITE_CMD_V2 3 0x68 1 0x6a>,
			<LCM_FUNC_CMD LCM_UTIL_WRITE_CMD_V2 3 0x69 1 0x03>,
			<LCM_FUNC_CMD LCM_UTIL_WRITE_CMD_V2 3 0x6A 1 0x80>,
			<LCM_FUNC_CMD LCM_UTIL_WRITE_CMD_V2 3 0x6B 1 0x03>,
			<LCM_FUNC_CMD LCM_UTIL_WRITE_CMD_V2 3 0x6C 1 0x9d>,
			<LCM_FUNC_CMD LCM_UTIL_WRITE_CMD_V2 3 0x6D 1 0x03>,
			<LCM_FUNC_CMD LCM_UTIL_WRITE_CMD_V2 3 0x6E 1 0xb7>,
			<LCM_FUNC_CMD LCM_UTIL_WRITE_CMD_V2 3 0x6F 1 0x03>,
			<LCM_FUNC_CMD LCM_UTIL_WRITE_CMD_V2 3 0x70 1 0xFF>,
			<LCM_FUNC_CMD LCM_UTIL_WRITE_CMD_V2 3 0x71 1 0x00>,
			<LCM_FUNC_CMD LCM_UTIL_WRITE_CMD_V2 3 0x72 1 0x00>,
			<LCM_FUNC_CMD LCM_UTIL_WRITE_CMD_V2 3 0x73 1 0x00>,
			<LCM_FUNC_CMD LCM_UTIL_WRITE_CMD_V2 3 0x74 1 0x3e>,
			<LCM_FUNC_CMD LCM_UTIL_WRITE_CMD_V2 3 0x75 1 0x00>,
			<LCM_FUNC_CMD LCM_UTIL_WRITE_CMD_V2 3 0x76 1 0x6f>,
			<LCM_FUNC_CMD LCM_UTIL_WRITE_CMD_V2 3 0x77 1 0x00>,
			<LCM_FUNC_CMD LCM_UTIL_WRITE_CMD_V2 3 0x78 1 0x8f>,
			<LCM_FUNC_CMD LCM_UTIL_WRITE_CMD_V2 3 0x79 1 0x00>,
			<LCM_FUNC_CMD LCM_UTIL_WRITE_CMD_V2 3 0x7A 1 0xa7>,
			<LCM_FUNC_CMD LCM_UTIL_WRITE_CMD_V2 3 0x7B 1 0x00>,
			<LCM_FUNC_CMD LCM_UTIL_WRITE_CMD_V2 3 0x7C 1 0xbc>,
			<LCM_FUNC_CMD LCM_UTIL_WRITE_CMD_V2 3 0x7D 1 0x00>,
			<LCM_FUNC_CMD LCM_UTIL_WRITE_CMD_V2 3 0x7E 1 0xce>,
			<LCM_FUNC_CMD LCM_UTIL_WRITE_CMD_V2 3 0x7F 1 0x00>,
			<LCM_FUNC_CMD LCM_UTIL_WRITE_CMD_V2 3 0x80 1 0xdd>,
			<LCM_FUNC_CMD LCM_UTIL_WRITE_CMD_V2 3 0x81 1 0x00>,
			<LCM_FUNC_CMD LCM_UTIL_WRITE_CMD_V2 3 0x82 1 0xec>,
			<LCM_FUNC_CMD LCM_UTIL_WRITE_CMD_V2 3 0x83 1 0x01>,
			<LCM_FUNC_CMD LCM_UTIL_WRITE_CMD_V2 3 0x84 1 0x1a>,
			<LCM_FUNC_CMD LCM_UTIL_WRITE_CMD_V2 3 0x85 1 0x01>,
			<LCM_FUNC_CMD LCM_UTIL_WRITE_CMD_V2 3 0x86 1 0x3e>,
			<LCM_FUNC_CMD LCM_UTIL_WRITE_CMD_V2 3 0x87 1 0x01>,
			<LCM_FUNC_CMD LCM_UTIL_WRITE_CMD_V2 3 0x88 1 0x76>,
			<LCM_FUNC_CMD LCM_UTIL_WRITE_CMD_V2 3 0x89 1 0x01>,
			<LCM_FUNC_CMD LCM_UTIL_WRITE_CMD_V2 3 0x8A 1 0xa3>,
			<LCM_FUNC_CMD LCM_UTIL_WRITE_CMD_V2 3 0x8B 1 0x01>,
			<LCM_FUNC_CMD LCM_UTIL_WRITE_CMD_V2 3 0x8C 1 0xe9>,
			<LCM_FUNC_CMD LCM_UTIL_WRITE_CMD_V2 3 0x8D 1 0x02>,
			<LCM_FUNC_CMD LCM_UTIL_WRITE_CMD_V2 3 0x8E 1 0x20>,
			<LCM_FUNC_CMD LCM_UTIL_WRITE_CMD_V2 3 0x8F 1 0x02>,
			<LCM_FUNC_CMD LCM_UTIL_WRITE_CMD_V2 3 0x90 1 0x22>,
			<LCM_FUNC_CMD LCM_UTIL_WRITE_CMD_V2 3 0x91 1 0x02>,
			<LCM_FUNC_CMD LCM_UTIL_WRITE_CMD_V2 3 0x92 1 0x56>,
			<LCM_FUNC_CMD LCM_UTIL_WRITE_CMD_V2 3 0x93 1 0x02>,
			<LCM_FUNC_CMD LCM_UTIL_WRITE_CMD_V2 3 0x94 1 0x8f>,
			<LCM_FUNC_CMD LCM_UTIL_WRITE_CMD_V2 3 0x95 1 0x02>,
			<LCM_FUNC_CMD LCM_UTIL_WRITE_CMD_V2 3 0x96 1 0xb2>,
			<LCM_FUNC_CMD LCM_UTIL_WRITE_CMD_V2 3 0x97 1 0x02>,
			<LCM_FUNC_CMD LCM_UTIL_WRITE_CMD_V2 3 0x98 1 0xe2>,
			<LCM_FUNC_CMD LCM_UTIL_WRITE_CMD_V2 3 0x99 1 0x03>,
			<LCM_FUNC_CMD LCM_UTIL_WRITE_CMD_V2 3 0x9A 1 0x02>,
			<LCM_FUNC_CMD LCM_UTIL_WRITE_CMD_V2 3 0x9B 1 0x03>,
			<LCM_FUNC_CMD LCM_UTIL_WRITE_CMD_V2 3 0x9C 1 0x2d>,
			<LCM_FUNC_CMD LCM_UTIL_WRITE_CMD_V2 3 0x9D 1 0x03>,
			<LCM_FUNC_CMD LCM_UTIL_WRITE_CMD_V2 3 0x9E 1 0x3a>,
			<LCM_FUNC_CMD LCM_UTIL_WRITE_CMD_V2 3 0x9F 1 0x03>,
			<LCM_FUNC_CMD LCM_UTIL_WRITE_CMD_V2 3 0xA0 1 0x48>,
			<LCM_FUNC_CMD LCM_UTIL_WRITE_CMD_V2 3 0xA2 1 0x03>,
			<LCM_FUNC_CMD LCM_UTIL_WRITE_CMD_V2 3 0xA3 1 0x58>,
			<LCM_FUNC_CMD LCM_UTIL_WRITE_CMD_V2 3 0xA4 1 0x03>,
			<LCM_FUNC_CMD LCM_UTIL_WRITE_CMD_V2 3 0xA5 1 0x6a>,
			<LCM_FUNC_CMD LCM_UTIL_WRITE_CMD_V2 3 0xA6 1 0x03>,
			<LCM_FUNC_CMD LCM_UTIL_WRITE_CMD_V2 3 0xA7 1 0x80>,
			<LCM_FUNC_CMD LCM_UTIL_WRITE_CMD_V2 3 0xA9 1 0x03>,
			<LCM_FUNC_CMD LCM_UTIL_WRITE_CMD_V2 3 0xAA 1 0x9d>,
			<LCM_FUNC_CMD LCM_UTIL_WRITE_CMD_V2 3 0xAB 1 0x03>,
			<LCM_FUNC_CMD LCM_UTIL_WRITE_CMD_V2 3 0xAC 1 0xb7>,
			<LCM_FUNC_CMD LCM_UTIL_WRITE_CMD_V2 3 0xAD 1 0x03>,
			<LCM_FUNC_CMD LCM_UTIL_WRITE_CMD_V2 3 0xAE 1 0xFF>,
			<LCM_FUNC_CMD LCM_UTIL_WRITE_CMD_V2 3 0xAF 1 0x00>,
			<LCM_FUNC_CMD LCM_UTIL_WRITE_CMD_V2 3 0xB0 1 0x00>,
			<LCM_FUNC_CMD LCM_UTIL_WRITE_CMD_V2 3 0xB1 1 0x00>,
			<LCM_FUNC_CMD LCM_UTIL_WRITE_CMD_V2 3 0xB2 1 0x3e>,
			<LCM_FUNC_CMD LCM_UTIL_WRITE_CMD_V2 3 0xB3 1 0x00>,
			<LCM_FUNC_CMD LCM_UTIL_WRITE_CMD_V2 3 0xB4 1 0x6f>,
			<LCM_FUNC_CMD LCM_UTIL_WRITE_CMD_V2 3 0xB5 1 0x00>,
			<LCM_FUNC_CMD LCM_UTIL_WRITE_CMD_V2 3 0xB6 1 0x8f>,
			<LCM_FUNC_CMD LCM_UTIL_WRITE_CMD_V2 3 0xB7 1 0x00>,
			<LCM_FUNC_CMD LCM_UTIL_WRITE_CMD_V2 3 0xB8 1 0xa7>,
			<LCM_FUNC_CMD LCM_UTIL_WRITE_CMD_V2 3 0xB9 1 0x00>,
			<LCM_FUNC_CMD LCM_UTIL_WRITE_CMD_V2 3 0xBA 1 0xbc>,
			<LCM_FUNC_CMD LCM_UTIL_WRITE_CMD_V2 3 0xBB 1 0x00>,
			<LCM_FUNC_CMD LCM_UTIL_WRITE_CMD_V2 3 0xBC 1 0xce>,
			<LCM_FUNC_CMD LCM_UTIL_WRITE_CMD_V2 3 0xBD 1 0x00>,
			<LCM_FUNC_CMD LCM_UTIL_WRITE_CMD_V2 3 0xBE 1 0xdd>,
			<LCM_FUNC_CMD LCM_UTIL_WRITE_CMD_V2 3 0xBF 1 0x00>,
			<LCM_FUNC_CMD LCM_UTIL_WRITE_CMD_V2 3 0xC0 1 0xec>,
			<LCM_FUNC_CMD LCM_UTIL_WRITE_CMD_V2 3 0xC1 1 0x01>,
			<LCM_FUNC_CMD LCM_UTIL_WRITE_CMD_V2 3 0xC2 1 0x1a>,
			<LCM_FUNC_CMD LCM_UTIL_WRITE_CMD_V2 3 0xC3 1 0x01>,
			<LCM_FUNC_CMD LCM_UTIL_WRITE_CMD_V2 3 0xC4 1 0x3e>,
			<LCM_FUNC_CMD LCM_UTIL_WRITE_CMD_V2 3 0xC5 1 0x01>,
			<LCM_FUNC_CMD LCM_UTIL_WRITE_CMD_V2 3 0xC6 1 0x76>,
			<LCM_FUNC_CMD LCM_UTIL_WRITE_CMD_V2 3 0xC7 1 0x01>,
			<LCM_FUNC_CMD LCM_UTIL_WRITE_CMD_V2 3 0xC8 1 0xa3>,
			<LCM_FUNC_CMD LCM_UTIL_WRITE_CMD_V2 3 0xC9 1 0x01>,
			<LCM_FUNC_CMD LCM_UTIL_WRITE_CMD_V2 3 0xCA 1 0xe9>,
			<LCM_FUNC_CMD LCM_UTIL_WRITE_CMD_V2 3 0xCB 1 0x02>,
			<LCM_FUNC_CMD LCM_UTIL_WRITE_CMD_V2 3 0xCC 1 0x20>,
			<LCM_FUNC_CMD LCM_UTIL_WRITE_CMD_V2 3 0xCD 1 0x02>,
			<LCM_FUNC_CMD LCM_UTIL_WRITE_CMD_V2 3 0xCE 1 0x22>,
			<LCM_FUNC_CMD LCM_UTIL_WRITE_CMD_V2 3 0xCF 1 0x02>,
			<LCM_FUNC_CMD LCM_UTIL_WRITE_CMD_V2 3 0xD0 1 0x56>,
			<LCM_FUNC_CMD LCM_UTIL_WRITE_CMD_V2 3 0xD1 1 0x02>,
			<LCM_FUNC_CMD LCM_UTIL_WRITE_CMD_V2 3 0xD2 1 0x8f>,
			<LCM_FUNC_CMD LCM_UTIL_WRITE_CMD_V2 3 0xD3 1 0x02>,
			<LCM_FUNC_CMD LCM_UTIL_WRITE_CMD_V2 3 0xD4 1 0xb2>,
			<LCM_FUNC_CMD LCM_UTIL_WRITE_CMD_V2 3 0xD5 1 0x02>,
			<LCM_FUNC_CMD LCM_UTIL_WRITE_CMD_V2 3 0xD6 1 0xe2>,
			<LCM_FUNC_CMD LCM_UTIL_WRITE_CMD_V2 3 0xD7 1 0x03>,
			<LCM_FUNC_CMD LCM_UTIL_WRITE_CMD_V2 3 0xD8 1 0x02>,
			<LCM_FUNC_CMD LCM_UTIL_WRITE_CMD_V2 3 0xD9 1 0x03>,
			<LCM_FUNC_CMD LCM_UTIL_WRITE_CMD_V2 3 0xDA 1 0x2d>,
			<LCM_FUNC_CMD LCM_UTIL_WRITE_CMD_V2 3 0xDB 1 0x03>,
			<LCM_FUNC_CMD LCM_UTIL_WRITE_CMD_V2 3 0xDC 1 0x3a>,
			<LCM_FUNC_CMD LCM_UTIL_WRITE_CMD_V2 3 0xDD 1 0x03>,
			<LCM_FUNC_CMD LCM_UTIL_WRITE_CMD_V2 3 0xDE 1 0x48>,
			<LCM_FUNC_CMD LCM_UTIL_WRITE_CMD_V2 3 0xDF 1 0x03>,
			<LCM_FUNC_CMD LCM_UTIL_WRITE_CMD_V2 3 0xE0 1 0x58>,
			<LCM_FUNC_CMD LCM_UTIL_WRITE_CMD_V2 3 0xE1 1 0x03>,
			<LCM_FUNC_CMD LCM_UTIL_WRITE_CMD_V2 3 0xE2 1 0x6a>,
			<LCM_FUNC_CMD LCM_UTIL_WRITE_CMD_V2 3 0xE3 1 0x03>,
			<LCM_FUNC_CMD LCM_UTIL_WRITE_CMD_V2 3 0xE4 1 0x80>,
			<LCM_FUNC_CMD LCM_UTIL_WRITE_CMD_V2 3 0xE5 1 0x03>,
			<LCM_FUNC_CMD LCM_UTIL_WRITE_CMD_V2 3 0xE6 1 0x9d>,
			<LCM_FUNC_CMD LCM_UTIL_WRITE_CMD_V2 3 0xE7 1 0x03>,
			<LCM_FUNC_CMD LCM_UTIL_WRITE_CMD_V2 3 0xE8 1 0xb7>,
			<LCM_FUNC_CMD LCM_UTIL_WRITE_CMD_V2 3 0xE9 1 0x03>,
			<LCM_FUNC_CMD LCM_UTIL_WRITE_CMD_V2 3 0xEA 1 0xFF>,
			<LCM_FUNC_CMD LCM_UTIL_WRITE_CMD_V2 3 0xFF 1 0x21>,
			<LCM_FUNC_UTIL LCM_UTIL_UDELAY 1 1>,
			<LCM_FUNC_CMD LCM_UTIL_WRITE_CMD_V2 3 0xEB 1 0x30>,
			<LCM_FUNC_CMD LCM_UTIL_WRITE_CMD_V2 3 0xEC 1 0x17>,
			<LCM_FUNC_CMD LCM_UTIL_WRITE_CMD_V2 3 0xED 1 0x20>,
			<LCM_FUNC_CMD LCM_UTIL_WRITE_CMD_V2 3 0xEE 1 0x0F>,
			<LCM_FUNC_CMD LCM_UTIL_WRITE_CMD_V2 3 0xEF 1 0x1F>,
			<LCM_FUNC_CMD LCM_UTIL_WRITE_CMD_V2 3 0xF0 1 0x0F>,
			<LCM_FUNC_CMD LCM_UTIL_WRITE_CMD_V2 3 0xF1 1 0x0F>,
			<LCM_FUNC_CMD LCM_UTIL_WRITE_CMD_V2 3 0xF2 1 0x07>,
			<LCM_FUNC_CMD LCM_UTIL_WRITE_CMD_V2 3 0xFF 1 0x23>,
			<LCM_FUNC_UTIL LCM_UTIL_UDELAY 1 1>,
			<LCM_FUNC_CMD LCM_UTIL_WRITE_CMD_V2 3 0x08 1 0x04>,
			<LCM_FUNC_CMD LCM_UTIL_WRITE_CMD_V2 3 0xFF 1 0x10>,
			<LCM_FUNC_UTIL LCM_UTIL_UDELAY 1 1>,
			<LCM_FUNC_CMD LCM_UTIL_WRITE_CMD_V2 3 0x35 1 0x00>,
			<LCM_FUNC_CMD LCM_UTIL_WRITE_CMD_V2 4 0x44 2 0x05 0x00>,
			<LCM_FUNC_CMD LCM_UTIL_WRITE_CMD_V2 2 0x11 0>,
			<LCM_FUNC_UTIL LCM_UTIL_MDELAY 1 120>,
			<LCM_FUNC_CMD LCM_UTIL_WRITE_CMD_V2 2 0x29 0>;

		compare_id = <LCM_FUNC_UTIL LCM_UTIL_RESET 1 LCM_UTIL_RESET_HIGH>,
			<LCM_FUNC_UTIL LCM_UTIL_MDELAY 1 1>,
			<LCM_FUNC_UTIL LCM_UTIL_RESET 1 LCM_UTIL_RESET_LOW>,
			<LCM_FUNC_UTIL LCM_UTIL_MDELAY 1 10>,
			<LCM_FUNC_UTIL LCM_UTIL_RESET 1 LCM_UTIL_RESET_HIGH>,
			<LCM_FUNC_UTIL LCM_UTIL_MDELAY 1 10>,
			<LCM_FUNC_CMD LCM_UTIL_WRITE_CMD_V1 5 1 0x00 0x37 0x02 0x00>,
			<LCM_FUNC_CMD LCM_UTIL_READ_CMD_V2 3 0xF4 1 0xF5>;

		suspend = <LCM_FUNC_CMD LCM_UTIL_WRITE_CMD_V2 2 0x28 0>,
			<LCM_FUNC_CMD LCM_UTIL_WRITE_CMD_V2 2 0x10 0>,
			<LCM_FUNC_UTIL LCM_UTIL_MDELAY 1 120>,
			<LCM_FUNC_CMD LCM_UTIL_WRITE_CMD_V2 3 0x4F 1 0x01>,
			<LCM_FUNC_UTIL LCM_UTIL_MDELAY 1 120>,
			<LCM_FUNC_UTIL LCM_UTIL_MDELAY 1 10>,
			<LCM_FUNC_GPIO LCM_GPIO_MODE 1 LCM_GPIO_MODE_00>,
			<LCM_FUNC_GPIO LCM_GPIO_DIR 1 LCM_GPIO_DIR_OUT>,
			<LCM_FUNC_GPIO LCM_GPIO_OUT 1 LCM_GPIO_OUT_ZERO>;

		backlight = <LCM_FUNC_CMD LCM_UTIL_WRITE_CMD_V2 3 0x51 1 0xFF>;

		backlight_cmdq = <LCM_FUNC_CMD LCM_UTIL_WRITE_CMD_V23 3 0x51 1 0xFF>;
	};
	/* LCM standardization end */
};

