## drivers/power/supply/mediatek/charger/Kconfig
```kconfig
config MTK_CHARGER
	bool "MediaTek Charging Driver"
	depends on MEDIATEK_SOLUTION
	default n
	help
	  Say yes here to enable MediaTek charging driver.
	  This driver contains charging control flow and
	  maintains charging status.
	  Say no if not using MediaTek charging driver.

config POWER_EXT
	bool "MediaTek Power Ext"
	default n
	help
	  Check this if the device is not powered by battery.
	  For example, if the device is powered by AC adapter.
	  Select No if the device needs info about
	  battery voltage, temperature, etc.

config MTK_SWCHR_SUPPORT
	bool "MediaTek switch charger"
	default n
	depends on MTK_CHARGER
	help
	  This is to enable switching charger control flow.
	  switching charger has better performance than pulse charger
	  Set to yes if switching charger is used.
	  Set to no if pmic pulse charger is used.

config MTK_KERNEL_POWER_OFF_CHARGING
	bool "MTK kernel power off charging"
	default n
	depends on MTK_CHARGER
	help
	  yes : support KPOC feature, power off charging would running by
	  kernel and charging animation by kpoc service. no: not support KPOC
	  feature.
	  device won't enter charging mode if config is no.

config SWCHR_POWER_PATH
	bool "External charger IC supports powerpath"
	default n
	depends on MTK_CHARGER
	help
	  Set Yes if the external charger IC
	  supports power path function.
	  This affects setting of auxadc channels
	  used to representing voltage of system
	  or battery.
```

## drivers/power/supply/mediatek/turbo_qc3p/Kconfig
```kconfig
config CHARGER_QC_POLICY
    bool "QC3+ Charger Policy"
    help
      Say yes here to enable qc3+ charger policy.
      This driver contains charging control flow and
      maintains charging status.
      Say no if not using Qc3+ charger policy manager

config CHARGER_TURBO_QC3P
    bool "Turbo QC3+ Charger Policy"
    help
      Say yes here to enable Turbo qc3+ charger policy.
      This driver contains charging control flow and
      maintains charging status.
      Say no if not using Turbo Qc3+ charger policy manager
```

## drivers/power/supply/qc/Kconfig
```kconfig
config CHARGER_SC854X
    bool "charger pump SC854X device driver"
    depends on CHARGER_DEVICE_QC
    default n
    help
      This config is for charger pump sc854x device driver
      Say Y to enable charger pump sc854x
      Say N to disable

config CHARGER_WT6670F
    bool "qc3+ wt6670f or z350 device driver"
    depends on CHARGER_DEVICE_QC
    default n
    help
      This config is for qc3+ wt6670f or z350 device driver
      Say Y to enable wt6670f or z350
      Say N to disable
```

## drivers/power/supply/sc8989x/Kconfig
```kconfig
config CHARGER_SC8989X
	bool "Switch charger SC8989X driver"
	depends on CHARGER_DEVICE_SC
	default n
	help
	  This config is for switch charger sc8989x
	  Say Y to enable switch charger sc8989x
	  Say N to disable
```

## drivers/power/supply/sgm415xx/Kconfig
```kconfig
config CHARGER_SGM415XX
	bool "Switch charger SGM415XX driver"
	depends on CHARGER_DEVICE_SGM
	default n
	help
	  This config is for switch charger sgm415xx
	  Say Y to enable switch charger sgm4154x
	  Say N to disable
```

## drivers/power/supply/sy697x/Kconfig
```kconfig
config CHARGER_SY697X
	bool "Switch charger sy697x device driver"
	depends on CHARGER_DEVICE_SY
	default n
	help
	  This config is for switch charger sy697X
	  Say Y to enable switch charger sy697x
	  Say N to disable
```

## drivers/soc/mediatek/Kconfig
```kconfig
#
# MediaTek SoC drivers
#
config SOC_MEDIATEK
	bool
	help
	  Mediatek SoC support.

config MTK_INFRACFG
	bool "MediaTek INFRACFG Support"
	depends on ARCH_MEDIATEK
	select SOC_MEDIATEK
	select REGMAP
	help
	  Say yes here to add support for the MediaTek INFRACFG controller. The
	  INFRACFG controller contains various infrastructure registers not
	  directly associated to any device.
	  INFRACFG controller is needed by SCPSYS driver.

config MTK_SCPSYS_MT8173
	bool "SCPSYS Support for MediaTek MT8173"
	depends on MTK_INFRACFG
	select SOC_MEDIATEK
	select REGMAP
	select PM_GENERIC_DOMAINS
	default y if ARCH_MT8173
	help
	  Say yes here to add support for the MediaTek SCPSYS power domain
	  driver.
	  The System Control Processor System (SCPSYS) has several power
	  management related tasks in the system.

config MTK_SCPSYS_MT8163
	bool "SCPSYS Support MediaTek MT8163"
	depends on MTK_INFRACFG
	select SOC_MEDIATEK
	select REGMAP
	select PM_GENERIC_DOMAINS
	default y if ARCH_MT8163
	help
	  Say yes here to add support for the MediaTek SCPSYS power domain
	  driver.
	  The System Control Processor System (SCPSYS) has several power
	  management related tasks in the system.

config MTK_SCPSYS_MT2701
	bool "SCPSYS Support MediaTek MT2701"
	depends on MTK_INFRACFG
	select SOC_MEDIATEK
	select REGMAP
	select PM_GENERIC_DOMAINS
	default y if MACH_MT2701
	help
	  Say yes here to add support for the MediaTek SCPSYS power domain
	  driver.
	  The System Control Processor System (SCPSYS) has several power
	  management related tasks in the system.

config MTK_PMIC_WRAP
	tristate "MediaTek PMIC Wrapper Support"
	depends on ARCH_MEDIATEK
	select REGMAP
	help
	  Say yes here to add support for MediaTek PMIC Wrapper found
	  on different MediaTek SoCs. The PMIC wrapper is a proprietary
	  hardware to connect the PMIC.
```

## drivers/staging/android/Kconfig
```kconfig
menu "Android"

if ANDROID

config ASHMEM
	bool "Enable the Anonymous Shared Memory Subsystem"
	default n
	depends on SHMEM
	---help---
	  The ashmem subsystem is a new shared memory allocator, similar to
	  POSIX SHM but with different behavior and sporting a simpler
	  file-based API.

	  It is, in theory, a good memory allocator for low-memory devices,
	  because it can discard shared memory units when under memory pressure.

config ANDROID_LOW_MEMORY_KILLER
	bool "Android Low Memory Killer"
	---help---
	  Registers processes to be killed when low memory conditions, this is useful
	  as there is no particular swap space on android.

	  The registered process will kill according to the priorities in android init
	  scripts (/init.rc), and it defines priority values with minimum free memory size
	  for each priority.

config ANDROID_LOW_MEMORY_KILLER_AUTODETECT_OOM_ADJ_VALUES
	bool "Android Low Memory Killer: detect oom_adj values"
	depends on ANDROID_LOW_MEMORY_KILLER
	default y
	---help---
	  Detect oom_adj values written to
	  /sys/module/lowmemorykiller/parameters/adj and convert them
	  to oom_score_adj values.

config ANDROID_INTF_ALARM_DEV
	bool "Android alarm driver"
	depends on RTC_CLASS
	default n
	---help---
	  Provides non-wakeup and rtc backed wakeup alarms based on rtc or
	  elapsed realtime, and a non-wakeup alarm on the monotonic clock.
	  Espically for wake up alarm ioctl.
	  Also exports the alarm interface to user-space.

config MTK_GMO_RAM_OPTIMIZE
	bool "MTK ram optimize"
	default n
	select MTK_ENABLE_GMO
	select MTK_ENABLE_AGO
	help
	  Provide centeral config to use memory efficiently.
	  GMO must set both in kernel & project config to prevent
	  different flow.
	  If you are not familiar with this config, please set it to n.

config MTK_ENABLE_GMO
	bool "Enable/Disable GMO related feautre"
	default n
	select CC_OPTIMIZE_FOR_SIZE
	select ZRAM_LZ4K_COMPRESS
	---help---
	Enable/Disable GMO related feautre
	Do not use this options in Kernel directly
	this is a group kernel setting of GMO
	must set CONFIG_LOG_BUF_SHIFT=17 manually

config MTK_ENABLE_AGO
	bool "Enable/Disable A-Go related feautre"
	default n
	select SWAP
	select ZRAM
	select ZRAM_LZ4_COMPRESS
	select MEMCG
	select MEMCG_SWAP
	select HZ_300
	select UID_CPUTIME
	select SDCARD_FS
	select MTK_DM_VERITY_OFF
	---help---
	Enable/Disable GMO related feautre
	Do not use this options in Kernel directly
	this is a group kernel setting of AGO

source "drivers/staging/android/ion/Kconfig"

source "drivers/staging/android/fiq_debugger/Kconfig"

endif # if ANDROID

endmenu
```

## drivers/staging/android/ion/Kconfig
```kconfig
menuconfig ION
	bool "Ion Memory Manager"
	depends on HAVE_MEMBLOCK && HAS_DMA && MMU
	select GENERIC_ALLOCATOR
	select DMA_SHARED_BUFFER
	---help---
	  Chose this option to enable the ION Memory Manager,
	  used by Android to efficiently allocate buffers
	  from userspace that can be shared between drivers.
	  If you're not using Android its probably safe to
	  say N here.

config ION_TEST
	tristate "Ion Test Device"
	depends on ION
	help
	  Choose this option to create a device that can be used to test the
	  kernel and device side ION functions.
	  this file to ion test.
	  you want to test ion, please uset this option.

config ION_DUMMY
	bool "Dummy Ion driver"
	depends on ION
	help
	  Provides a dummy ION driver that registers the
	  /dev/ion device and some basic heaps. This can
	  be used for testing the ION infrastructure if
	  one doesn't have access to hardware drivers that
	  use ION.

config ION_TEGRA
	tristate "Ion for Tegra"
	depends on ARCH_TEGRA && ION
	help
	  Choose this option if you wish to use ion on an nVidia Tegra.
	  ion for tegra is on an nVidia tegra.
	  It set in xxxx_defconfig.mk.
	  default is on.

source "drivers/staging/android/ion/mtk/Kconfig"
```

## drivers/staging/android/ion/mtk/Kconfig
```kconfig
#
# Copyright (C) 2015 MediaTek Inc.
#
# This program is free software: you can redistribute it and/or modify
# it under the terms of the GNU General Public License version 2 as
# published by the Free Software Foundation.
#
# This program is distributed in the hope that it will be useful,
# but WITHOUT ANY WARRANTY; without even the implied warranty of
# MERCHANTABILITY or FITNESS FOR A PARTICULAR PURPOSE. See the
# GNU General Public License for more details.
#
config MTK_ION
	tristate "MTK ION -- ion multimedia heap"
	depends on ION
	help
	  Choose this option to support multimedia heap.
	  It means support ION.
	  It set in xxxx_defconfig.mk
	  default is on.

config MTK_ION_CAM_POOL_DIS
	tristate "MTK_ION_CAM_POOL_DIS -- camera heap pool"
	default n
	help
	  This option is useful for ION_HEAP_TYPE_MULTIMEDIA_FOR_CAMERA.
	  For ion camera heap, buffer is reclaimed to system instead
	  of reclaiming to camera heap pool.So the memory of system can
	  use the buffer.
```

## drivers/staging/dyn_obj/Kconfig
```kconfig
config MTK_DO
	bool "MediaTek Dynamic Object support"
	default n
	help
	  DynamicObject AP driver for IPI communication to SCP DynamicObject core
```

## drivers/switch/Kconfig
```kconfig
menuconfig SWITCH
	tristate "Switch class support"
	help
	  Say Y here to enable switch class support. This allows
	  monitoring switches by userspace via sysfs and uevent.

if SWITCH

config SWITCH_GPIO
	tristate "GPIO Swith support"
	depends on GPIOLIB
	help
	  Say Y here to enable GPIO based switch support.

config SWITCH_USB_RT8973
	bool "RT8973 USB Switch Driver"
	default n
	help
	  Say Y here to enable RT8973 usb switch support.

endif # SWITCH
```

## drivers/tee/rsee/Kconfig
```kconfig
# RSEE Trusted Execution Environment Configuration
config RSEE
	tristate "RSEE"
	#depends on HAVE_ARM_SMCCC
	help
	  This implements the RSEE Trusted Execution Environment (TEE)
	  driver.
```

## drivers/trusty/Kconfig
```kconfig
#
# Trusty
#

menu "Trusty"

config TRUSTY
	tristate "Trusty"
	default n

config TRUSTY_LOG
	tristate
	depends on TRUSTY
	default y

config TRUSTY_VIRTIO
	tristate "Trusty virtio support"
	depends on TRUSTY
	select VIRTIO
	default y

config TRUSTY_VIRTIO_IPC
	tristate "Trusty Virtio IPC driver"
	depends on TRUSTY_VIRTIO
	default y
	help
	  This module adds support for communications with Trusty Services

	  If you choose to build a module, it'll be called trusty-ipc.
	  Say N if unsure.

config MT_TRUSTY_DEBUGFS
	tristate "Trusty debugfs for Mediatek platforms"
	default n

config TRUSTY_INTERRUPT_MAP
	tristate "Trusty interrupt map"
	depends on TRUSTY
	default n

endmenu
```

## drivers/video/Kconfig
```kconfig
#
# Video configuration
#

menu "Graphics support"
	depends on HAS_IOMEM

config HAVE_FB_ATMEL
	bool

config SH_MIPI_DSI
	tristate
	depends on (SUPERH || ARCH_SHMOBILE) && HAVE_CLK

config SH_LCD_MIPI_DSI
	bool

source "drivers/char/agp/Kconfig"

menu "ARM GPU Configuration"
source "drivers/gpu/arm/Kconfig"
endmenu

source "drivers/gpu/vga/Kconfig"

source "drivers/gpu/host1x/Kconfig"
source "drivers/gpu/ipu-v3/Kconfig"

menu "Direct Rendering Manager"
source "drivers/gpu/drm/Kconfig"
endmenu

menu "Frame buffer Devices"
source "drivers/video/fbdev/Kconfig"
endmenu

source "drivers/video/backlight/Kconfig"
source "drivers/video/adf/Kconfig"

config VGASTATE
       tristate
       default n

config VIDEOMODE_HELPERS
	bool

# add by longcheer yufangfang for cabc
config LCT_CABC_MODE_SUPPORT
	bool "LCT_CABC_MODE_SUPPORT"
#yufangfang add end

# add by longhceer yufangfang for hbm
config LCT_HBM_SUPPORT
	bool "LCT_HBM_SUPPORT"
# yufangfang add end

# add by longhceer yufangfang for esd check
config LCT_ESD_CHECK_MULTI_REG
	bool "LCT_ESD_CHECK_MULTI_REG"
# yufangfang add end

config HDMI
	bool

if VT
	source "drivers/video/console/Kconfig"
endif

if FB || SGI_NEWPORT_CONSOLE
	source "drivers/video/logo/Kconfig"

endif


endmenu
```
