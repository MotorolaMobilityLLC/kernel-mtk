## drivers/input/touchscreen/mediatek/lct_gt917d/Kconfig
```kconfig
#
# Touchscreen driver configuration
#
menu "GT9 Touchscreen Config"
	depends on TOUCHSCREEN_MTK_GT917D

if TOUCHSCREEN_MTK_GT917D

config GTP_USE_PINCTRL
	bool "GT9 GPIO use Pinctrl"
	default y
	help
	Say Y here if you build GT9 driver on MTK Phone platform.

	If unsure, say N.

config GTP_FIRMWARE
	string "GT9 firmawre group"
	default "firmware0"

config GTP_CONFIG
	string "GT9 config data group"
	default "config0"

config GTP_DRIVER_SEND_CFG
	bool "GT9 driver send config"
	default n
	help
	Say Y here if you have GT9 touch panel GTP_DRIVER_SEND_CFG.

	If unsure, say N.

config GTP_GLOVE_MODE
	bool "GT9 driver send config"
	default n
	help
	Say Y here if you have GT9 touch panel GTP_DRIVER_SEND_CFG.

	If unsure, say N.

config GTP_CUSTOM_CFG
	bool "GT9 custom config"
	default n
	help
	Say Y here if you have GT9 touch panel GTP_CUSTOM_CFG.

	If unsure, say N.

config GTP_HAVE_TOUCH_KEY
	bool "GT9 touch key enable"
	default n
	help
	Say Y here if you have GT9 touch panel GTP_HAVE_TOUCH_KEY.

	If unsure, say N.

config GTP_CHANGE_X2Y
	bool "GT9 X2Y"
	default n
	help
	Say Y here if you have GT9 touch panel GTP_CHANGE_X2Y.

	If unsure, say N.

config GTP_COMPATIBLE_MODE
	bool "GT9 flahless compatible"
	default n
	help
	Say Y here if you have GT9 touch panel GTP_COMPATIBLE_MODE.

	If unsure, say N.

config GTP_WARP_X_ON
	bool "GT9 swap x"
	default n
	help
	Say Y here if you have GT9 touch panel GTP_WARP_X_ON.

	If unsure, say N.

config GTP_WARP_Y_ON
	bool "GT9 swap y"
	default n
	help
	Say Y here if you have GT9 touch panel GTP_WARP_Y_ON.

	If unsure, say N.

config GTP_GESTURE_WAKEUP
	bool "GT9 gesture wakeup"
	default n
	help
	Say Y here if you have GT9 touch panel GTP_GESTURE_WAKEUP.

	If unsure, say N.

config GTP_HOTKNOT
	bool "GT9 hotknot"
	default n
	help
	Say Y here if you have GT9 touch panel GTP_HOTKNOT.

	If unsure, say N.

config HOTKNOT_BLOCK_RW
	bool "GT9 hotknot blocking rw"
	default n
	help
	Say Y here if you have GT9 touch panel HOTKNOT_BLOCK_RW.

	If unsure, say N.

config GTP_PROXIMITY
	bool "GT9 proximity"
	default n
	help
	Say Y here if you have GT9 touch panel GTP_PROXIMITY.

	If unsure, say N.

config GTP_WITH_PEN
	bool "GT9 pen enable"
	default n
	help
	Say Y here if you have GT9 touch panel GTP_WITH_PEN.

	If unsure, say N.

config GTP_AUTO_UPDATE
	bool "GT9 firmware auto update"
	default n
	help
	Say Y here if you have GT9 touch panel GTP_AUTO_UPDATE.

	If unsure, say N.

config GTP_AUTO_UPDATE_CFG
	bool "GT9 config data auto update"
	default n
	help
	Say Y here if you have GT9 touch panel GTP_AUTO_UPDATE_CFG.

	If unsure, say N.

config GTP_HEADER_FW_UPDATE
	bool "GT9 firmware in header file"
	default n
	help
	Say Y here if you have GT9 touch panel GTP_HEADER_FW_UPDATE.

	If unsure, say N.

config GTP_REQUEST_FW_UPDATE
	bool "GT9 firmware in request firmware"
	default n
	help
	Say Y here if you have GT9 touch panel GTP_REQUEST_FW_UPDATE.

	If unsure, say N.

config GTP_SUPPORT_I2C_DMA
	bool "GT9 support i2c dma"
	default n
	help
	Say Y here if you have GT9 touch panel GTP_SUPPORT_I2C_DMA.

	If unsure, say N.

config GTP_CREATE_WR_NODE
	bool "GT9 create debug node"
	default n
	help
	Say Y here if you have GT9 touch panel GTP_CREATE_WR_NODE.

	If unsure, say N.

config GTP_ESD_PROTECT
	bool "GT9 esd protection"
	default n
	help
	Say Y here if you have GT9 touch panel GTP_ESD_PROTECT.

	If unsure, say N.

config GTP_CHARGER_DETECT
	bool "GT9 charger detection"
	default n
	help
	Say Y here if you have GT9 touch panel GTP_CHARGER_DETECT.

	If unsure, say N.

config GTP_CHARGER_SWITCH
	bool "GT9 for Mediatek package"
	default n
	help
	Say Y here if you have GT9 touch panel GTP_CHARGER_SWITCH.

	If unsure, say N.

config GTP_DEBUG_ARRAY_ON
	bool "GT9 debug array"
	default n
	help
	Say Y here if you have GT9 touch panel GTP_DEBUG_ARRAY_ON.

	If unsure, say N.

config GTP_DEBUG_FUNC_ON
	bool "GT9 debug func on"
	default n
	help
	Say Y here if you have GT9 touch panel GTP_DEBUG_FUNC_ON.

	If unsure, say N.

config GTP_DEBUG_ON
	bool "GT9 debug on"
	default n
	help
	Say Y here if you have GT9 touch panel GTP_DEBUG_ON.

	If unsure, say N.

config GTP_POWER_CTRL_SLEEP
	bool "GT9 power down when sleeping"
	default n
	help
	Say Y here if you have GT9 touch panel GTP_POWER_CTRL_SLEEP.

	If unsure, say N.

endif
endmenu
```

## drivers/input/touchscreen/mediatek/msg28xx/Kconfig
```kconfig
#
# Touchscreen driver configuration
#
config TOUCHSCREEN_MTK_MSG28XX_TS
    bool "Mstar G28XX Ts for Mediatek"
    depends on I2C
    default n
    help
      Say Y here if you have Mstar touch panel.
      If unsure, say N.
      

config TOUCHSCREEN_MTK_MSG28XX_TS_TEST
    bool "Mstar G28XX Ts Self Test for Mediatek"
    depends on TOUCHSCREEN_MTK_MSG28XX_TS
    default y
    help
      Say Y here if you need to enable self test for Mstar touch panel.
      If unsure, say N.
```

## drivers/input/touchscreen/mediatek/msg2xxx/Kconfig
```kconfig
#
# Touchscreen driver configuration
#
config TOUCHSCREEN_MTK_MSTAR_TS
    bool "MSTAR Ts for Mediatek"
    depends on I2C
    default n
    help
      Say Y here if you have Focaltech touch panel.
      If unsure, say N.
    
```

## drivers/input/touchscreen/mediatek/nova_tddi/Kconfig
```kconfig
#
# Novatek NT36xxx touchscreen driver configuration
#
config TOUCHSCREEN_NOVA_TDDI
	tristate "Novatek TDDI touchscreen for Mediatek package"
	depends on SPI
	default n
	help
	  Say y here if you have novatek TDDI touch panel.

	  If unsure, say N.

	  To compile this driver as a module, choose M here: the
	  module will be called nova-tddi.
```

## drivers/input/touchscreen/mediatek/sx9301/Kconfig
```kconfig
#tuwenzan@wind-mobi.com add at 20161110 begin#
# Input misc drivers configuration
#
menuconfig INPUT_MISC
	bool "Miscellaneous devices"
	help
	  Say Y here, and a list of miscellaneous input drivers will be displayed.
	  Everything that didn't fit into the other categories is here. This option
	  doesn't affect the kernel.

	  If unsure, say Y.

if INPUT_MISC

config INPUT_SX9310
	tristate "SX9310_SAR_sensor"
	depends on I2C
	default n
	help 
	  Say Y to enable the SAR detection application, if N here not to use the 
	  this SAR sensor

endif
#tuwenzan@wind-mobi.com add at 20161110 end
```

## drivers/input/touchscreen/omnivision_tcm/Kconfig
```kconfig
#
# Omnivision TCM touchscreen driver configuration
#
menuconfig TOUCHSCREEN_OMNIVISION_TCM
	bool "Omnivision TCM touchscreen"
	default y
	help
	  Say Y here if you have a Omnivision TCM touchscreen connected
	  to your system.

	  If unsure, say N.

if TOUCHSCREEN_OMNIVISION_TCM

choice
	default TOUCHSCREEN_OMNIVISION_TCM_I2C
	prompt "Omnivision TCM bus module"
config TOUCHSCREEN_OMNIVISION_TCM_I2C
	bool "I2C"
	depends on I2C
config TOUCHSCREEN_OMNIVISION_TCM_SPI
	bool "SPI"
	depends on SPI_MASTER
endchoice

config TOUCHSCREEN_OMNIVISION_TCM_CORE
	tristate "Omnivision TCM core module"
	depends on I2C || SPI_MASTER
	help
	  Say Y here to enable core functionality.

	  If unsure, say N.

	  To compile this driver as a module, choose M here: the
	  module will be called omnivision_tcm_core.

config TOUCHSCREEN_OMNIVISION_TCM_TOUCH
	tristate "Omnivision TCM touch module"
	depends on TOUCHSCREEN_OMNIVISION_TCM_CORE
	help
	  Say Y here to enable support for touch reporting.

	  If unsure, say N.

	  To compile this driver as a module, choose M here: the
	  module will be called omnivision_tcm_touch.

config TOUCHSCREEN_OMNIVISION_TCM_DEVICE
	tristate "Omnivision TCM device module"
	depends on TOUCHSCREEN_OMNIVISION_TCM_CORE
	help
	  Say Y here to enable support for TCM device functionality.

	  If unsure, say N.

	  To compile this driver as a module, choose M here: the
	  module will be called omnivision_tcm_device.

config TOUCHSCREEN_OMNIVISION_TCM_TESTING
	tristate "Omnivision TCM testing module"
	depends on TOUCHSCREEN_OMNIVISION_TCM_CORE
	help
	  Say Y here to enable support for testing functionality.

	  If unsure, say N.

	  To compile this driver as a module, choose M here: the
	  module will be called omnivision_tcm_testing.

config TOUCHSCREEN_OMNIVISION_TCM_REFLASH
	tristate "Omnivision TCM reflash module"
	depends on TOUCHSCREEN_OMNIVISION_TCM_CORE
	help
	  Say Y here to enable support for reflash functionality.

	  If unsure, say N.

	  To compile this driver as a module, choose M here: the
	  module will be called omnivision_tcm_reflash.

config TOUCHSCREEN_OMNIVISION_TCM_RECOVERY
	tristate "Omnivision TCM recovery module"
	depends on TOUCHSCREEN_OMNIVISION_TCM_CORE
	help
	  Say Y here to enable support for recovery functionality.

	  If unsure, say N.

	  To compile this driver as a module, choose M here: the
	  module will be called omnivision_tcm_recovery.

config TOUCHSCREEN_OMNIVISION_TCM_ZEROFLASH
	tristate "Omnivision TCM zeroflash module"
	depends on TOUCHSCREEN_OMNIVISION_TCM_CORE
	help
	  Say Y here to enable support for ZeroFlash functionality.

	  If unsure, say N.

	  To compile this driver as a module, choose M here: the
	  module will be called omnivision_tcm_zeroflash.

config TOUCHSCREEN_OMNIVISION_TCM_DIAGNOSTICS
	tristate "Omnivision TCM diagnostics module"
	depends on TOUCHSCREEN_OMNIVISION_TCM_CORE
	help
	  Say Y here to enable support for diagnostics functionality.

	  If unsure, say N.

	  To compile this driver as a module, choose M here: the
	  module will be called omnivision_tcm_diagnostics.
endif
```
