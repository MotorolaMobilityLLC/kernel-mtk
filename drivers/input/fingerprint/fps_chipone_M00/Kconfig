## drivers/input/fingerprint/fps_chipone_M00/Kconfig
```kconfig
config MICROTRUST_FPSENSOR_M00
    tristate "Chipone Finger Print Driver"
    help
        Chipone Finger Print Supported
```

## drivers/input/fingerprint/fps_egis_M00/Kconfig
```kconfig
#
# fp_sensor driver configuration
#

config TRUSTONIC_EGIS_M00
    tristate "egis Finger Print Driver"
    help
        egis Finger Print Supported
```

## drivers/input/fingerprint/fps_fpc_M00/Kconfig
```kconfig
config MICROTRUST_FPC_M00
    tristate "FPC Finger Print Driver"
    help
        FPC Finger Print Supported
```

## drivers/input/fingerprint/fpsensor_tee/Kconfig
```kconfig
config MICROTRUST_FP_FPSENSOR
	tristate "Chipone Finger Print Driver"
   	help
		Chipone Finger Print Supported
```

## drivers/input/keyboard/mediatek/Kconfig
```kconfig
config KEYBOARD_MTK
	tristate "MediaTek Keypad Support"
	---help---
	  Say Y here if you want to use the keypad.
	  If unuse, say N.
	  To compile this driver as a module, choose M here: the
	  module will be called mtk-kpd.

config KEYBOARD_MTK_PLAT
	string "MediaTek Keypad rely on specific platform"
	depends on KEYBOARD_MTK
	---help---
	  choose which platform you used.
	  Every chip has its own key matrix.
	  So should implement driver rely on specific paltform and
	  get registor map from ic designer
```

## drivers/input/touchscreen/mediatek/FT3519/Kconfig
```kconfig
#
# Focaltech Touchscreen driver configuration
#

config TOUCHSCREEN_FT3519
    bool "Focaltech Touchscreen"
    default n
    help
      Say Y here if you have Focaltech touch panel.
      If unsure, say N.

config TOUCHSCREEN_FT3519_DIRECTORY
    string "Focaltech ts directory name"
    default "FT3519"
    depends on TOUCHSCREEN_FT3519
```

## drivers/input/touchscreen/mediatek/FT5X26/Kconfig
```kconfig
#
# Touchscreen driver configuration
#
if TOUCHSCREEN_FT5X26

config FT5X0X_FIRMWARE
	string "FT5X0X for Mediatek firmware"

config TPD_ROTATE_90
	bool "ft5x0x for Mediatek package"
	help
	  Say Y here if you have ft5x0x touch panel TPD_ROTATE_90.
	  If unsure, say N.

config TPD_ROTATE_180
	bool "ft5x0x for Mediatek package"
	help
	  Say Y here if you have ft5x0x touch panel TPD_ROTATE_180.
	  If unsure, say N.

config TPD_ROTATE_270
	bool "ft5x0x for Mediatek package"
	help
	  Say Y here if you have ft5x0x touch panel TPD_ROTATE_270.
	  If unsure, say N.

config FT_AUTO_UPGRADE_SUPPORT
	bool "ft5x0x for Mediatek package"
	default y
	help
	  Say Y here if you have ft5x0x touch panel FT_AUTO_UPGRADE_SUPPORT.
	  If unsure, say N.

config CUST_FTS_APK_DEBUG
	bool "ft5x0x for Mediatek package"
	default y
	help
	  Say Y here if you have ft5x0x touch panel CUST_FTS_APK_DEBUG.
	  If unsure, say N.

config TPD_HAVE_CALIBRATION
	bool "ft5x0x for Mediatek package"
	help
	  Say Y here if you have ft5x0x touch panel TPD_HAVE_CALIBRATION.
	  If unsure, say N.

config TPD_CUSTOM_CALIBRATION
	bool "ft5x0x for Mediatek package"
	help
	  Say Y here if you have ft5x0x touch panel TPD_CUSTOM_CALIBRATION.
	  If unsure, say N.
endif
```

## drivers/input/touchscreen/mediatek/Kconfig
```kconfig
#
# Touchscreen driver configuration
#
menuconfig INPUT_TOUCHSCREEN
	bool "Touchscreens"
	help
	  Say Y here, and a list of supported touchscreens will be displayed.
	  This option doesn't affect the kernel.

	  If unsure, say Y.

if INPUT_TOUCHSCREEN

config TOUCHSCREEN_MTK
	bool "MediaTek Touch Panel Driver"
	help
	  Say Y here if you have MediaTek touch panel.

	  If unsure, say N.

	  To compile this dirver as a module, choose M here: the
	  module will be called.

config TOUCHSCREEN_MTK_ILITEK_V3_ILI7806S
	bool "ILITEK_V3_ILI7806S for Mediatek package"
	default n
	help
	  Say Y here if you have ilitek_touch touch panel.

          If unsure, say N.
	  To compile this dirver as a module, choose M here: the
	  module will be called.

source "drivers/input/touchscreen/mediatek/ilitek_v3/Kconfig"

config TOUCHSCREEN_MTK_NVT_NT36xxx
	bool "Novatek NT36xxx host download SPI driver"
	default n
	help
	  Say Y here if you have a Novatek NT36xxx no flash touchscreen connected
	  to your system by SPI bus.

	  If unsure, say N.

source "drivers/input/touchscreen/mediatek/NT36xxx/Kconfig"

config TOUCHSCREEN_MTK_TP_SEQ_PRE
	bool "TP seq config"
	default n
	help
          Say Y here if you need set tp seq ahead of LCD

          If unsure, say N.

endif
```

## drivers/input/touchscreen/mediatek/MSG2256/Kconfig
```kconfig
#
# Touchscreen driver configuration
#
if TOUCHSCREEN_MTK_MSG2256

config MSG2838_FIRMWARE
	string "MSG2838 for Mediatek firmware"

config TPD_ROTATE_90
	bool "msg2838 for Mediatek package"
	default n
	help
	Say Y here if you have msg2838 touch panel TPD_ROTATE_90.

	If unsure, say N.

	To compile this dirver as a module, choose M here: the
	module will be called.

config TPD_ROTATE_180
	bool "msg2838 for Mediatek package"
	default n
	help
	Say Y here if you have msg2838 touch panel TPD_ROTATE_180.

	If unsure, say N.

	To compile this dirver as a module, choose M here: the
	module will be called.

config TPD_ROTATE_270
	bool "msg2838 for Mediatek package"
	default n
	help
	Say Y here if you have msg2838 touch panel TPD_ROTATE_270.

	If unsure, say N.

	To compile this dirver as a module, choose M here: the
	module will be called.

config FT_AUTO_UPGRADE_SUPPORT
	bool "msg2838 for Mediatek package"
	default y
	help
	Say Y here if you have msg2838 touch panel FT_AUTO_UPGRADE_SUPPORT.

	If unsure, say N.

	To compile this dirver as a module, choose M here: the
	module will be called.

config CUST_FTS_APK_DEBUG
	bool "msg2838 for Mediatek package"
	default y
	help
	Say Y here if you have msg2838 touch panel CUST_FTS_APK_DEBUG.

	If unsure, say N.

	To compile this dirver as a module, choose M here: the
	module will be called.

config TPD_HAVE_CALIBRATION
	bool "msg2838 for Mediatek package"
	default n
	help
	Say Y here if you have msg2838 touch panel TPD_HAVE_CALIBRATION.

	If unsure, say N.

	To compile this dirver as a module, choose M here: the
	module will be called.

config TPD_CUSTOM_CALIBRATION
	bool "msg2838 for Mediatek package"
	default n
	help
	Say Y here if you have msg2838 touch panel TPD_CUSTOM_CALIBRATION.

	If unsure, say N.

	To compile this dirver as a module, choose M here: the
	module will be called.
endif
```

## drivers/input/touchscreen/mediatek/chipone_tddi_v131/Kconfig
```kconfig
config TOUCHSCREEN_CHIPONE_V131
	tristate "Chipone TDDI touchscreen for Mediatek package"
	default n
	help
	  Say y here if you have chipone TDDI touch panel.

	  If unsure, say N.

	  To compile this driver as a module, choose M here: the
	  module will be called chipone-tddi.

config CTS_I2C_HOST
       tristate "Chipone TDDI I2C or SPI touchscreen for Mediatek package"
       depends on I2C
       default n
       help 
         Say y here, use I2C, or use SPI
```

## drivers/input/touchscreen/mediatek/chipone_v2_tddi/Kconfig
```kconfig
config TOUCHSCREEN_CHIPONE_V2_TDDI
	tristate "Chipone TDDI touchscreen for Mediatek package"
	default n
	help
	  Say y here if you have chipone TDDI touch panel.

	  If unsure, say N.

	  To compile this driver as a module, choose M here: the
	  module will be called chipone-tddi.
```

## drivers/input/touchscreen/mediatek/focaltech_touch/Kconfig
```kconfig
#
# Focaltech Touchscreen driver configuration
#

config TOUCHSCREEN_FTS
    bool "Focaltech Touchscreen"
    default n
    help
      Say Y here if you have Focaltech touch panel.
      If unsure, say N.

config TOUCHSCREEN_FTS_DIRECTORY
    string "Focaltech ts directory name"
    default "focaltech_touch"
    depends on TOUCHSCREEN_FTS

config FTS_AUTO_LIC_UPGRADE_EN
      default n
      bool "FTS"
      depends on TOUCHSCREEN_FTS
    
```

## drivers/input/touchscreen/mediatek/gt9xxtb_hn_new/Kconfig
```kconfig
#
# Touchscreen driver configuration
#
menu "GT9 Touchscreen Config"
	depends on TOUCHSCREEN_MTK_GT9XXTB_HN_NEW

#if TOUCHSCREEN_MTK_GT9XXTB_HN_NEW

config GTP_FIRMWARE
	string "GT9 firmawre group"

config GTP_CONFIG
	string "GT9 config data group"

config GTP_DRIVER_SEND_CFG
	bool "GT9 driver update config data"
	default y
	help
	Driver will send configuration data to touch IC.
	Say Y here if you need to update config data when touch startup.
	Say N if not need to update and use default config in touch IC.
	If unsure, say N.

config GTP_CUSTOM_CFG
	bool "GT9 resoluton customized"
	default n
	help
	Touch resolution and trigger mode will be customized,
	relative data in config data array will be replaced with
	customized data  before send to touch IC.
	Say Y here if you want to customized touch resolution and trigger mode.
	If unsure, say N.

config GTP_HAVE_TOUCH_KEY
	bool "GT9 touch key enable"
	default n
	help
	Touch panel may have a key area at the bottom side.
	It works just like keys in key area.
	Say Y here if your touch panel have key area and you want to use it.
	If unsure, say N.

config GTP_WITH_HOVER
	bool "GT9 hover enable"
	default n
	help
	This config is for enable HOVER function of touch.
	Say Y here if your touch have HOVER function and you want to enable it.
	Otherwise, please say N.
	If unsure, say N.

config GTP_CHANGE_X2Y
	bool "GT9 exchange X Y coordinate data"
	default n
	help
	Touch IC can exchange X and Y coordinate data in touch register.
	Say Y here if you need to exchange X coordinate data to Y.
	Otherwise, please say N.
	If unsure, say N.

config GTP_COMPATIBLE_MODE
	bool "GT9 flahless compatible"
	default n
	help
	Driver will compatible with flashless and flashed touch IC.
	You can use one driver for both 2 types touch IC.
	Say Y here if your driver need to compatible with both 2 types touch IC.
	If unsure, say N.

config GTP_WARP_X_ON
	bool "GT9 X coordinate turnaround"
	default n
	help
	Coordinate data of X axis will be turnarounded.
	X_max would be X_min after turnarounded.
	Say Y here if you need X cooridinate data turnaround.
	If unsure, say N.

config GTP_WARP_Y_ON
	bool "GT9 Y coordinate turnaround"
	default n
	help
        Coordinate data of y axis will be turnarounded.
        Y_max would be Y_min after turnarounded.
        Say Y here if you need Y cooridinate data turnaround.
        If unsure, say N.

config GTP_GESTURE_WAKEUP
	bool "GT9 gesture wakeup function"
	default n
	help
	This config is to enable touch gesture wakeup function.
	If your touch IC support gesture wakeup and after enable this config,
	You can wakeup your set by special gesture on touch.
	Say Y here if you want to enable gesture wakeup function.
	If unsure, say N.

config GTP_HOTKNOT
	bool "GT9 hotknot function"
	default n
	help
	For enabeling hotknot function
	You can transfer photo between 2 sets by making them face to face.
	Need touch IC support hotknot function.
	Say Y here if you want to enable hotknot function.
	If unsure, say N.

config GTP_HOTKNOT_AUTH_FW
	string "GT9 hotknot authentication FW path"

config GTP_HOTKNOT_TRANS_FW
	string "GT9 hotknot translation FW path"

config HOTKNOT_BLOCK_RW
	bool "GT9 hotknot blocking read write"
	default n
	help
	Hotknot blocking read/write function.
	Say Y here if you want to enable this funciton.
	Otherwise, sy N.
	If unsure, say N.

config GTP_PROXIMITY
	bool "GT9 proximity"
	default n
	help
	Touch can detect event of near to and far from.
	Like proximity sensor.
	Say Y here if you need to enable proximity function of touch.
	If unsure, say N.

config GTP_AUTO_UPDATE
	bool "GT9 firmware auto update"
	default y
	help
	Driver will check firmware you provide is match with IC or not.
	And check the FW is newer than current FW in IC or not.
	Then it decide need to update touch IC FW or not.
	Say Y here if you need driver auto check and update FW to tp IC.
	If unsure, say N.

config GTP_SUPPORT_I2C_DMA
	bool "GT9 i2c access with dma mode"
	default n
	help
	This config is for enable or disable DMA mode for i2c read/write.
	Say Y here if you need I2C access with DMA mode.
	Say N if you want to do I2C access with FIFO mode.
	If unsure, say N.

config GTP_CREATE_WR_NODE
	bool "GT9 create debug node"
	default y
	help
	This config is for creating a debug node.
	Then you can debug your driver in user space.
	Say Y here if you need to create a debug node for your driver.
	If unsure, say N.

config GTP_ESD_PROTECT
	bool "GT9 esd protection"
	default n
	help
	When ESD protection enabled, driver will monitor touch status regularly.
	Touch will be reseted if abnormal happened.
	Say Y here if you want to enable touch ESD proction function.
	If unsure, say N.

config GTP_CHARGER_DETECT
	bool "GT9 charger detection"
	default n
	help
	This is for touch driver detecting your set is charging or not.
	Say Y here if you want to enable touch charger detect function.
	Otherwise, please say N.
	If unsure, say N.

config GTP_DEBUG_ARRAY_ON
	bool "GT9 debug array"
	default n
	help
	This config is to enable output array data with log.
	Say Y here if you need debug information with array data to log.
	Otherwise, please say N.
	If unsure, say N.

config GTP_DEBUG_FUNC_ON
	bool "GT9 debug log"
	default n
	help
	This is to enable output function information log.
	Say Y here if you need to check driver function flow with log.
	Otherwise, please say N.
	If unsure, say N.

config GTP_DEBUG_ON
	bool "GT9 debug on"
	default n
	help
	This is to enable driver debug log output function.
	Say Y here if you need to check debug information in log.
	Otherwise, please say N.
	If unsure, say N.

config GTP_POWER_CTRL_SLEEP
	bool "GT9 power down when sleeping"
	default n
	help
	This is for touch power control in suspend mode.
	When this config enable, touch will power off shen set is suspended.
	Say Y here if you want to power off to save power in suspend mode.
	If touch is flashless, recommend to say N here.
	If unsure, say N.

config GTP_POWER_SOURCE_3300
	bool "touch power 3.3V"
	default n
	help
	Touch power is 2.8V or 3.3V.
	Say Y here if your touch power is 3300mV.
	Say N here is use 2.8V power for touch.
	If unsure, say N.
#endif
endmenu
```

## drivers/input/touchscreen/mediatek/ili9881h_bj/Kconfig
```kconfig
config TOUCHSCREEN_ILI9881H
    bool "ilitek Touchscreen"
    default n
    help
      Say Y here if you have ilitek touch panel.
      If unsure, say N.
      
config TOUCHSCREEN_ILI9881H_DEBUG
    bool "ilitek touch is or not debug "
    default n
    depends on TOUCHSCREEN_ILI9881H
```

## drivers/input/touchscreen/mediatek/ili9881h_spi/Kconfig
```kconfig
config TOUCHSCREEN_ILI9881H
    bool "ilitek Touchscreen"
    default n
    help
      Say Y here if you have ilitek touch panel.
      If unsure, say N.
```

## drivers/input/touchscreen/mediatek/ili9881x/Kconfig
```kconfig
config TOUCHSCREEN_ILI988X
    bool "ilitek Touchscreen"
    default n
    help
      Say Y here if you have ilitek touch panel.
      If unsure, say N.
      
config TOUCHSCREEN_ILI988X_DEBUG
    bool "ilitek touch is or not debug "
    default n
    depends on TOUCHSCREEN_ILI988X
```

## drivers/input/touchscreen/mediatek/ilitek/Kconfig
```kconfig
config TOUCHSCREEN_ILITEK_S00
    tristate "generic touchscreen ilitek driver"
    help
    add support for touchscreen driver.

config TOUCHSCREEN_ILITEK_MODEL
    string "ilitek model, kernel defconfig"
    help
    ilitek model, kernel defconfig
```

## drivers/input/touchscreen/mediatek/ilitek_v3/Kconfig
```kconfig
#
# ILITEK Touchscreen driver configuration
#

config TOUCHSCREEN_MTK_ILITEK_V3_ILI7806S
    bool "ILITEK Touchscreen"
    depends on spi
    default n
    help
      Say Y here if you have ILITEK touch panel.
      If unsure, say N.
```
