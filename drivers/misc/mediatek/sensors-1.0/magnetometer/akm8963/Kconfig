## drivers/misc/mediatek/sensors-1.0/magnetometer/akm8963/Kconfig
```kconfig
config MTK_AKM8963
	tristate "AKM08963 for MediaTek package"
	default n
	help
	  It support different magnetometer sensor.
	  If this option is set, it will support
	  AKMD08963 magnetometer which is a 3-axis electronic
	  compass IC with high sensitive Hall sensor technology.
```

## drivers/misc/mediatek/sensors-1.0/magnetometer/mmc3630/Kconfig
```kconfig
config MTK_MMC3630X
	bool "mmc3630x for MediaTek package"
	help
	  This configuration is for enable or disable mmc3630 magnetic sensor.
	  Say Y here if you want to support this sensor.
	  Say N if you not support it.
	  If no sure, say N.
```

## drivers/misc/mediatek/sensors-1.0/magnetometer/mmc3680kj/Kconfig
```kconfig
config MTK_MMC3680X
	bool "mmc3680x for MediaTek package"
	default n
	help
	  It support different magnetometer sensor.
		  If this option is set,
	  It will support
		  MMC3680X magnetometer.
```

## drivers/misc/mediatek/sensors-1.0/magnetometer/mmc5603/Kconfig
```kconfig
config MTK_MMC5603
	bool "mmc3630x for MediaTek package"
	default n
	help
	  This configuration is for enable or disable mmc5603 magnetic sensor.
	  Say Y here if you want to support this sensor.
	  Say N if you not support it.
	  If no sure, say N.
```

## drivers/misc/mediatek/sensors-1.0/magnetometer/st480/Kconfig
```kconfig
config MTK_ST480
	bool "ST480 magnetometer for MediaTek package"
	default n
	help
	  This configuration is for enable or disable ST480 magnetometer sensor support.
		Say Y here if you want to support this sensor.
		Say N if you not support it.
		If no sure, say N.
```

## drivers/misc/mediatek/sensors-1.0/sar/Kconfig
```kconfig
config SAR
	bool "MTK AUTO DETECT SAR Sensor"
	help
	to support different sar sensor.
config ABOV_SAR
	bool "MTK AUTO DETECT SAR Sensor"
	help
	  to support abov sar sensor.
config ABOV_A96T346
	bool "MTK AUTO DETECT SAR Sensor"
	help
	  to support abov a96t346 sar sensor.
```

## drivers/misc/mediatek/sensors-1.0/situation/Kconfig
```kconfig
config CUSTOM_KERNEL_SITUATION
	bool "mediatek situation sensor tag"
	help
	  Kernel space support situation sensor driver.
	  If the platform is supported for gesture, this
	  configuration should be configured, and the situation
	  driver configuration should be configured as well.

config MOTO_ALGO_PARAMS
	bool "algo params for moto sensor algo"
	default n
	help
	  This feature Option is used for open/close moto sensor algo parms.
config MOTO_ALSPS
        bool "alsps for moto package"
        default n
        help
          Put the device lie on the table.

config MOTO_HUB
	bool "moto hub for moto gesture"
	default n
	help
	This config is only for kernel-5.10 + sensorhub-1.0 + GKI-1.0

source "drivers/misc/mediatek/sensors-1.0/situation/situation_hub/Kconfig"
source "drivers/misc/mediatek/sensors-1.0/situation/mot/Kconfig"
```

## drivers/misc/mediatek/sensors-1.0/situation/aw9610x/Kconfig
```kconfig
#
# Mediatek AW9610X Driver
#

config AW9610X_SAR
	tristate "Awinic AW9610X_Sar driver"
	depends on I2C
	help
	  Say Y here if you have Awinic AW9610X_Sar controller
	  chip in your system.
	  If unsure, say N.
	  To compile this driver as a module, choose M here: the
	  module will be called AW9610X_Sar key.
```

## drivers/misc/mediatek/sensors-1.0/situation/chop_chop/Kconfig
```kconfig
config MTK_CHOPCHOP_HUB
	bool "CHOPCHOP for MediaTek package"
	help
	  CHOPCHOP is a device,
	  usually portable and electronic
	  or electromechanical,
	  that detect device is chopped twice.
```

## drivers/misc/mediatek/sensors-1.0/situation/chopchop_detector/Kconfig
```kconfig
config MTK_CHOPDETECTHUB
	bool "chopdetecthub for MediaTek package"
	help
	  A tilt detect is a device,
	  usually portable and electronic
	  or electromechanical,
	  that detect device is picked up with 35 degree.
```

## drivers/misc/mediatek/sensors-1.0/situation/chopchop_gesture/Kconfig
```kconfig
config ONTIM_CHOPCHOPHUB
	bool "chopchophub for Ontim package"
	default y
	help
	  A chopchop gesture is a device,
	  usually portable and electronic
	  or electromechanical,
	  that detect device is chop-chop-ed.
```

## drivers/misc/mediatek/sensors-1.0/situation/flip_twist/Kconfig
```kconfig
config MTK_FLIPTWIST_HUB
	bool "FLIPWIST for MediaTek package"
	help
	  FLIPWIST is a device,
	  usually portable and electronic
	  or electromechanical,
	  that detect device is flipped twice.
```

## drivers/misc/mediatek/sensors-1.0/situation/mot/Kconfig
```kconfig
config MOTO_ALGO
	bool "algo for moto package"
	default n
	help
	  A stationary is a device, usually portable
	  and electronic or electromechanical, that detect device is kept static.


source "drivers/misc/mediatek/sensors-1.0/situation/mot/moto_flatup/Kconfig"
source "drivers/misc/mediatek/sensors-1.0/situation/mot/moto_flatdown/Kconfig"
source "drivers/misc/mediatek/sensors-1.0/situation/mot/moto_stowed/Kconfig"
source "drivers/misc/mediatek/sensors-1.0/situation/mot/moto_camgest/Kconfig"
source "drivers/misc/mediatek/sensors-1.0/situation/mot/moto_chopchop/Kconfig"
source "drivers/misc/mediatek/sensors-1.0/situation/mot/moto_glance/Kconfig"
source "drivers/misc/mediatek/sensors-1.0/situation/mot/moto_ltv/Kconfig"
source "drivers/misc/mediatek/sensors-1.0/situation/mot/moto_ftm/Kconfig"
source "drivers/misc/mediatek/sensors-1.0/situation/mot/moto_offbody/Kconfig"
source "drivers/misc/mediatek/sensors-1.0/situation/mot/moto_lts/Kconfig"
```

## drivers/misc/mediatek/sensors-1.0/situation/mot/moto_camgest/Kconfig
```kconfig
config MOTO_CAMGEST
	bool "camgest for moto package"
	default n
	help
	  Put the device lie on the table.
```

## drivers/misc/mediatek/sensors-1.0/situation/mot/moto_flatup/Kconfig
```kconfig
config MOTO_FLATUP
	bool "flatup for moto package"
	default n
	help
	  Put the device lie on the table.
```

## drivers/misc/mediatek/sensors-1.0/situation/mot/moto_ftm/Kconfig
```kconfig
config MOTO_FTM
	bool "ftm for moto package"
	default n
	help
	  Put the device lie on the table.
```

## drivers/misc/mediatek/sensors-1.0/situation/mot/moto_glance/Kconfig
```kconfig
config MOTO_GLANCE
	bool "glance for moto package"
	default n
	help
	  Put the device lie on the table.
```

## drivers/misc/mediatek/sensors-1.0/situation/mot/moto_ltv/Kconfig
```kconfig
config MOTO_LTV
	bool "ltv for moto package"
	default n
	help
	  Put the device lie on the table.
```

## drivers/misc/mediatek/sensors-1.0/situation/mot/moto_offbody/Kconfig
```kconfig
config MOTO_OFFBODY
	bool "off body for moto package"
	default n
	help
	  Put the device lie on the table.
```

## drivers/misc/mediatek/sensors-1.0/situation/mot/moto_stowed/Kconfig
```kconfig
config MOTO_STOWED
	bool "stowed for moto package"
	default n
	help
	  Put the device lie on the table.
```

## drivers/misc/mediatek/sensors-1.0/situation/sig_move/Kconfig
```kconfig
config MTK_SIGMOVE_HUB
	bool "SIGMOVE for MediaTek package"
	help
	  SIGMOVE is a device,
	  usually portable and electronic
	  or electromechanical,
	  that detect device triggers significant move.
```

## drivers/misc/mediatek/sensors-1.0/situation/significant_move/Kconfig
```kconfig
config MTK_SIGNIFICANT_MOVE
	bool "significant move hub for MediaTek package"
	help
	  A tilt detect is a device,
	  usually portable and electronic
	  or electromechanical,
	  that detect device is picked up with 35 degree.
```

## drivers/misc/mediatek/sensors-1.0/situation/situation_hub/Kconfig
```kconfig
source "drivers/misc/mediatek/sensors-1.0/situation/situation_hub/stationary/Kconfig"
source "drivers/misc/mediatek/sensors-1.0/situation/situation_hub/inpocket/Kconfig"
source "drivers/misc/mediatek/sensors-1.0/situation/situation_hub/wake_gesture/Kconfig"
source "drivers/misc/mediatek/sensors-1.0/situation/situation_hub/glance_gesture/Kconfig"
source "drivers/misc/mediatek/sensors-1.0/situation/situation_hub/answercall/Kconfig"
source "drivers/misc/mediatek/sensors-1.0/situation/situation_hub/pickup_gesture/Kconfig"
source "drivers/misc/mediatek/sensors-1.0/situation/situation_hub/device_orientation/Kconfig"
source "drivers/misc/mediatek/sensors-1.0/situation/situation_hub/motion_detect/Kconfig"
source "drivers/misc/mediatek/sensors-1.0/situation/situation_hub/tilt_detector/Kconfig"
source "drivers/misc/mediatek/sensors-1.0/situation/situation_hub/flat/Kconfig"
source "drivers/misc/mediatek/sensors-1.0/situation/situation_hub/sar/Kconfig"

# moto add
source "drivers/misc/mediatek/sensors-1.0/situation/situation_hub/mot_hub/moto_chopchop/Kconfig"
source "drivers/misc/mediatek/sensors-1.0/situation/situation_hub/mot_hub/moto_camgest/Kconfig"
source "drivers/misc/mediatek/sensors-1.0/situation/situation_hub/mot_hub/moto_flatdown/Kconfig"
source "drivers/misc/mediatek/sensors-1.0/situation/situation_hub/mot_hub/moto_flatup/Kconfig"
source "drivers/misc/mediatek/sensors-1.0/situation/situation_hub/mot_hub/moto_ftm/Kconfig"
source "drivers/misc/mediatek/sensors-1.0/situation/situation_hub/mot_hub/moto_glance/Kconfig"
source "drivers/misc/mediatek/sensors-1.0/situation/situation_hub/mot_hub/moto_lts/Kconfig"
source "drivers/misc/mediatek/sensors-1.0/situation/situation_hub/mot_hub/moto_ltv/Kconfig"
source "drivers/misc/mediatek/sensors-1.0/situation/situation_hub/mot_hub/moto_offbody/Kconfig"
source "drivers/misc/mediatek/sensors-1.0/situation/situation_hub/mot_hub/moto_stowed/Kconfig"
```

## drivers/misc/mediatek/sensors-1.0/situation/situation_hub/mot_hub/moto_chopchop/Kconfig
```kconfig
config MOTO_CHOPCHOP
	bool "chopchop for moto package"
	default n
	help
	  Put the device lie on the table.
```

## drivers/misc/mediatek/sensors-1.0/situation/situation_hub/mot_hub/moto_flatdown/Kconfig
```kconfig
config MOTO_FLATDOWN
	bool "flatdown for moto package"
	default n
	help
	  Put the device lie on the table.
```
