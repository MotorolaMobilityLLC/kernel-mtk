## drivers/misc/mediatek/sensors-1.0/situation/situation_hub/mot_hub/moto_lts/Kconfig
```kconfig
config MOTO_LTS
	bool "lts for moto package"
	default n
	help
	  Put the device lie on the table.
```

## drivers/misc/mediatek/sensors-1.0/situation/sx932x/Kconfig
```kconfig
config MTK_SX932x
	bool "sx932x for MediaTek package"
	default n
	help
	  A sar is a device,
	  usually portable and electronic
	  or electromechanical,
	  that detect distance between the body and device .
```

## drivers/misc/mediatek/sensors-1.0/situation/twist_twice_gesture/Kconfig
```kconfig
config ONTIM_TWIST_TWICEHUB
	bool "twist_twicehub for Ontim package"
	default n
	help
		A twist_twice gesture is a device,
		usually portable and electronic
		or electromechanical,
		that detect device is twist twice.
```

## drivers/misc/mediatek/sim_check/Kconfig
```kconfig
config LCT_SIM_CHECK
	tristate "Longcheer sim check driver"
	---help---
	  sim check driver support for MediaTek SOC
	  If you want to use Longcheer Sim check driver,
	  say Y or M here.
	  If unsure, say N.
```

## drivers/misc/mediatek/smi/Kconfig
```kconfig
config MTK_SMI_EXT
	bool "SMI Driver"
	default n
	help
	  SMI Driver is used to arbitrate memory bandwidth of multimedia,
	  it can optimize multimedia memory usage in different scenarios.
	  This driver should always enable, if you have any question about this driver,
	  please contact driver owner for further help.

config MTK_SMI_VARIANT
	bool "MTK SMI Tablet Code"
	select MTK_SMI_EXT
	help
	   It's for smi common tablet framework. And it will enable power-domain.
```

## drivers/misc/mediatek/sspm/Kconfig
```kconfig
config MTK_TINYSYS_SSPM_SUPPORT
	bool "Specifiy If Support SSPM"
	default n
	help
	  SSPM is a MediaTek in-house hardware for power management under secure world.
	  Set y to enable this feature.
	  Set n to stay with legancy feature.

config MTK_TINYSYS_SSPM_PLT_SUPPORT
	bool "Specifiy If of SSPM on Platform"
	default n
	help
	  SSPM is a MediaTek in-house hardware for power management based on platform.
	  Set y to enable this feature for specific platform.
	  Set n to stay with legancy feature.
```

## drivers/misc/mediatek/step_counter/Kconfig
```kconfig
config CUSTOM_KERNEL_STEP_COUNTER
	bool "CUSTOM_KERNEL_STEP_COUNTER"
	help
	  A pedometer is a device, usually portable and electronic or electromechanical, that counts each step a person takes by detecting the motion of the person's hands or hips.

config CUSTOM_KERNEL_STEP_DETECTOR
	bool "CUSTOM_KERNEL_STEP_DETECTOR"
	help
	  A step detector is a device, usually portable and electronic or electromechanical, that detect each step a person takes by detecting the motion of the person's hands or hips.

config CUSTOM_KERNEL_SIGNIFICANT_MOTION
	bool "CUSTOM_KERNEL_SIGNIFICANT_MOTION"
	help
	  Kernel space sigificant motion sensor driver.
source "drivers/misc/mediatek/step_counter/stepsignhub/Kconfig"
```

## drivers/misc/mediatek/step_counter/icm206xx_sc/Kconfig
```kconfig
config MTK_ICM206XX_SC
	bool "ICM206XX for MediaTek package"
	default n
	help
	It support different step_counter sensor.
	If this option is set,
	it will support
	ICM206XX step_counter.
```

## drivers/misc/mediatek/step_counter/stepsignhub/Kconfig
```kconfig
config MTK_SMDHUB
	bool "SMDhub for MediaTek package"
	default n
	help
	  A significant motions is a device, usually portable and electronic or electromechanical, that detect each step a person takes by detecting the motion of the person's hands or hips.
config MTK_STEP_CHUB
	bool "SMDhub for MediaTek package"
	default n
	help
      A pedometer is a device, usually portable and electronic or electromechanical, that counts each step a person takes by detecting the motion of the person's hands or hips.
config MTK_STEP_DHUB
	bool "SMDhub for MediaTek package"
	default n
	help
	  A step detector is a device, usually portable and electronic or electromechanical, that detect each step a person takes by detecting the motion of the person's hands or hips.
```

## drivers/misc/mediatek/teei/Kconfig
```kconfig
# Copyright (c) 2015-2016 MICROTRUST Incorporated
# All Rights Reserved.
#
# This program is free software; you can redistribute it and/or
# modify it under the terms of the GNU General Public License
# version 2 as published by the Free Software Foundation.
#
# This program is distributed in the hope that it will be useful,
# but WITHOUT ANY WARRANTY; without even the implied warranty of
# MERCHANTABILITY or FITNESS FOR A PARTICULAR PURPOSE. See the
# GNU General Public License for more details.

config MICROTRUST_TEE_SUPPORT
	bool "Enable Microtrust TEEI Support"
	default n
	---help---
	Enables the support of Microtrust TEE drivers.
	All Microtrust related TEE drivers will depend on this option.
	Say Y if you would like to enable this feature.
	If unsure, say N.

config MICROTRUST_TZ_DRIVER
	tristate "Microtrust TEEI Driver"
	depends on MICROTRUST_TEE_SUPPORT
	default y
	---help---
	Enables the support of Microtrust trustzone linux driver.
	This driver in charge of all initial process, creating
	communication channels and connections with secure world.
	Say Y if you would like to enable the driver.
	If unsure, say N.

config MICROTRUST_VFS_DRIVER
	tristate "Microtrust Virtual File System Driver"
	depends on MICROTRUST_TEE_SUPPORT
	default y
	---help---
	Enables the support of Microtrust virtual file system driver.
	This driver is the proxy of secure world for linux virtual
	file system access. E.g., access for file system or RPMB.
	Say Y if you would like to enable the driver.
	If unsure, say N.

config MICROTRUST_FP_DRIVER
	tristate "Microtrust Fingerprint Driver"
	depends	on MICROTRUST_TEE_SUPPORT
	default y
	---help---
	Enables support of Microtrust fingerprint helper driver.
	This driver provides IOCTL interface for fingerprint HAL or
	driver to communicate with fingerpirnt trusted application.
	Say Y if you would like to enable the helper driver.
	If unsure, say N.

config MICROTRUST_KEYMASTER_DRIVER
	tristate "Microtrust keymaster Driver"
	depends on MICROTRUST_TEE_SUPPORT
	default y
	---help---
	Enables support of Microtrust keymaster helper driver.
	This driver provides IOCTL interface for keymaster HAL
	to communicate with keymaster trusted application.
	Say Y if you would like to enable the helper driver.
	If unsure, say N.

config MICROTRUST_DEBUG
	bool "Enable Microtrust Debug Message"
	depends on MICROTRUST_TEE_SUPPORT
	default n
	---help---
	Enable debug messages output from Microtrust Linux drivers.
	More debug information will be directed to console.
	Say Y if you would like to enable more debug outputs.
	If unsure, say N.
```

## drivers/misc/mediatek/thermal/Kconfig
```kconfig
config MTK_LEGACY_THERMAL
	bool "Use MTK legacy thermal code"
	help
	  Upstream thermal code and legacy thermal
	  code are not compatiable. As a result,
	  add a new switch MTK_LEGACY_THERMAL to replace
	  CONFIG_THERMAL for MTK legacy thermal code.

config MTK_THERMAL_PA_VIA_ATCMD
	bool "Thermal switch for query modem RF temp"
	depends on MTK_LEGACY_THERMAL
	help
	  Internal switch for thermal management
	  to query modem RF temperature
	  via AT command.
	  (RIL sockets)

config MTK_LEGACY_THERMAL_PLATFORM
	string "MTK legacy thermal platform name"
	depends on MTK_LEGACY_THERMAL
	help
	  To separate platform codes for legacy thermal
	  drivers. Config platform name for your
	  selection. It's used for legacy thermal
	  drivers only.

config USE_MT6360_TS_PIN
	bool "USE MT6360 TS PIN"
	default n
	help
	  This feature option is used to enable/disable
          the MT6360 TS detection temperature.

config TYPEC_GPIO_OUT_TOGGLE
	bool "Enable usb therm gpio toggle"
	default n
	help
	  This feature option is used to enable/disable
          mosfet control in usb therm gpio.

config GENEVA_THERMAL_NTC
	bool "Genva thermal ntc"
	help
	  Enable the geneva thermal ntc

config THERMAL_CP_SUPPORT
      bool "Thermal charge pump support"
      help
         3rd charge pump thermal limit charge current
```

## drivers/misc/mediatek/tilt_detector_sensor/Kconfig
```kconfig
config CUSTOM_KERNEL_TILT_DETECTOR_SENSOR
	bool "CUSTOM_KERNEL_TILT_DETECTOR_SENSOR"
	help
	  Kernel space tilt detector sensor driver.
```

## drivers/misc/mediatek/time/Kconfig
```kconfig
config MTK_TIMER_ACCURANCY_TEST
	bool "mtk timer gpt and systimer accurancy UT test"
	help
	  MTK_TIMER_ACCURANCY_TEST which is used to test gpt and systimer
	  accurancy, this config only open in UT test, normal we do not open
```

## drivers/misc/mediatek/trng/Kconfig
```kconfig
config MTK_TRNG_DRIVER
	bool "Enable MTK TRNG driver"
	depends on MTK_ENG_BUILD
	default y
	help
	  TRNG is a kernel driver which creates
	  procfs to dump random number through
	  SMC call. The driver only exists in
	  eng load.
```

## drivers/misc/mediatek/usb_cable/Kconfig
```kconfig
config USB_CABLE
	tristate "USB cable detect driver"
	help
	  USE a gpio to detect usb calbe, then control the cpu frequency
```

## drivers/misc/mediatek/vibrator/Kconfig
```kconfig
config MTK_VIBRATOR
	tristate "MediaTek Vibrator driver"
	default n
	  ---help---
	  Vibrator driver support for MediaTek SOC.
	  You can customize the vibrate strength and lowest vibrate time.
	  If you want to use MediaTek Vibrator driver, say Y or M here.
	  If unsure, say N.

config SEPERATE_VOLT_FORLONGVIB
	bool "Seperate the volt value for long vib"
	default n
	help
	  Enable it only for product that need seperate the volt value for long vib
```

## drivers/misc/mediatek/vow/Kconfig
```kconfig
config MTK_VOW_SUPPORT
	bool "MediaTek VOW support"
	default n
	help
	  For VOW kernel driver config. This kernel driver
	  cooperate with SCP VOW driver to wakeup phone by
	  doing voice recognition.
```

## drivers/misc/mediatek/vpu/Kconfig
```kconfig
config MTK_VPU_SUPPORT
	bool "MediaTek VPU Driver"
	default n
	---help---
	  Support image processing using VPU hardware
```

## drivers/misc/mediatek/wake_gesture_sensor/Kconfig
```kconfig
config CUSTOM_KERNEL_WAKE_GESTURE_SENSOR
	bool "CUSTOM_KERNEL_WAKE_GESTURE_SENSOR"
	help
	  Kernel space wake up gesture sensor driver.
```

## drivers/misc/mediatek/watchtrust/Kconfig
```kconfig
# Copyright (c) 1993-2018 WATCHDATA Co.,Ltd
# All Rights Reserved.
#
# This program is free software; you can redistribute it and/or modify
# it under the terms of the GNU General Public License Version 2 as
# published by the Free Software Foundation.
#
# This program is distributed in the hope that it will be useful,
# but WITHOUT ANY WARRANTY; without even the implied warranty of
# MERCHANTABILITY or FITNESS FOR A PARTICULAR PURPOSE. See the
# GNU General Public License for more details.
#

#
# Trursted Execution Environment Configuration
#
config WATCHDATA_TEE_SUPPORT
	tristate "Watchdata Trusted Execution Environment Support"
	default n
	---help---
	  This implements the Trusted Execution Environment (TEE) Client
	  API Specification from GlobalPlatform Device Technology.
	  Say Y if you would like to enable this feature.
	  If unsure, say N.
```

## drivers/misc/mediatek/wind_device_info/Kconfig
```kconfig
#add wind_device_info --sunsiyuan@wind-mobi.com 20161129 begin
config WIND_DEVICE_INFO
	bool "CONFIG_WIND_DEVICE_INFO"
	default n
	help
		Select y or n
#add wind_device_info --sunsiyuan@wind-mobi.com 20161129 end
```

## drivers/misc/mediatek/xhci/Kconfig
```kconfig
#
# Mediatek XHCI Driver
#

config USB_MTK_DUALMODE
	bool "MediaTek DUAL MODE support"
	default n
	depends on USB_XHCI_MTK
	---help---
	  Enable Mediatek USB Host OTG DUAL-ROLE SUPPORT
	  The USB Port can act device role or host role.
	  Say Y here if your system support usb otg DUAL_ROLE.
	  If unsure, say N.

config USB_MTK_IDDIG
	bool "MediaTek OTG IDDIG support"
	default n
	depends on USB_MTK_DUALMODE
	---help---
	  Enable Mediatek USB Host OTG detection mechanism
	  IDDIG - OTG cable attachment detection.
	  Say Y here if your system support OTG IDDIG detection.
	  If unsure, say N.

config MTK_TEST_XHCI
	tristate "MediaTek U3 TEST XHCI driver support"
	default n
	---help---
	  Enables support Mediatek U3 XHCI test driver
	  kernel framework.
	  Say Y if you would like to do verification program.
	  If unsure, say N.

config USB_MTK_OTG_SWITCH
	tristate "MediaTek OTG IDDIG Function Switch"
	default n
	depends on USB_MTK_IDDIG
	---help---
	  Enable Mediatek OTG function Switch mechanism.
	  The default OTG DUALROLE function is disabled.
	  User can switch to enable or disable by command.
	  Say Y here if your want to use mechanism.
	  If unsure, say N.

config USB_XHCI_MTK_SUSPEND_SUPPORT
	tristate "MediaTek XHCI SUSPEND SUPPORT"
	default n
	depends on USB_XHCI_MTK
	---help---
	  Enable Mediatek OTG function Switch mechanism.
	  The default OTG DUALROLE function is disabled.
	  User can switch to enable or disable by command.
	  Say Y here if your want to use mechanism.
```

## drivers/misc/mediatek/xlog/Kconfig
```kconfig
config HAVE_XLOG_SUPPORT
	bool "HAVE_XLOG_SUPPORT"
	default y
	help
	  It decide whether the system has XLOG mechanism. XLOG is a log
	  filter mechanism which can filter the logs by tag before they are
	  written to log buffer
	  it for user space.
```

## drivers/misc/mmi/Kconfig
```kconfig
#
# Motorola drivers
# drivers (unitinfo, bootinfo, utag, etc.) and config defines
#
menu "Motorola mobile support drivers"
config MMI_INFO
	tristate "Motorola info driver"
	default n
	help
	  Motorola boot/ram/storage/unit info

config MOT_UTAG
	tristate  "Motorola Configuration read/write support "
	default n
	help
	  With this option you get read/write access to utag partition via procfs.
	  Content of the entire partition can be checked, separate utags accessed
	  and modified.

config MOTO_MAIN_DTSI
    string "Main dts Moto override dtsi name"

endmenu
```

## drivers/misc/utag/Kconfig
```kconfig
config UTAG
	tristate "Utag Configuration read/write support"
	default n
	help
	  With this option you get read/write access to utag partition via procfs.
          Content of the entire partition can be checked, separate utags accessed
	  and modified.
```
