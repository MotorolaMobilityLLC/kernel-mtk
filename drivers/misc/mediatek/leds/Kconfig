## drivers/misc/mediatek/leds/Kconfig
```kconfig
config MTK_LEDS
	tristate "MediaTek LED Support"
	depends on LEDS_CLASS
	---help---
	  This selects the MediaTek(R) LEDs connected to MediaTek chips.
	  If you want to use MediaTek(R) LEDs support, say Y or M here.
	  If unsure, say N.
	  Mediatek LED module includes backlight, indicate LED, keypad LED, button LED etc.

config LIGHTNESS_MAPPING_VALUE
	int "LIGHTNESS_MAPPING_VALUE"
	default 255
 	---help---
	  Backlight brightness mapping value, from 0 to 255.

config TB8173_EVB
	bool "Support TB8173 EVB board"
```

## drivers/misc/mediatek/mach/Kconfig
```kconfig
menu "MTK Board Support Package"

choice
	bool "MTK Board"

config MTK_EVB_BOARD
	bool "MTK EVB BOARD"
	depends on (ARCH_MT6580 || ARCH_MT6735)
	select ARM_L1_CACHE_SHIFT_6 if (!ARM64)
	help
	  Select if you are using an EVB board.

config MTK_FPGA
	bool "MTK FPGA"
	depends on (ARCH_MT6580 || ARCH_MT6735)
	select ARM_L1_CACHE_SHIFT_6 if (!ARM64)
	help
	  Select if you are using the FPGA board.

endchoice

config FPGA_CA7
	bool "FPGA CA7"
	depends on MTK_FPGA
	default n
	help
	  Select if you are using the CA7 FPGA board.

config MTK_PSCI
	bool "MT6752 PSCI boot method"
	depends on (ARCH_MT6580 || ARCH_MT6735)
	default n
	help
	  Select if you want to enable PSCI boot method on MTK platform.

config MAX_DRAM_SIZE_SUPPORT
	hex "The maximum size of the DRAM can be supported in the kernel"
	default 0x10000000
	depends on (ARCH_MT6580 || ARCH_MT6735)
	help
	  Define the maximum size of the kernel can be supported.
	  It will modify the memory size if it size is smaller than
	  the memory size passed by the boot loader to the MAX_DRAM_SIZE_SUPPORT.
	  Notice that the maximum DRAM size is including the memory size
	  reserved for the modem and the PMEM.

endmenu
```

## drivers/misc/mediatek/magnetometer/akm09916/Kconfig
```kconfig
config MTK_AKM09916
	bool "AKM09916 for MediaTek package"
	default n
	help
	  It support different magnetometer sensor.
          If this option is set,
	  it will support
          AKMD09911 magnetometer.
```

## drivers/misc/mediatek/magnetometer/mmc3530/Kconfig
```kconfig
config MTK_MMC3524X
	bool "MMC3524X for MediaTek package"
	default n
	help
	  It support different magnetometer sensor.
          If this option is set,
	  it will support
          mmc3524x magnetometer.
```

## drivers/misc/mediatek/magnetometer/mmc3630x/Kconfig
```kconfig
config MTK_MMC3630X
	bool "mmc3630x for MediaTek package"
	default n
	help
	  It support different magnetometer sensor.
		  If this option is set,
	  It will support
		  MMC3630X magnetometer.
```

## drivers/misc/mediatek/magnetometer/qmcX983/Kconfig
```kconfig
config MTK_QMCX983
	bool "QMCX983 for MediaTek package"
	default n
	help
	  It support different magnetometer sensor.
          If this option is set,
	  it will support
          QMCX983D magnetometer.
```

## drivers/misc/mediatek/masp/Kconfig
```kconfig
config MTK_SECURITY_SW_SUPPORT
	bool "Enable MTK SECURITY SW Support"
	help
	  If yes,
	  All security functions in preloader/LK/kernel/android
	  will be built into software images.
	  Otherwise, they will not be built into software images.

config MTK_SEC_MODEM_NVRAM_ANTI_CLONE
	bool "MTK_SEC_MODEM_NVRAM_ANTI_CLONE"
	help
	  This option is used to enable modem NVRAM anti-clone functionality
	  [dependency_relationship]: yes If this option is turned on, the
	  modem part should also turn on for the following setting 1. Modem
	  project file CUSTOM_OPTION += __NVRAM_BIND_TO_CHIP_CIPHER__ 2. by
	  default, only two LID is defaulted has MSP attribute
	  (1)NVRAM_EF_SML_LID (2)NVRAM_EF_SIM_LOCK_LID 3. if want to turn on
	  specific LID, please add attribute NVRAM_ATTR_MSP

config MTK_AVB20_SUPPORT
	bool "MTK_AVB20_SUPPORT"
	help
	  This option is used to enable AVB2.0, which stands for Android
	  Verified Boot 2.0.
```

## drivers/misc/mediatek/mkp_test/Kconfig
```kconfig
config MTK_MKP_TEST
	tristate "Test MTK MKP feature"
	default n
	help
	  Test MKP
```

## drivers/misc/mediatek/mmp/Kconfig
```kconfig
config MTK_MMPROFILE_SUPPORT
	bool "Medaitek mmprofile support, for debug"
		default y
	help
	  Multimedia profiling mechanism
```

## drivers/misc/mediatek/mtprintk/Kconfig
```kconfig
config PRINTK_MT_PREFIX
	bool "Prefix cpu_id/status/pid/process_name to each kernel log"
	default y
	help
	  PRINTK_MT_PREFIX which is used to control whether to show
	  process information about this log.
	  the information about which cpu about this
	  process in, and whether in isr.

config MT_PRINTK_UART_CONSOLE
	bool "MTK printk UART controller"
	default y
	help
	  MT_PRINTK_UART_CONSOLE which is used to control whether to
	  control printk to uart console.  when boot up finish
	  uart console do not output printk log.
	  also RD can set the setting by command.

config LOG_TOO_MUCH_WARNING
	bool "printk too much warning"
	default y
	depends on PRINTK_MT_PREFIX
	help
	  LOG_TOO_MUCH_WARNING which is used to control whether to
	  detect printk too much issue. kernel log too much will detect and
	  create a exception when printk log large than
	  LOG_TOO_MUCH_DETECT_COUNT in one second.

config LOG_TOO_MUCH_DETECT_COUNT
	hex "printk too much detect count"
	default 0xC8
	depends on LOG_TOO_MUCH_WARNING

config LOG_TOO_MUCH_DETECT_GAP
	hex "detect log too much delay time"
	default 10
	depends on LOG_TOO_MUCH_WARNING
```

## drivers/misc/mediatek/mtprof/Kconfig
```kconfig
config MTPROF
	bool "Enable MTK profiler/debugger tool"
	help
	  CONFIG_MTPROF define if mtk profiling tools should be built-in or not. It
	  includes workqueue debugger, signal debugger, bootprof, and other
	  misc tools. If you are not sure about whether to enable it or not, please
	  set n.

if MTPROF

config MTK_WQ_DEBUG
	bool "mtk workqueue debug"
	help
	  CONFIG_MTK_WQ_DEBUG define if workqueue debugging should be built-in or not
	  It will add logs to monitor work activation, queue, and execution. Say y to
	  enable mtk workqueue debug, or if you are not sure about this, please
	  set n

endif # MTPROF
```

## drivers/misc/mediatek/mu3d/Kconfig
```kconfig
#
# MediaTek USB 3.0 Controller Driver
#

config USBIF_COMPLIANCE
	tristate "MediaTek MUSB U3 USBIF COMPLIANCE"
	default n
	---help---
	  This selects the MediaTek USB-IF Compliance Test Program.
	  MediaTek I2C bus adapter is the base for some other I2C client, eg: touch, sensors.
	  If you want to verify USB-IF COMPLIANCE, say Y.
	  If unsure, say N.

config USB_MU3D_PIO_ONLY
	tristate "MediaTek MUSB Gadget support EP0 PIO mode"
	default n
	---help---
	  Say Y here if you want to disable USB DMA function.
	  All data is copied between memory and FIFO by the CPU.
	  DMA controllers are ignored.
	  If unsure, say N.

config USB_MU3D_DRV
	tristate "MediaTek SSUSB MAC Driver support"
	default n
	---help---
	  This selects the MediaTek USB MAC driver.
	  Say Y here if your system using Mediatek USB3.0 IP.
	  It supports super-speed, high-speed and full-speed.
	  If unsure, say N.

config USB_MU3D_DVT
	tristate "MediaTek SSUSB DVT support"
	default n
	---help---
	  Say Y here if your system using Mediatek USB3.0 IP
	  and would like to do verification program.
	  If unsure, say N.
```

## drivers/misc/mediatek/nfc/Kconfig
```kconfig
config MTK_NFC_SUPPORT
	tristate "MediaTek NFC driver"
	default n
	help
	  Y means NFC_MT6605 define if use Mediatek NFC Function to provide reader
	  Card emulation or P2P function. If you are not sure about this, set n.
	  Y means NFC_MT6605 define if use Mediatek NFC Function to provide reader
	  Card emulation or P2P function. If you are not sure about this, set n.

config NFC_CHIP_SUPPORT
	tristate "NFC driver solution - STMicroelectronics ST21NFC NFC Controller Driver"
	default n
	depends on I2C
	help
	  STMicroelectronics ST21NFC Near Field Communication controller support.
	  ST21NFCD can support 2UICC mode, and ST54F can support 1UICC + eSE.
	  If configures to be y, means devices supports NFC functionality.
	  If configures to be n, means devices doesn't support NFC functionality.
```

## drivers/misc/mediatek/partition/Kconfig
```kconfig
config MTK_GPT_SCHEME_SUPPORT
	bool "MTK_GPT_SCHEME_SUPPORT"
	depends on EFI_PARTITION
	help
	  MTK Support for GUID Partition Table
	  Provide APIs to query GPT information
	  Set Y to support.
	  Set N to disable.
```

## drivers/misc/mediatek/pcie_ut/Kconfig
```kconfig
config PCIE_MTK_UNIT
	bool "pcie unit test"
	depends on PCIE_MTK
	help
	  This selects MediaTek(R) PCIE UNIT TEST driver.
	  UNIT TEST is used to test PCIE device.
	  If you want to use MediaTek(R) PCIE UNIT TEST driver, say
	  Y or M here. If unsure, say N.
```

## drivers/misc/mediatek/pdr_sensor/Kconfig
```kconfig
config CUSTOM_KERNEL_PDR_SENSOR
	bool "CUSTOM_KERNEL_PDR_SENSOR"
	help
	  Kernel space PDR sensor driver.
```

## drivers/misc/mediatek/pedometer/Kconfig
```kconfig
config CUSTOM_KERNEL_PEDOMETER
	bool "CUSTOM_KERNEL_PEDOMETER"
	help
	  Kernel space pedometer sensor driver.
```

## drivers/misc/mediatek/performance/Kconfig
```kconfig
config MTK_PERFMGR
	tristate "Performance manager kernel driver"
	default n
	help
	  kernel driver of performance manager
```

## drivers/misc/mediatek/pick_up_sensor/Kconfig
```kconfig
config CUSTOM_KERNEL_PICK_UP_SENSOR
	bool "CUSTOM_KERNEL_PICK_UP_SENSOR"
	help
	  Kernel space pick up sensor driver.
```
