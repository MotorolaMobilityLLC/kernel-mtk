## drivers/misc/mediatek/gpu/Kconfig
```kconfig
config MTK_GPU_SUPPORT
	bool CONFIG_MTK_GPU_SUPPORT
	default n
	help
	  CONFIG_MTK_GPU_SUPPORT define if the gpu driver should be built in or not

config MTK_GPU_VERSION
	string CONFIG_MTK_GPU_VERSION
	default ""
	help
	  CONFIG_MTK_GPU_VERSION define which gpu ddk version will be used

config MTK_GPU_COMMON_DVFS_SUPPORT
  bool CONFIG_MTK_GPU_COMMON_DVFS_SUPPORT
  default n
  help
    CONFIG_MTK_GPU_COMMON_DVFS_SUPPORT define to use COMMON DVFS
```

## drivers/misc/mediatek/gud/Kconfig
```kconfig
#
# TRUSTONIC TEE configuration
#
config TRUSTONIC_TEE_SUPPORT
	bool "Enable Trustonic TEE Support"
	default n
	---help---
	  Enable Trustonic TEE Support

config TRUSTONIC_TEE_VERSION
	string "TRUSTONIC TEE Version"
	depends on TRUSTONIC_TEE_SUPPORT
	default "302c" if (MACH_MT6757)
	default "311b" if (MACH_MT6763 || MACH_MT6799)

config MTK_TRUSTONIC_TEE_DEBUGFS
	bool "Enable Trustonic TEE debugfs"
	depends on (TRUSTONIC_TEE_VERSION="302c")
	default n
	---help---
	  Enable Trustonic TEE debugfs

config TRUSTONIC_TEE_DEBUG
	bool "Trustonic TEE driver debug mode"
	depends on (TRUSTONIC_TEE_SUPPORT) && (TRUSTONIC_TEE_VERSION="311b")
	default n
	---help---
	  Enable the debug mode in the Trustonic TEE Driver.

#
# MobiCore configuration
#
config MOBICORE_DRIVER
	tristate "MobiCore Driver"
	depends on (TRUSTONIC_TEE_SUPPORT) && (TRUSTONIC_TEE_VERSION="302c")
	default y
	---help---
	  Enable Linux Kernel MobiCore Support

config MOBICORE_DEBUG
	bool "MobiCore Module debug mode"
	depends on MOBICORE_DRIVER
	default n
	---help---
	  Enable Debug mode in the MobiCore Driver.
	  It enables printing information about mobicore operations

config MOBICORE_VERBOSE
	bool "MobiCore Module verbose debug mode"
	depends on MOBICORE_DEBUG
	default n
	---help---
	  Enable Verbose Debug mode in the MobiCore Driver.
	  It enables printing extra information about mobicore operations
	  Beware: this is only useful for debuging deep in the driver because
	  it prints too much logs

config MOBICORE_API
	tristate "Linux MobiCore API"
	depends on MOBICORE_DRIVER
	default y
	---help---
	  Enable Linux Kernel MobiCore API

config TRUSTONIC_TRUSTED_UI
	tristate "<t-base TUI"
	depends on TRUSTONIC_TEE_SUPPORT
	default n
	---help---
	  Enable <t-base Trusted User Interface

config TRUSTONIC_TRUSTED_UI_FB_BLANK
	bool "<t-base TUI with fb_blank"
	depends on TRUSTONIC_TRUSTED_UI
	default n
	---help---
	  Blank the framebuffer before starting a TUI session
```

## drivers/misc/mediatek/gyroscope/ITG1010-new/Kconfig
```kconfig
config MTK_ITG1010_NEW
        bool "ITG1010 for MediaTek package"
        default n
        help
        It support different gyroscope sensor.
        If this option is set,
	  	it will support
         ITG1010 gyroscope.
```

## drivers/misc/mediatek/gyroscope/Kconfig
```kconfig
config CUSTOM_KERNEL_GYROSCOPE
	bool "CUSTOM_KERNEL_GYROSCOPE"
	help
	  gyroscope sensor to detect gyroscope from x y z axis.
	  If the platform is supported for gyroscope, this
	  configuration should be configured, and the gyroscope
	  driver configuration should be configured as well.

source "drivers/misc/mediatek/gyroscope/lsm6ds3hgy/Kconfig"
source "drivers/misc/mediatek/gyroscope/bmi160gy-spi/Kconfig"
source "drivers/misc/mediatek/gyroscope/bmi160gy-i2c/Kconfig"
```

## drivers/misc/mediatek/gyroscope/LCT_bmi160gy-new/Kconfig
```kconfig
config LCT_MTK_BMI160GY_NEW
        bool "BMI120 for MediaTek package"
        default n
        help
        It support different gyroscope sensor.
        If this option is set,
	  	it will support
         BMI120 gyroscope. code same with  120
```

## drivers/misc/mediatek/gyroscope/bmi120gy-new/Kconfig
```kconfig
config MTK_BMI120GY_NEW
        bool "BMI120 for MediaTek package"
        default n
        help
        It support different gyroscope sensor.
        If this option is set,
	  	it will support
         BMI120 gyroscope.
```

## drivers/misc/mediatek/gyroscope/icm206xx_g/Kconfig
```kconfig
config MTK_ICM206XX_G
	bool "ICM206XX for MediaTek package"
	default n
	help
	It support different gyroscope sensor.
	If this option is set,
	it will support
	ICM206XX gyroscope.
```

## drivers/misc/mediatek/gyroscope/lsm6ds3gy-k52/Kconfig
```kconfig
config MTK_LSM6DS3GY_K52
	bool "LSM6DS3GY_K52 for MediaTek package"
	default n
	help
	  It support different gyroscope sensor.
          If this option is set,
	  it will support
          MTK_LSM6DS3_K52 gyroscope.
```

## drivers/misc/mediatek/hdmi/ANX7625/Kconfig
```kconfig
config ANALOGIX_OHIO
	tristate "Analogix Type-C interface support"
	help
		Analogix type-c interface is a  chip support USB PD protocol device.
		ANX7625 is an ultra-low power 4K mobile HD transmitter designed
		for portable devices. It converts MIPI/DPI to DisplayPort1.3 4K
		including an intelligent crosspoint switch to support USB Type-C.
```

## drivers/misc/mediatek/hdmi/Kconfig
```kconfig
# HDMI
config MTK_HDMI_SUPPORT
	bool "MTK_HDMI_SUPPORT"
	default n
	help
	   To control whether enable or disable HDMI feature. If choose yes,
	   phone's screen can be demonstrated on TV via HDMI cable.

config MTK_MT8193_HDMI_SUPPORT
	bool "MTK_MT8193_HDMI_SUPPORT"
	depends on MTK_HDMI_SUPPORT
	depends on MTK_MT8193_SUPPORT

config MTK_INTERNAL_HDMI_SUPPORT
	bool "MTK_INTERNAL_HDMI_SUPPORT"
	default n
	depends on MTK_HDMI_SUPPORT
	help
			Enable the Internal HDMI Support

config MTK_HDMI_HDCP_SUPPORT
	bool "MTK_HDMI_HDCP_SUPPORT"
	depends on MTK_HDMI_SUPPORT
	help
	   Enable hdmi tx hdcp support
```

## drivers/misc/mediatek/humidity/Kconfig
```kconfig
config CUSTOM_KERNEL_HUMIDITY
	bool "CUSTOM_KERNEL_HUMIDITY"
	help
	  To detect humidity raw data

source "drivers/misc/mediatek/humidity/hts221/Kconfig"
```

## drivers/misc/mediatek/i2c/Kconfig
```kconfig
config MTK_I2C
	bool "Enble OCP2131 driver"
	depends on I2C=y
	help
	  if vendor has its own i2c devices used on mtk chip,
	  should define this macro to y.

config MTK_LCM_BIAS_OCP2131
	bool "Enble OCP2131 driver"
	help
	  define OCP2131 driver config to enable OCP2131 driver.
	  To set LOCP2131 driver which you choose avoid cannot driver OCP2131.
	  Please make sure CONFIG_MTK_LCM_BIAS_OCP2131 in xxxxxx_defconfig.mk.
	  And also make sure true on in ProjectConfig.mk
```

## drivers/misc/mediatek/iccs/Kconfig
```kconfig
config MTK_ICCS_SUPPORT
	bool "Enable MediaTek Inter-Cluster Cache Sharing"
	default n
	help
	  MediaTek Inter Cluster Cache Sharing is a feature
	  to enhance system performance, which enables the
	  cache sharing capability between clusters for
	  better cache utilization.
```

## drivers/misc/mediatek/ice_debug/Kconfig
```kconfig
config MTK_ICE_DEBUG
	bool "Enable ICE clock"
	help
	  CCF will disable CLK_TOP_DEBUGSYS by default,ICE can not connect to SOC.
	  If you need ice,please select this item.
```

## drivers/misc/mediatek/imgsensor/Kconfig
```kconfig
config MTK_IMGSENSOR
	bool CONFIG_MTK_IMGSENSOR
	default n
	help
	  CONFIG_MTK_IMGSENSOR

config CAMERA_DVDD_SWITCH
	default n
	bool "Use to distinguish camera config for saipan"
	help
	    Use to Use to distinguish camera config for saipan

config PROJECT_LISBON
	bool CONFIG_PROJECT_LISBON
	default n
	help
	  CONFIG_PROJECT_LISBON

config CAMERA_EFUSE
	bool CONFIG_IMGSENSOR_EFUSE
	default y
	help
	  CONFIG_IMGSENSOR_EFUSE

source "drivers/misc/mediatek/imgsensor/src/Kconfig"
config ARCH_MOTO_PROJECT
	string CONFIG_ARCH_MOTO_PROJECT
	help
	  CONFIG_ARCH_MOTO_PROJECT
```

## drivers/misc/mediatek/imgsensor/src/Kconfig
```kconfig
config SPECIFY_IMGSENSOR
	bool "Specify image sensor name"
	depends on MTK_IMGSENSOR
	help
	  Specify name of each sensor to prevent obtaining wrong sensor driver
	  with same sensor ID. For example, imx258_mipi_raw and
	  imx258_mipi_mono are of same sensor ID. If not specifying sensor,
	  imx258_mipi_mono may be recognized as imx258_mipi_raw.

config IMGSENSOR_MAIN
	string "Custom main image sensor"
	depends on SPECIFY_IMGSENSOR
	help
	  Specify name of main sensor to prevent obtaining wrong sensor driver
	  with same sensor ID. For example, imx258_mipi_raw and
	  imx258_mipi_mono are of same sensor ID. If not specifying sensor,
	  imx258_mipi_mono may be recognized as imx258_mipi_raw.

config IMGSENSOR_MAIN2
	string "Custom main2 image sensor"
	depends on SPECIFY_IMGSENSOR
	help
	  Specify name of main2 sensor to prevent obtaining wrong sensor driver
	  with same sensor ID. For example, imx258_mipi_raw and
	  imx258_mipi_mono are of same sensor ID. If not specifying sensor,
	  imx258_mipi_mono may be recognized as imx258_mipi_raw.

config IMGSENSOR_SUB
	string "Custom sub image sensor"
	depends on SPECIFY_IMGSENSOR
	help
	  Specify name of sub sensor to prevent obtaining wrong sensor driver
	  with same sensor ID. For example, imx258_mipi_raw and
	  imx258_mipi_mono are of same sensor ID. If not specifying sensor,
	  imx258_mipi_mono may be recognized as imx258_mipi_raw.

config IMGSENSOR_SUB2
	string "Custom sub2 image sensor"
	depends on SPECIFY_IMGSENSOR
	help
	  Specify name of sub2 sensor to prevent obtaining wrong sensor driver
	  with same sensor ID. For example, imx258_mipi_raw and
	  imx258_mipi_mono are of same sensor ID. If not specifying sensor,
	  imx258_mipi_mono may be recognized as imx258_mipi_raw.

config IMGSENSOR_MAIN3
	string "Custom main3 image sensor"
	depends on SPECIFY_IMGSENSOR
	help
	  Specify name of main3 sensor to prevent obtaining wrong sensor driver
	  with same sensor ID. For example, imx258_mipi_raw and
	  imx258_mipi_mono are of same sensor ID. If not specifying sensor,
	  imx258_mipi_mono may be recognized as imx258_mipi_raw.

config MTK_CAM_SENSOR_PROBE_RETRY
       bool "For sensor probe fail"
       default n
       help
         Add retries for sensor id matching

config  MOT_DEVONN_CAMERA_PROJECT
	tristate "set devonn camera driver"
	help
	  Used to distinguish project-driver code from other projects.

config  MOT_DEVONF_CAMERA_PROJECT
	tristate "set devonf camera driver"
	help
	  Used to distinguish project-driver code from other projects.

config  MOT_CANCUNF_CAMERA_PROJECT
        tristate "set cancun camera driver"
        help
          Used to distinguish project-driver code from other projects.

config  MOT_TAIPEI_CAMERA_PROJECT
        tristate "set taipei camera driver"
        help
          Used to distinguish project-driver code from other projects.

config  MOT_CANCUNN_CAMERA_PROJECT
        tristate "set cancunn camera driver"
        help
          Used to distinguish project-driver code from other projects.

config  MOT_MAUI_CAMERA_PROJECT
        tristate "set maui camera driver"
        help
          Used to distinguish project-driver code from other projects.

config  MOT_VICKY_CAMERA_PROJECT
        tristate "set vicky camera driver"
        help
          Used to distinguish project-driver code from other projects.
```

## drivers/misc/mediatek/in_pocket_sensor/Kconfig
```kconfig
config CUSTOM_KERNEL_IN_POCKET_SENSOR
	bool "CUSTOM_KERNEL_IN_POCKET_SENSOR"
	help
	  Kernel space in pocket detection sensor driver.
```

## drivers/misc/mediatek/ir_learning/Kconfig
```kconfig
config MTK_IR_LEARNING_SUPPORT
	bool "MediaTek consumer IR learning solution"
	default n
	---help---
	  This selects MediaTek(R) internal IR-learning driver.
          IR-learning is used to learn the key of IR remote controller, like TV controller.
	  If you want to use MediaTek(R) internal IR-learning driver, say
	  Y or M here. If unsure, say N.
```

## drivers/misc/mediatek/irtx/Kconfig
```kconfig
config MTK_IRTX_PWM_SUPPORT
	bool "MediaTek consumer IR tansmitter"
	default n
	---help---
	  IRTX driver support for MediaTek PWM only solution
```

## drivers/misc/mediatek/jpeg/Kconfig
```kconfig
config MTK_JPEG
	bool CONFIG_MTK_JPEG
	default n
	help
	  This option enables mtk jpeg driver,
	  if yes, it means this platform supports mtk jpeg encoder or decoder HW,
	  if no, it means this platform supports only SW jpeg encoder and decoder.
	  The option default disabled.
```

## drivers/misc/mediatek/keypad/Kconfig
```kconfig
config MTK_KEYPAD
	tristate "MediaTek Keypad Support"
	---help---
	  Say Y here if you want to use the keypad.

	  If unuse, say N.

	  To compile this driver as a module, choose M here: the
	  module will be called mtk-kpd.

config KEYBOARD_HID
	tristate "MediaTek hid keyboard support"
	---help---
	  Say Y here if you want to use the hid keyboard.

	  If unuse, say N.

	  To compile this driver as a module, choose M here: the
	  module will be called hid_keyboard.

config ONEKEY_REBOOT_NORMAL_MODE
	bool "Long press reboot by Powerkey only on normal mode"
	default n
	---help---
	  Say Y here if you want to use one key reboot normal mode.

	  If unuse, say N.

	  To compile this driver as a module, choose M here: the
	  module will be called long_press_reboot_function_setting.

config TWOKEY_REBOOT_NORMAL_MODE
	bool "Long press reboot by Powerkey + other key on normal mode"
	default n
	---help---
	  Say Y here if you want to use two key reboot noraml mode.

	  If unuse, say N.

	  To compile this driver as a module, choose M here: the
	  module will be called long_press_reboot_function_setting.

config ONEKEY_REBOOT_OTHER_MODE
	bool "Long press reboot by Powerkey only on other mode"
	default n
	---help---
	  Say Y here if you want to use one key reboot other mode.

	  If unuse, say N.

	  To compile this driver as a module, choose M here: the
	  module will be called long_press_reboot_function_setting.

config TWOKEY_REBOOT_OTHER_MODE
	bool "Long press reboot by Powerkey + other key on other mode"
	default n
	---help---
	  Say Y here if you want to use two key reboot other mode.

	  If unuse, say N.

	  To compile this driver as a module, choose M here: the
	  module will be called long_press_reboot_function_setting.

config KPD_PMIC_LPRST_TD
	int "Long press reboot timeout period"
	range 0 3
	default "1"
	---help---
	  0->8s, 1->11s, 2->14s, 3->5s
```

## drivers/misc/mediatek/laser/Kconfig
```kconfig
config MTK_LASER
	bool CONFIG_MTK_LASER
	default n
	help
	  CONFIG_MTK_LASER
#
# LASER
#

config LASER_STMVl53l0
	bool "STMVl53l0 laser Driver"
	default n
	help
	  STMVl53l0 laser Driver
	  This config is used to enable the corresponding
	  laser driver for the camera sensor module
	  Set as y if the driver is used in this project
```

## drivers/misc/mediatek/lastpc/Kconfig
```kconfig
config MTK_LASTPC
	bool CONFIG_MTK_LASTPC
	default n
	help
	  LASTPC is a debugging feature on MCUCFG bus.
	  Which latches the last pc value on each CPUs as debugging
	  information after sysytem unexpectedly crash or shutdown.
```

## drivers/misc/mediatek/lcm/Kconfig
```kconfig
config MTK_LCM
	bool "Enable LCM driver"
	default n
	help
	  define LCM driver config to enable LCM driver.
	  To set LCM driver which you choose avoid cannot driver LCM.
	  Please make sure CONFIG_MTK_LCM in xxxxxx_defconfig.mk.
	  And also make sure true on in ProjectConfig.mk

config CUSTOM_KERNEL_LCM
	string "define mediatek kernel LCM driver"
	help
	  To choose kernel LCM driver name.
	  This config is to select which LCM driver you want to use.
	  Please make sure CUSTOME_KERNEL_LCM in xxxxx_defconfig.mk.
	  And also make sure turn on in ProjectConfig.mk

config MTK_LCM_DEVICE_TREE_SUPPORT
	bool "support LCM device tree connect with display drivers"
	help
	  Decide whether to support LCM device tree based configuration.
	  This feature requires the connection between display driver and LCM devices.
	  Please also turn on MTK_LCM_DEVICE_TREE_SUPPORT in ProjectConfig.mk.
	  If not define MTK_LCM_DEVICE_TREE_SUPPORT
	  there will not connect between display driver and LCM devices.

config MTK_BIAS_BL_FEATURE
	default n
	bool "Support bias and backlight i2c driver"
	help
	  This config for bias IC and backlight IC
	  bias IC and backlight IC are used by LCM
	  Normal project will disable it first
	  If you are not sure about this, do not set it to y
```
