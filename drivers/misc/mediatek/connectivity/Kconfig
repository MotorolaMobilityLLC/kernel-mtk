## drivers/misc/mediatek/fmradio/Kconfig
```kconfig
config MTK_FMRADIO
	bool CONFIG_MTK_FMRADIO
	default n
	help
		This config is used to choose
		if need to compile fmradio folder.
		Will compile fmradio folder if set to 'y',
		otherwise will not compile fmradio folder.

config MTK_FM
	bool "MediaTek FM Chip Support"
	default n
	help
		This config is used to choose
		if use MTK FM chip or not.
		Will used MTK FM chip if set to 'y',
		otherwise will not use MTK FM chip.

config MTK_FM_SUPPORT
	bool "MTK_FM_SUPPORT"
	default n
	help
	  This config is used to choose
	  switch off Android FM or not.
	  All features(RX&TX) of FM will be enabled if set to 'y',
	  otherwise will be disabled.

config MTK_FM_CHIP
	string "MTK_FM_CHIP"
	depends on MTK_FM_SUPPORT
	default "MT6620_FM" if MTK_COMBO_CHIP_MT6620
	default "MT6630_FM" if MTK_COMBO_CHIP_MT6630
	help
		This config is used to choose
		which FM radio chip to use:
		e.g. MT6620_FM, MT6628_FM, MT6627_FM,
		MT6580_FM, MT6630_FM...

config MTK_FM_50KHZ_SUPPORT
	bool "MTK_FM_50KHZ_SUPPORT"
	depends on MTK_FM_SUPPORT
	help
		This config is used to choose
		if need to support FM 50KHz step or not
		for tune/seek/scan functions.
		Will support 50KHz step if set to 'y',
		otherwise will not support 50KHz step.

config MTK_MERGE_INTERFACE_SUPPORT
	bool "MTK_MERGE_INTERFACE_SUPPORT"
	help
		This config used to control Audio
		path is merge interface or not.
		Audio/FM will use merge interface if yes,
		otherwise merge interface is not used.
```

## drivers/misc/mediatek/freqhopping/Kconfig
```kconfig
config MTK2712_FREQ_HOPPING
	bool "MT2712 FREQHOPPING driver"
	depends on MTK_FREQ_HOPPING
	help
	  Freqhopping can help you control some PLLs by freqhopping HW.

config MTK8173_FREQ_HOPPING
	bool "MT8173 FREQHOPPING driver"
	depends on MTK_FREQ_HOPPING
	help
	  Freqhopping can help you control some PLLs by freqhopping HW.
```

## drivers/misc/mediatek/geniezone/Kconfig
```kconfig
config MTK_GZ_KREE
	bool "MediaTek GenieZone support"
	default n
	help
	  Mediatek GenieZone kernel driver
	  with APIs based on MTEE framework
	  Note that user-space API requires
	  This module to be enabled.
```

## drivers/misc/mediatek/glance_gesture_sensor/Kconfig
```kconfig
config CUSTOM_KERNEL_GLANCE_GESTURE_SENSOR
	bool "CUSTOM_KERNEL_GLANCE_GESTURE_SENSOR"
	help
	  Kernel space glance(touch wake up) gesture sensor driver.
```

## drivers/misc/mediatek/gpio/Kconfig
```kconfig
config MTK_GPIO
	tristate "MediaTek GPIO driver"
	default y
	---help---
	  This selects the MediaTek(R) GPIO driver.
	  Some pinctrl functions need the utilities from this driver.
	  If you want to use MediaTek(R) GPIO driver, say Y or M here.
	  If unsure, say N.


config MTK_MT6306_GPIO_SUPPORT
	tristate "MediaTek MT6306 GPIO Controller support"
	default n
	---help---
	  This selects the MediaTek(R) MT6306 GPIO driver.
	  Some pinctrl functions need the utilities from this driver.
	  If you want to use MediaTek(R) GPIO driver, say Y or M here.
	  If unsure, say N.

config MTK_GPIOLIB_STAND
	bool "Mediatek Use GPIO Upstream Code"
	default n
	---help---
	  This selects the MediaTek(R) GPIO driver code.
	  If you want to use MediaTek(R) GPIO Upstream Code, say Y or M here.
	  If unsurem say N.
```

## drivers/misc/mediatek/gps/Kconfig
```kconfig
menuconfig GPS
        tristate "GPS drivers"
        default y
        ---help---
          Say Y here for supporting GPS.

if GPS
config MTK_GPS
        tristate "MediaTek GPS driver"
        default y
        ---help---
          MTK GPS driver
          To switch gps nmea port driver.
          Set "yes" to turn on.
          Set "no" to turn off.
endif # GPS

config MTK_GPS_SUPPORT
        tristate "MediaTek GPS driver"
        select MTK_GPS
        help
          to switch GPS feature on the platform. Set "yes" to turn
          on and set "no"(with MTK_AGPS_APP=no at the same time) to turn
          off.
```

## drivers/misc/mediatek/gpt/Kconfig
```kconfig
# common gpt driver
config MTK_GPT_COMMON
	bool "General Purpose Timer Support Common"
	---help---
	MTK General_Purpose_Timer driver support common code between different Socs.
config MTK_GPT_SCHEME_SUPPORT
       bool "Support for GPT scheme layout"
       ---help---
       MTK driver support gpt sheme layout
```
