## drivers/misc/mediatek/connectivity/Kconfig
```kconfig
config MTK_COMBO
	tristate "MediaTek Connectivity Combo Chip Support"
	help
	  MTK connectivity combo chip driver for MT66xx

#
# MTK Combo Chip Selection
#

choice
	prompt "Select Chip"
	depends on MTK_COMBO

config MTK_COMBO_CHIP_MT6620
	bool "MT6620"
	help
	  this config is used to decided combo chip version
	  in current platform
	  is
	  MT6620

config MTK_COMBO_CHIP_MT6628
	bool "MT6628"
	help
	  this config is used to decided combo chip version
	  in current platform
	  is
	  MT6628

config MTK_COMBO_CHIP_MT6630
	bool "MT6630"
	help
	  this config is used to decided combo chip version
	  in current platform
	  is
	  MT6630

config MTK_COMBO_CHIP_CONSYS_6572
	bool "CONSYS_6572"
	help
	  this config is used to decided SOC consys version
	  in current platform
	  is
	  MT6572

config MTK_COMBO_CHIP_CONSYS_6582
	bool "CONSYS_6582"
	help
	  this config is used to decided SOC consys version
	  in current platform
	  is
	  MT6582

config MTK_COMBO_CHIP_CONSYS_8127
	bool "CONSYS_8127"
	help
	  this config is used to decided SOC consys version
	  in current platform
	  is
	  MT6572

config MTK_COMBO_CHIP_CONSYS_6752
	bool "CONSYS_6752"
	help
	  this config is used to decided SOC consys version
	  in current platform
	  is
	  MT6752

config MTK_COMBO_CHIP_CONSYS_6592
	bool "CONSYS_6592"
	help
	  this config is used to decided SOC consys version
	  in current platform
	  is
	  MT6592

config MTK_COMBO_CHIP_CONSYS_8163
	bool "CONSYS_8163"
	help
	  this config is used to decided SOC consys version
	  in current platform
	  is
	  MT8163

config MTK_COMBO_CHIP_CONSYS_6735
	bool "CONSYS_6735"
	help
	  this config is used to decided SOC consys version
	  in current platform
	  is
	  MT6735

config MTK_COMBO_CHIP_CONSYS_6580
	bool "CONSYS_6580"
	help
	  this config is used to decided SOC consys version
	  in current platform
	  is
	  MT6580

endchoice

config MTK_COMBO_CHIP
	string
	default "MT6620" if MTK_COMBO_CHIP_MT6620
	default "MT6628" if MTK_COMBO_CHIP_MT6628
	default "MT6630" if MTK_COMBO_CHIP_MT6630
	default "CONSYS_6572" if MTK_COMBO_CHIP_CONSYS_6572
	default "CONSYS_6582" if MTK_COMBO_CHIP_CONSYS_6582
	default "CONSYS_8127" if MTK_COMBO_CHIP_CONSYS_8127
	default "CONSYS_6752" if MTK_COMBO_CHIP_CONSYS_6752
	default "CONSYS_6592" if MTK_COMBO_CHIP_CONSYS_6592
	default "CONSYS_8163" if MTK_COMBO_CHIP_CONSYS_8163
	default "CONSYS_6735" if MTK_COMBO_CHIP_CONSYS_6735
	default "CONSYS_6580" if MTK_COMBO_CHIP_CONSYS_6580
	help
	  this feature is used to identify combo chip version or SOC chip
	  consys version.

#
# Target Platform Selection
#
config MTK_COMBO_PLAT_PATH
	string "Platform folder name"
	depends on MTK_COMBO
	default "sample" if MTK_COMBO_PLAT_SAMPLE
	help
	  Specify platform folder under common driver platform folder:
	  mtk_wcn_combo/common/platform/*

#
# MTK COMBO Chip Configuration
#
config MTK_COMBO_COMM
	depends on MTK_COMBO
	tristate "MediaTek Combo Chip Common part driver"
	help
	  MediaTek combo chip common part driver

#config MTK_COMBO_COMM_PS
#	depends on MTK_COMBO_COMM
#	bool "Enable PS support"
#	default n
#	help
#	  Enable PS support of common UART interface

config MTK_COMBO_COMM_UART
	depends on MTK_COMBO_COMM
	tristate "Common interface UART"
	help
	  Use UART for common part interface type

config MTK_COMBO_COMM_SDIO
	depends on MTK_COMBO_COMM
	tristate "Common interface SDIO"
	help
	  Use SDIO for common part interface type

config MTK_COMBO_COMM_NPWR
	depends on MTK_COMBO_COMM
	bool "Enable NPWR support"
	default n
	help
	  Enable NPWR support of new power on swquence

config MTK_COMBO_COMM_APO
	depends on MTK_COMBO_COMM
	bool "Enable always power on support"
	default y
	help
	  Enable chip will always power on

config MTK_COMBO_BT
	tristate "MediaTek Combo Chip BT driver"
	depends on MTK_COMBO
	help
	  MTK BT /dev/stpbt driver for Bluedroid

config MTK_COMBO_ANT
	tristate "MediaTek Combo Chip ANT driver"
	depends on MTK_COMBO
	help
	  MTK ANT /dev/stpant driver for ANT

config MTK_COMBO_BT_HCI
	tristate "MediaTek Combo Chip BlueZ driver"
	depends on BT && MTK_COMBO
	help
	  MTK BT driver for BlueZ

config MTK_COMBO_GPS
	tristate "MediaTek Combo Chip GPS driver"
	depends on MTK_COMBO
	help
	  MTK GPS /dev/stpgps driver

config MTK_COMBO_WIFI
	tristate "MediaTek combo chip Wi-Fi support"
	depends on MTK_COMBO
	depends on !mt592x
	select WIRELESS_EXT
	select WEXT_PRIV

config MTK_WAPI_SUPPORT
	bool "MTK_WAPI_SUPPORT"
	help
	  if it is set to TRUE: Support WAPI (WLAN Authentication and
	  Privacy Infrastructure)

config MTK_PASSPOINT_R1_SUPPORT
	bool "MTK_PASSPOINT_R1_SUPPORT"
	help
	  Support Passpoint R1 (Hotspot 2.0 R1)

config MTK_PASSPOINT_R2_SUPPORT
	bool "MTK_PASSPOINT_R2_SUPPORT"
	help
	   Support Passpoint R2

config MTK_WIFI_MCC_SUPPORT
	bool "MTK_WIFI_MCC_SUPPORT"
	default y
	help
	   if it is set to TRUE, wlan will support Multi-Channel Concurrency,
	   otherwise, only support Single Channel Concurrency

config MTK_DHCPV6C_WIFI
	bool "MTK_DHCPV6C_WIFI"
	help
	  no: disable this feature

config MTK_WFD_SUPPORT
	bool "MTK_WFD_SUPPORT"
	help
	  Wi-Fi Display Switch

config MTK_CONN_LTE_IDC_SUPPORT
	bool "MediaTek CONN LTE IDC support"
	select MTK_CONN_MD
	default y
	help
	  This option enables CONN LTE IDC support
```

## drivers/misc/mediatek/cqdma/Kconfig
```kconfig
config MTK_CQDMA
	bool "Enable MTK CQDMA Driver"
	default n
	help
	  The purpose of Mediatek cqdma is performing data transfer
	  between external memory such as LPDDR3.
```

## drivers/misc/mediatek/debug_latch/Kconfig
```kconfig
menuconfig MTK_DEBUG_LATCH
	bool "MediaTek Debug Latch Configuration"
	help
	  Select to enable MediaTek Debug Latch configuration.
	  Includes LASTPC and LASTBUS module for latching the
	  system status.

if  MTK_DEBUG_LATCH

config MTK_LASTPC
	bool "MediaTek LASTPC LATCH"
	default n
	help
	  LASTPC is a debugging feature on MCUCFG bus.
	  Which latches the last pc value on each CPUs as debugging
	  information after sysytem unexpectedly crash or shutdown.
	  After rebooting, these information could be dumped for
	  debugging.

config MTK_LASTBUS
	bool "MediaTek LASTBUS LATCH"
	default n
	help
	  LASTBUS is a debugging feature on MCUSYS and PERISYS bus.
	  Which latches the last bus status as debugging information
	  after sysytem unexpectedly crash or shutdown.
	  After rebooting, these information could be dumped for
	  debugging.

endif
```

## drivers/misc/mediatek/debug_tracer/Kconfig
```kconfig
menuconfig MTK_DEBUG_TRACER
	bool "MediaTek Debug Tracer Configuration"
	help
	  Select to enable MediaTek Debug Tracer configuration.
	  Includes BUS_TRACER module and MCSI_B_TRACER module
	  for recording the historical information to debug

if  MTK_DEBUG_TRACER

config MTK_BUS_TRACER
	bool "MediaTek BUS TRACER"
	default n
	help
	  BUS TRACER is a debugging feature to record the historical
	  information on bus. After rebooting, these information could
	  be dumped for debugging. It can also debug with watchpoint,
	  bypass, id, and rw filters

config MTK_MCSI_B_TRACER
	bool "MediaTek MCSI-B TRACER"
	default n
	help
	  MCSI-B TRACER is a debugging feature to record the historical
	  information on MCSI-B. After rebooting, these information could
	  be dumped for debugging.

endif
```

## drivers/misc/mediatek/devinfo/Kconfig
```kconfig
config MTK_DEVINFO_DRIVER
	bool "Enable MTK EFUSE driver"
	default y
	help
	  EFUSE driver is a must
```

## drivers/misc/mediatek/dfrc/Kconfig
```kconfig
config MTK_DYNAMIC_FPS_SUPPORT
	bool "support dynamic fps"
	select MTK_DYNAMIC_FPS_FRAMEWORK_SUPPORT
	default n
	help
	  Decide whether to support dynamic fps.
	  If enable this config, dynamic fps clients base on scenario to adjust
	  system fps.
	  When enable this config, it also need to enable the feature option
	  "MTK_DYNAMIC_FPS_SUPPORT", otherwise some clients do not work.

config MTK_DYNAMIC_FPS_FRAMEWORK_SUPPORT
	bool "enable framework of dynamic fps"
	default n
	help
	  Decide whether to build the framework of dynamic fps.
	  If enable this config, basic modules can adjust refresh rate of
	  system through GPU or display driver.
	  When enable this config, it also need to enable the feature option
	  "MTK_DYNAMIC_FPS_FRAMEWORK_SUPPORT", otherwise this feature work abnormally.
```

## drivers/misc/mediatek/dramc/Kconfig
```kconfig
config MTK_DRAMC
	tristate "MediaTek DRAMC driver"
	default n
	---help---
	  This selects the MediaTek(R) DRAMC driver.
	  incude the following API
	  PASR
	  DVFS


config MTK_DRAMC_PASR
	bool "Mediatek DRAMC PASR control"
	default n
	help
	  Mediatek(R) PASR HW control.
	  This controls the setting of DRAM mode register
	  for PASR(Partial Array Self-Refresh).
	  Caller needs to prepare bit-mask setting of DRAM
	  segment to trigger PASR.
```

## drivers/misc/mediatek/dum-char/Kconfig
```kconfig
config MTK_DUM_CHAR
	bool CONFIG_MTK_DUM_CHAR
	default n
	help
	  Enable dum-char only on nand platform.
```

## drivers/misc/mediatek/dxcc/Kconfig
```kconfig
config CRYPTO_DEV_DX_CC63P
	tristate "Dxcc Crypto driver driver"
	default n
	---help---
	  DXCC is a crypto engine by ARM.
	  DXCC provides hardware acceleration of AEAD, cipher, hash, etc.
	  This selects the DXCC crypto driver.
	  If you want to use DXCC crypto, say Y or M here.
	  If unsure, say N.
```

## drivers/misc/mediatek/eccci/Kconfig
```kconfig
config MTK_ECCCI_DRIVER
	tristate "Enable Evolved CCCI Driver as interface for modem"
	depends on MTK_CCCI_DEVICES
	select MTK_NET_CCMNI
	help
	  This option enables ECCCI device driver support, if yes,
	  then modem1 is using eccci driver, if no,
	  eccci driver is disabled.
	  The option default disabled.

config MTK_ECCCI_CLDMA
	tristate "ECCCI driver using CLDMA HW to communicate with LTE modem"
	depends on MTK_ECCCI_DRIVER
	default y
	help
	  This option enables ECCCI CLDMA driver, if yes,
	  then modem1 is using cldma hardware, if no,
	  cldma hardware is disabled.
	  The option default disabled.

config MTK_ECCCI_CCIF
	tristate "ECCCI driver using CCIF HW to communicate with LTE modem"
	depends on MTK_ECCCI_DRIVER
	help
	  This option enables ECCCI CCIF driver, if yes,
	  then modem1 is using ccif hardware, if no,
	  ccif hardware is disabled,
	  The option default disabled.

config MTK_ECCCI_C2K
	bool "ECCCI driver using CCIF HW to communicate with C2K modem"
	depends on MTK_ECCCI_DRIVER
	help
	  This option enables ECCCI CCIF C2K driver, if yes,
	  c2k modem is enabled, if no,
	  c2k modem is disabled,
	  The option default disabled.

config MTK_ECCCI_C2K_USB
	tristate "ECCCI USB driver using CCIF HW to communicate with C2K modem"
	depends on MTK_ECCCI_DRIVER
	help
	  This option enables ECCCI CCIF C2K's USB driver, if yes,
	  c2k modem is enabled, if no,
	  c2k modem is disabled,
	  The option default disabled.

config MTK_SIM_LOCK_POWER_ON_WRITE_PROTECT
	bool "sim lock poweron write protect"
	help
	  To support SIM lock power on write protect  feature, if yes,
	  then it is supported, if no,
	  it is disabled.
	  The option default disabled.

config MOTO_TESLA_SWTP_CUST
	bool "ECCCI tesla swtp customization"
	depends on MTK_ECCCI_DRIVER
	help
	  This option enables tesla swtp customization, if yes,
	  then it is supported, if no,
	  it is disabled.
	  The option default disabled.

config MOTO_DISABLE_SWTP_FACTORY
	bool "ECCCI tesla swtp customization"
	depends on MTK_ECCCI_DRIVER
	help
	  This option enables devonn swtp customization, if yes,
	  then it is supported, if no,
	  it is disabled.
	  The option default disabled.

config MOTO_DEVONN_SWTP_CUST
	bool "ECCCI tesla swtp customization"
	depends on MTK_ECCCI_DRIVER
	help
	  This option enables devonn swtp customization, if yes,
	  then it is supported, if no,
	  it is disabled.
	  The option default disabled.

config MOTO_DEVONF_SWTP_CUST
	bool "ECCCI devonf swtp customization"
	depends on MTK_ECCCI_DRIVER
	help
	  This option enables devonf swtp customization, if yes,
	  then it is supported, if no,
	  it is disabled.
	  The option default disabled.

config MOTO_AION_SWTP_CUST
	bool "ECCCI aion swtp customization"
	depends on MTK_ECCCI_DRIVER
	help
	  This option enables tesla swtp customization, if yes,
	  then it is supported, if no,
	  it is disabled.
	  The option default disabled.

config MOTO_MANAUS_SWTP_CUST
	bool "ECCCI manaus swtp customization"
	depends on MTK_ECCCI_DRIVER
	help
	  This option enables manaus swtp customization, if yes,
	  then it is supported, if no,
	  it is disabled.
	  The option default disabled.

config MOTO_CANCUNF_SWTP_CUST
	bool "ECCCI cancunf swtp customization"
	depends on MTK_ECCCI_DRIVER
	help
	  This option enables cancunf swtp customization, if yes,
	  then it is supported, if no,
	  it is disabled.
	  The option default disabled.

config MOTO_TAIPEI_SWTP_CUST
	bool "ECCCI taipei swtp customization"
	depends on MTK_ECCCI_DRIVER
	help
	  This option enables taipei swtp customization, if yes,
	  then it is supported, if no,
	  it is disabled.
	  The option default disabled.

config MOTO_CANCUNN_SWTP_CUST
	bool "ECCCI cancunn swtp customization"
	depends on MTK_ECCCI_DRIVER
	help
	  This option enables cancunn swtp customization, if yes,
	  then it is supported, if no,
	  it is disabled.
	  The option default disabled.

config MOTO_BYPSS_RF_CABLE_DETECT_SUPPORT
	bool "ECCCI by pass rfcable detection"
	depends on MTK_ECCCI_DRIVER
	help
	  This option enables bypass rfcable detection, if yes,
	  then it is supported, if no,
	  it is disabled.
	  The option default disabled.
```

## drivers/misc/mediatek/emi/Kconfig
```kconfig
config MTK_EMI
	bool "EMI driver"
	default n
	help
	  This config enable/disable EMI driver, which includes
	  bandwidth limiter (BWL), memory protect unit (MPU),
	  and EMI latency monitor (ELM).
```

## drivers/misc/mediatek/emi_bwl/Kconfig
```kconfig
config MTK_EMI_BWL
  bool "enable MTK_EMI_BWL"
  default y
  help
    This enable MTK_EMI_BWL

config MTK_COMMON_EMI
	bool "common emi driver for 8127/2701/7623"
	help
	  This enable 8127/7623/2701 common emi driver.
```

## drivers/misc/mediatek/emi_mbw/Kconfig
```kconfig
config MTK_EMI_MBW
  bool CONFIG_MTK_EMI_MBW
  default y
  help
    CONFIG_MTK_EMI_MBW
```

## drivers/misc/mediatek/emi_mpu/Kconfig
```kconfig
config MTK_EMI_MPU
  bool "enable MTK_EMI_MPU"
  default y
  help
    This enable MTK_EMI_MPU
```

## drivers/misc/mediatek/exm/Kconfig
```kconfig
config MTK_EXTMEM
	bool "mtk external memory"
	default n
	depends on MTK_INTERNAL
	help
	  external memory is unused DRAM memory, example:
	  DRAM 1GB, system uses 512MB, the left 512MB is seen
	  as external memory, it only exists in gmo projects.
	  Some debug features can use external memory to save
	  normal memory usage
```

## drivers/misc/mediatek/fde_aes/Kconfig
```kconfig
config MTK_HW_FDE_AES
	tristate "MediaTek FDE AES support"
	default n
	select MTK_HW_FDE
	help
	  This selects the MediaTek Full Disk Encryption support
	  Full Disk Encryption (FDE) to accelerate the performance.
	  Interface. If you have a machine with a MTK FDE AES
	  reader, say Y or M here. If unsure, say N.
```

## drivers/misc/mediatek/flashlight/Kconfig
```kconfig
config MTK_FLASHLIGHT
  bool CONFIG_MTK_FLASHLIGHT
  default n
  help
    CONFIG_MTK_FLASHLIGHT

config CUSTOM_KERNEL_FLASHLIGHT
        string "CUSTOM_KERNEL_FLASHLIGHT"
        help
          Kernel space cameara flashlight driver. You can use this driver
          choose cameara flashlight type.
```
