## drivers/misc/mediatek/pmic/rt5081a/Kconfig
```kconfig
config MFD_RT5081A_PMU
	bool "Support for RT5081A PMU part"
	depends on I2C
	select MFD_CORE
	select RT_REGMAP
	help
	  Select Y
	  to enable
	  support
	  for RT5081A PMU.

config RT5081A_PMU_CHARGER
	bool "RT5081A PMU Charger Part"
	depends on MFD_RT5081A_PMU
	select MTK_SWITCH_INPUT_OUTPUT_CURRENT_SUPPORT
	select MTK_CHARGER_INTERFACE
	help
	  Say Y here
	  to enable
	  supprot for RT5081A
	  charger device.

config RT5081A_PMU_CHARGER_TYPE_DETECT
	bool "RT5081A PMU Charger Type Detect"
	depends on RT5081A_PMU_CHARGER
	depends on MTK_EXTERNAL_CHARGER_TYPE_DETECT
	default MTK_EXTERNAL_CHARGER_TYPE_DETECT
	help
	  Say Y here
	  to enable
	  supprot for RT5081A
	  charger type detect.

config RT5081A_PMU_FLED
	bool "RT5081A PMU FLED Part"
	depends on LEDS_CLASS && MFD_RT5081A_PMU
	select FLASHLIGHT
	select RT_FLASHLIGHT
	help
	  Say Y here
	  to enable
	  supprot for
	  RT5081A fled device.

config RT5081A_PMU_BLED
	bool "RT5081A PMU BLED Part"
	depends on LEDS_CLASS && MFD_RT5081A_PMU
	help
	  Say Y here
	  to enable supprot
	  for
	  RT5081A bled device.

config RT5081A_PMU_RGBLED
	bool "RT5081A PMU RGBLED Part"
	depends on LEDS_CLASS && MFD_RT5081A_PMU
	help
	  Say Y here
	  to enable supprot
	  for
	  RT5081A rgbled device.

config RT5081A_PMU_LDO
	bool "rt5081 PMU LDO Part"
	depends on REGULATOR && MFD_RT5081A_PMU
	help
	  Say Y here
	  to enable
	  support for
	  RT5081A ldo device.

config RT5081A_PMU_DSV
	bool "rt5081 PMU DSV Part"
	depends on REGULATOR && MFD_RT5081A_PMU
	help
	  Say Y here to
	  enable support
	  for
	  RT5081A dsv device.

config RT5081A_PMU_DSV_EXTPIN
	bool "rt5081 PMU DSV use external pin control"
	depends on RT5081A_PMU_DSV
	help
	  Say y here to
	  enable rt5081a pmu dsv external pin control
	  Say n here to
	  disable rt5081a pmu dsv external pin control
```

## drivers/misc/mediatek/pmic_wrap/Kconfig
```kconfig
config MTK_PMIC_WRAP
	tristate "MediaTek PMIC_WRAP driver"
	default y
	---help---
	  MediaTek PMIC_WRAP driver.
	  The PMIC wrapper serves as the bridge for communication between AP and PMIC.
	  Set y to support this driver.
	  Set n and choose other chargers.
```

## drivers/misc/mediatek/power-loss-test/Kconfig
```kconfig
# For power loss test
menuconfig PWR_LOSS_MTK_TEST
	tristate "Power Loss Test"
	default n
	help
	  Enable power loss test driver and suuport in MTK NAND driver or MTK
	  EMMC driver. This is only for testing purpose and shall not be
	  enabled in kernel used by end user.

config PWR_LOSS_MTK_DEBUG
	bool "Debugging"
	depends on PWR_LOSS_MTK_TEST
	help
	  Enable low-level debugging message in power loss test driver.
	  Say Y if you turn on PWR_LOSS_MTK_TEST and want to turns on
	  low-level debugging.
	  Defalut is N.

config PWR_LOSS_MTK_SPOH
	bool "Power Loss Test Version SPOH"
	depends on PWR_LOSS_MTK_TEST
	default n
	help
	  Enable new power loss test driver (named SPOH) and suuport in MTK
	  NAND driver or MTK EMMC driver.Say Y if you will run power loss
	  test cases designed for SPOH.
	  Default is N.
```

## drivers/misc/mediatek/power/Kconfig
```kconfig
# Power Related
config MTK_PMIC
	bool "MediaTek PMIC driver"
	default y
	---help---
	  MediaTek PMIC driver.
	  Set y to support this driver.
	  Set n and choose other chargers.
	  This driver uses MTK_PWRAP.

config MTK_CHARGER_INTERFACE
	bool "Mediatek Charger Interface"
	default n
	---help---
	  Mediatek Charger Interface.
	  Say y to support this module.
	  Say n and choose other chargers and interface.
	  Do not select this module if you've ported your own interface.

config MTK_RT9466_SUPPORT
	bool "Mediatek Richtek RT9466 driver"
	select MTK_SWITCH_INPUT_OUTPUT_CURRENT_SUPPORT
	select MTK_CHARGER_INTERFACE
	default n
	---help---
	  Mediatek Richtek RT9466 driver.
	  Say y to support this driver.
	  Say n and choose other chargers.
	  This driver uses I2C bus.

config MTK_RT9468_SUPPORT
	bool "Mediatek Richtek RT9466 driver"
	select MTK_SWITCH_INPUT_OUTPUT_CURRENT_SUPPORT
	select MTK_CHARGER_INTERFACE
	default n
	---help---
	  Mediatek Richtek RT9468 driver.
	  Say y to support this driver.
	  Say n and choose other chargers.
	  This driver uses I2C bus.

config MTK_BQ25896_SUPPORT
	bool "Mediatek TI BQ25896 driver"
	select MTK_SWITCH_INPUT_OUTPUT_CURRENT_SUPPORT
	default n
	---help---
	Mediatek TI BQ25896 driver.
	Set y to support this driver.
	Set n and choose other chargers.
	This driver uses I2c bus.

config MTK_BQ25898_DUAL_SUPPORT
	bool "Mediatek dual TI BQ25896 driver"
	select MTK_SWITCH_INPUT_OUTPUT_CURRENT_SUPPORT
	default n
	---help---
	Mediatek TI BQ25898D driver.
	Set y to support this driver.
	Set n and choose other chargers.
	This driver uses I2c bus.

config MTK_SWITCH_INPUT_OUTPUT_CURRENT_SUPPORT
	bool "Mediatek allow to configure input/charging current"
	default n
	---help---
	Mediatek switch charger input output current.
	Set y to support.
	Set n to disable.
	switch charger often supports this feature.

config MTK_WIRELESS_CHARGER_SUPPORT
	bool "Mediatek Wireless charger driver"
	default n
	---help---
	yes : support wireless charger feature, it can show the wireless
	charging animation and charging icon when receive wireless charger
	plug-in. no: not support wireless charger feature, stay with
	legancy feature, which cannot sense the exist of the wireles
	charger.

config MTK_POWER_EXT_DETECT
	bool "MediaTek Power Ext detect"
	default n
	---help---
	EVB/Phone share load configration.
	Require one GPIO to do detection,
	GPIO high mean EVB, otherwise mean phone platform.
```

## drivers/misc/mediatek/power/mt6797/Kconfig
```kconfig
config MTK_GPUREGULATOR_INTF
	bool "MTK Reaulator Richtek Chip INTF"
	---help---
	  This driver provide MTK
	  GPU Regulator
	  support.
	  from Richtek.

config REGULATOR_RT5735
	bool "RT5735 Regulator As External BUCK for GPU"
	select MTK_GPUREGULATOR_INTF
	default y
	---help---
	  Say Y here
	  to enable support
	  RT5735 Regulator
	  from Richtek
```

## drivers/misc/mediatek/reg_monitor/Kconfig
```kconfig
config REG_MONITOR_DRIVER
	default y
	tristate "Reg Monitor Driver"
	help
	  Say Y here if you want to enable reg monitor driver.
	  Which is for monitoring register accessing through pmic wrapper.
```

## drivers/misc/mediatek/rgbw/Kconfig
```kconfig
config CUSTOM_KERNEL_RGBW
	bool "KERNEL RGBW Sensor Driver Configure"
	help
	  ALSPS color sensor driver to detect RGBW light.
	  After configure this configuration,
	  the specific RGBW color sensor driver configuration
	  should be configured as well.

source "drivers/misc/mediatek/rgbw/cm36652-new/Kconfig"
```

## drivers/misc/mediatek/rgbw/cm36652-new/Kconfig
```kconfig
config MTK_CM36652_NEW_RGBW
	tristate "cm36652 RGBW for MediaTek package"
	default n
	help
	  It support RGBW color sensor
	  in this platform. If this option
	  is set, it will support RGBW color
	  sensor function of ambient
	  and light sensor CM36652.
```

## drivers/misc/mediatek/rotationvector/Kconfig
```kconfig
config CUSTOM_KERNEL_RV_SENSOR
	bool "CUSTOM_KERNEL_RV_SENSOR"
	help
	  Kernel space rotation vector sensor driver.
```

## drivers/misc/mediatek/rrc/Kconfig
```kconfig
# RRC
config MTK_RRC
	bool "MediaTek RRC Driver"
	default n
	help
	  RRC(Refresh Rate Controller) is a display tcehnology that automatically switch display refresh rate for
	  smoother and clearer user experience.
```

## drivers/misc/mediatek/rt-flashlight/Kconfig
```kconfig
config RT_FLASHLIGHT
	bool "Richtek Flashlight Device Class"
	default n
	help
	  Say Y
	  to enable
	  Richtek
	  Flashlight Device Class
```

## drivers/misc/mediatek/rt-regmap/Kconfig
```kconfig
config RT_REGMAP
	bool "Richtek regmap"
	default n
	help
	  Say Y to enable Richtek regmap
	  This config decide to use regmap easy
	  for debug in RT chip.
```

## drivers/misc/mediatek/rtc/Kconfig
```kconfig
# RTC Related
config MTK_RTC
	bool "MediaTek Real Time Clock Support"
	default n
	---help---
	  MediaTek RTC driver
# shaohui add for RPMB trigger
config LCT_RPMB_TRIGGER
	bool "MediaTek RPMB trigger by RTC"
	default n
	---help---
	  MediaTek RPMB trigger
```

## drivers/misc/mediatek/sar_sensor/sx9310/Kconfig
```kconfig
config SAR_SENSOR_SX9310
	tristate "SX9310_SAR_sensor"
	depends on I2C
	default y
	help
	  Say Y to enable the SAR detection application, if N here not to use the
	  this SAR sensor
```
