## drivers/misc/mediatek/sched/Kconfig
```kconfig
menu "MTK runqueue statistic calculation and CPU affinity"
config MTK_CPU_AFFINITY
	bool "Enhance CPU affinity in hotplug"
	depends on HOTPLUG_CPU
	help
	  The CPU affinity library for Hotplug enhancement
	  is to achieve set CPU affinity without take care
	  kernel behavior and to avoid affect the original
	  Linux design.

config MTK_USER_SPACE_GLOBAL_CPUSET
	bool "Enable user space global cpuset"
	depends on CPUSETS
	default n
	help
		Interface for set user space global cpuset:
		1. User can use user space global cpuset to set
		   cpuset mask of all child group.
		2. When unset, child cpuset will restore by cpus.

endmenu

menu "MTK load balance and schedule enhancement"
config MTK_LOAD_BALANCE_ENHANCEMENT
	bool "mtk load balance enhancement"
	depends on SMP
	default n
	help
	  Mediatek aggressive load balance, include
	   1. shorten the schedule migration cost and let the idle balance more aggregative,
	   2. aggressive load balance in hmp noHz.
	   3. aggressive cluster-migration in idle balancing & GTS balacing

config MTK_SCHED_INTEROP
	bool "mtk scheduling interopation enhancement"
	default n
	help
	   Original Linux Design, RT & CFS do load balance seperatedly,
	   and let would result in unload balance.
	   that is, one CPU has more than 2 tasks, however, one CPU is IDLE
	   We make RT & CFS to check each other and make load more balance.

config MTK_SCHED_TRACE
	bool "mt scheduling trace, output mtk schedule trace into FTRACE"
	default n
	help
	   Provide RT info via ftrace,
	   mt_sched_printf for scheduling module to output info and
	   RT scheduling info to ftrace,
	   including select_task_rq, check_preempt, find_lowest_rq.
	   Say no if not sure.

config MTK_SCHED_DEBUG
	bool "mt scheduling log, also output the scheduling log into Kernel log"
	depends on MTK_SCHED_TRACE
	default n
	help
	   MTK scheduling log, add scheduling log into Kernel log.
	   Including print scheduler debug information at KE and print load balance
	   information at kernel log.
	   Say no if not sure.

config MTK_DEBUG_PREEMPT
	bool "debug preempt, output the preempt enable/disable to FTRACE"
	default n
	help
	   Provide preempt debug.
	   Dump preempt disable/enable backtrace into ftrace.
	   Dump preempt count in kernel log.
	   Say no if not sure.

config MTK_RT_THROTTLE_MON
	bool "mt rt throttle monitor"
	default n
	help
	  MTK_RT_THROTTLE_MON is used to monitor rt throttle. When rt throttle activated
	  print 5 longest execusion time rt tasks. Say Y here to enable rt throttle
	  monitor. If you are not sure about whether to enable it or not, please set n.

endmenu

menu "MTK Cluster MultiProcessor Scheduler"
config MTK_CPU_TOPOLOGY
	bool "MTK cpu topology infrastructure"
	depends on (64BIT && OF && SMP) || (ARM_CPU_TOPOLOGY && OF)
	default n
	help
	  Say N if you want to build up another wheel
	  sched_init -> cmp_cputopo_domain_seutp()
	  rest_init -> fork kernel_init -> kernel_init_freeable ... -> parse_dt_topology
	  we focus to build up cpu topology and domain before scheduler runs.
endmenu

menu "MTK runqueue statistic calculation"
config MTK_SCHED_RQAVG_KS
	bool "Enable runqueue statistic calculation used in kernel space operation"
	depends on SMP
	help
		MTK ruqueue statistic kernel space CPUfreq governors, e.g., hotplug
		TLP estimation,
		heavy task detection and
		per CPU load for kernel space CPUfreq governors

config MTK_SCHED_RQAVG_US
	bool "Enable runqueue staticsic calculation used in user space operation"
	depends on SMP && HIGH_RES_TIMERS
	help
		MTK runqueue staticsic calculation
		used in user space operation.
		TLP estimation for user space
		CPUfreq governors.

config MTK_SCHED_CPULOAD
	bool "Enable timing-base CPU loading tracking in scheduler"
	depends on MTK_SCHED_RQAVG_US
	help
		Support timing-base CPU loading tracking
		in scheduler tick.
		Which helps load tracking in time-base view
		and more quick response in loading change.

config MTK_SCHED_SYSHINT
	bool "Enable asynchronus hint for external modules to get loading change in time"
	depends on MTK_ACAO_SUPPORT
	help
		Support asynchronus hint for external modules
		to get loading change notification from scheduler
		in time that helps resource control
		in low latency.
endmenu

menu "MTK Energy Aware Scheduler Plus"

config MTK_SCHED_EAS_PLUS
	bool "(EXPERIMENTAL) Energy Aware Scheduling"
	depends on SCHED_MC
	help
		Experimental scheduler optimizations in heterogeneous platforms for
		energy-awared. Attempts to introspectively select task affinity to
		optimize power and performance according to power estimation.
		There is currently support for Hotplug and all core all online.

config MTK_SCHED_EAS_POWER_SUPPORT
	bool "Enable MTK power calculation for EAS"
	depends on MTK_SCHED_EAS_PLUS
	default n
	help
		Power calculation for mtk Soc.
		According to platform characters(share-buck..etc),
		return correct power of core and cluster for
		scheduler to refer.

config MTK_SCHED_VIP_TASKS
	bool "Enable VIP task cgroup for special schedule (EXPERIMENTAL)"
	depends on SCHED_TUNE && CGROUP_SCHEDTUNE
	default n
	help
		VIP tasks of special cgroup favor use big-core.
		The user can apply pid to vip group via vip_task_set(set or not).
		Boost value of vip is synced with foreground for performance request.
		 1) wake up: higher idle cpu for vip task.
		 2) idle balance: pull runnable vip task.
		 3) migrating running vip to higher idle cpu.
endmenu

menu "MTK Heterogenous MultiProcessor Scheduler"

config SCHED_HMP
	bool "(EXPERIMENTAL) Heterogenous multiprocessor scheduling"
	depends on SCHED_MC && FAIR_GROUP_SCHED && !SCHED_AUTOGROUP
	help
	  Experimental scheduler optimizations for heterogeneous platforms.
	  Attempts to introspectively select task affinity to optimize power
	  and performance. Basic support for multiple (>2) cpu types is in place,
	  but it has only been tested with two types of cpus.
	  There is currently no support for migration of task groups, hence
	  !SCHED_AUTOGROUP.

config SCHED_HMP_PRIO_FILTER
	bool "(EXPERIMENTAL) Filter HMP migrations by task priority"
	help
	  Enables task priority based HMP migration filter. Any task with
	  a NICE value above the threshold will always be on low-power cpus
	  with less compute capacity.
	  If unsure say N here.

config SCHED_HMP_PRIO_FILTER_VAL
	int "NICE priority threshold"
	default 5
	depends on SCHED_HMP_PRIO_FILTER

config HMP_FREQUENCY_INVARIANT_SCALE
	bool "(EXPERIMENTAL) Frequency-Invariant Tracked Load for HMP"
	depends on !ARCH_SCALE_INVARIANT_CPU_CAPACITY
	help
	  Scales the current load contribution in line with the frequency
	  of the CPU that the task was executed on.
	  In this version, we use a simple linear scale derived from the
	  maximum frequency reported by CPUFreq.
	  Restricting tracked load to be scaled by the CPU's frequency
	  represents the consumption of possible compute capacity
	  (rather than consumption of actual instantaneous capacity as
	   normal) and allows the HMP migration's simple threshold
	  migration strategy to interact more predictably with CPUFreq's
	  asynchronous compute capacity changes.

config HMP_TRACER
	bool "(EXPERIMENTAL) Profile HMP scheduler"
	help
	  Profile HMP scheduler
	  Trace the update of cfs rq, load, and hmp_statisics to evaluate if
	  the schedule decision is as expected.
	  If unsure say N here.

config SCHED_HMP_PLUS
	bool "(EXPERIMENTAL) Corepilot enhancement"
	depends on SCHED_HMP
	default n
	help
	  Corepilot hmp enhancement.
	  1. Do hmp_idle_pull at idle_balance
	  2. At global balance, consider the tasks in rq, move heaviest/lightest
	  of first 5 tasks in rq.
	  3. Enhance down migration rule: Do not migrate task when big core
	  is idle
endmenu
```

## drivers/misc/mediatek/secmem/Kconfig
```kconfig
#
# Secure Memory configuration
#
config MTK_LEGACY_SECMEM_SUPPORT
	tristate "MTK Legacy SECURE Memory Support"
	depends on TRUSTONIC_TEE_SUPPORT || CONFIG_MTK_TEE_GP_SUPPORT
	default y if !(MACH_MT6771 || MACH_MT6765 || MACH_MT6761)
	help
	  Enable the support of MediaTek legacy secure memory driver.
	  This driver is in charge of secure memory region require/release
	  from SSMR and also the memory allocation/free requests from ION.
	  It is a proxy of TEE secure memory driver for secure memory management.
	  Say Y if you would like to enable this feature.
	  If unsure, say N.

config MTK_SVP_DISABLE_SODI
	tristate "Disable SODI while SVP playback"
	depends on TRUSTONIC_TEE_SUPPORT
	default n
	help
	  System will enter screen on device idle (SODI) while secure
	  video playback (SVP) playback in some specific project/platform,
	  and this will cause video playback hang issues. (depending on
	  Trustonic TEE Support or Microtrust TEE Support or other 3rd-party TEE)
```

## drivers/misc/mediatek/selinux_warning/Kconfig
```kconfig
config MTK_SELINUX_AEE_WARNING
	bool "Enable SELinux AEE Warning "
	depends on SECURITY_SELINUX
	default n
	---help---
	  This option enables SELinux violation AEE warning.

config MTK_ROOT_TRACE
        bool "Enable root trace for uid 0 "
        default n
        ---help---
          This option enables root trace, covering uid x to uid 0 for all uids, excluding fs uid.
```

## drivers/misc/mediatek/sensor/2.0/Kconfig
```kconfig
# SPDX-License-Identifier: GPL-2.0

config MOTO_ALGO_PARAMS
	bool "algo params for moto sensor algo"
	default n
	help
	  This feature Option is used for open/close moto sensor algo parms.

config MOTO_CHOPCHOP_PARAMS
	bool "algo params for moto chopchop algo"
	default n
	help
	  This feature Option is used for open/close moto chopchop algo parms.

config MOTO_CAMGEST_PARAMS
	bool "algo params for moto camgest algo"
	default n
	help
	  This feature Option is used for open/close moto camgest algo parms.

config MOTO_GLANCE_PARAMS
	bool "algo params for moto glance algo"
	default n
	help
	  This feature Option is used for open/close moto glance algo parms.

config MOTO_LTV_PARAMS
	bool "algo params for moto ltv algo"
	default n
	help
	  This feature Option is used for open/close moto ltv algo parms.

config MOTO_ALSPS_PARAMS
	bool "algo params for moto alsps algo"
	default n
	help
	  This feature Option is used for open/close moto alsps algo parms.

config MOTO_ALSPS_NVCFG
	bool "algo params for moto alsps nvcfg"
	default n
	help
	  This feature Option is used for open/close moto alsps nvcfg parms.

config MOTO_LIGHT_1_SENSOR
	bool "alternate light sensor"
	default n
	help
	  This feature Option is used for enable/disable moto alternate light sensor.

config MOTO_TAP_PARAMS
	bool "algo params for moto tap algo"
	default n
	help
	  This feature Option is used for open/close moto tap algo parms.

source "drivers/misc/mediatek/sensor/2.0/mtk_nanohub/Kconfig"
source "drivers/misc/mediatek/sensor/2.0/sensorhub/Kconfig"
source "drivers/misc/mediatek/sensor/2.0/test/Kconfig"
source "drivers/misc/mediatek/sensor/2.0/lsm6dsm_secondary/Kconfig"
```

## drivers/misc/mediatek/sensor_bio/Kconfig
```kconfig
source "drivers/misc/mediatek/sensor_bio/accelerometer/Kconfig"
source "drivers/misc/mediatek/sensor_bio/alsps/Kconfig"
source "drivers/misc/mediatek/sensor_bio/gyroscope/Kconfig"
source "drivers/misc/mediatek/sensor_bio/magnetometer/Kconfig"
source "drivers/misc/mediatek/sensor_bio/hwmon/Kconfig"
source "drivers/misc/mediatek/sensor_bio/barometer/Kconfig"
#source "drivers/misc/mediatek/sensor_bio/humidity/Kconfig"
source "drivers/misc/mediatek/sensor_bio/biometric/Kconfig"
```

## drivers/misc/mediatek/sensor_bio/barometer/Kconfig
```kconfig
config CUSTOM_KERNEL_BAROMETER
	bool "CUSTOM KERNEL BAROMETER Config"
	help
	  To detect barometer raw data

source "drivers/misc/mediatek/sensor_bio/barometer/barohub/Kconfig"
source "drivers/misc/mediatek/sensor_bio/barometer/BMP280-new/Kconfig"
```

## drivers/misc/mediatek/sensor_bio/biometric/Kconfig
```kconfig
config CUSTOM_KERNEL_BIOMETRIC_SENSOR
	bool "Support biometric sensor"
	help
	  biometric sensor to detect EKG(Electrocardiogram),
	  PPG(Photoplethysmogram ), etc.
	  If the platform is supported for biometric, this
	  configuration should be configured, and the biometric
	  driver configuration should be configured as well.

source "drivers/misc/mediatek/sensor_bio/biometric/mt6381/Kconfig"
```

## drivers/misc/mediatek/sensor_bio/biometric/mt6381/Kconfig
```kconfig
config MTK_MT6381
	bool "cm36558 for MediaTek package"
	default n
	help
	It support different type sensor
	in this platform. If this option
	is set, it will support ambient
	and light sensor MT6381.
```

## drivers/misc/mediatek/sensor_bio/gesture/Kconfig
```kconfig
config CUSTOM_KERNEL_GESTURE_SENSOR
	bool "CUSTOM_KERNEL_GESTURE_SENSOR"
	help
	  Kernel space support gesture sensor driver.

source "drivers/misc/mediatek/sensor_bio/gesture/stationary/Kconfig"
source "drivers/misc/mediatek/sensor_bio/gesture/inpocket/Kconfig"
source "drivers/misc/mediatek/sensor_bio/gesture/wake_gesture/Kconfig"
source "drivers/misc/mediatek/sensor_bio/gesture/glance_gesture/Kconfig"
source "drivers/misc/mediatek/sensor_bio/gesture/pickup_gesture/Kconfig"
source "drivers/misc/mediatek/sensor_bio/gesture/answercall/Kconfig"
```

## drivers/misc/mediatek/sensor_bio/gyroscope/Kconfig
```kconfig
config CUSTOM_KERNEL_GYROSCOPE
	bool "CUSTOM KERNEL GYROSCOPE Config"
	help
	  gyroscope sensor to detect gyroscope from x y z axis.
	  If the platform is supported for gyroscope, this
	  configuration should be configured, and the gyroscope
	  driver configuration should be configured as well.

source "drivers/misc/mediatek/sensor_bio/gyroscope/gyrohub/Kconfig"
source "drivers/misc/mediatek/sensor_bio/gyroscope/bmi160gy-spi/Kconfig"
```
