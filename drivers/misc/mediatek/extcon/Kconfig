## drivers/misc/mediatek/extcon/Kconfig
```kconfig
config EXTCON_MTK_USB
	tristate "MediaTek EXTCON USB Support"
	select EXTCON
	select USB_ROLE_SWITCH
	help
	  Say Y here to enable extcon support for USB cable detection
	  on the Mediatek PMIC.

config CP_CONTROL_MOS_AND_USB_MODULE_OUT_5V
	tristate "Motorola cp control mos and usb module out 5v  Support"
	help
	  Say M for Motorola cp control mos and usb module out 5v  Support
```

## drivers/misc/mediatek/typec/Kconfig
```kconfig
#
# MediaTek USB TYPEC Driver
#

config MTK_USB_TYPEC
	tristate "Mediatek USB TYPE-C Driver"
	help
	  Enables to support usb-c. So the usb device and host driver register
	  the callback func to the usb-c driver. When the usb-c driver detect
	  a device/host plugged in/out, it will notify the device/host driver
	  by callback func.
	  If unsure, say N.

config TARGET_BUILD_FACTORY
	bool "Identify if it's a factory build"
	default n
	help
		Say Y here if it's a factory build for driver.

config MOTO_FACTORY_LPD
	bool "factory lpd support"
	default n
	help
		This is to enable MOTO supports of factory lpd feature.

source "drivers/misc/mediatek/typec/tcpc/Kconfig"

source "drivers/misc/mediatek/typec/mux/Kconfig"
```

## sound/soc/codecs/aw87564/Kconfig
```kconfig
config SND_SOC_AW87564
	tristate "SoC Audio for awinic AW87XXX Smart K PA"
	depends on I2C
	help
	  This option enables support for AW87XXX Smart K PA.
```

## sound/soc/codecs/fs1815/Kconfig
```kconfig
config SND_SOC_FS1815
	tristate "SoC Audio for awinic FS1815 Smart K PA"
	depends on I2C
	help
	  This option enables support for FS1815 Smart K PA.
```
