## drivers/misc/mediatek/alsps/lenovo_ltr778/Kconfig
```kconfig
config LENOVO_LTR778
	bool "LENOVO_LTR778 for MediaTek package"
	default n
	help
	It support different type sensor
	in this platform. If this option
	is set, it will support ambient
	and light sensor LENOVO_LTR778.
```

## drivers/misc/mediatek/alsps/ltr578/Kconfig
```kconfig
config MTK_LTR578
	tristate "cm36652 for MediaTek package"
	default n
	help
	  It support different type sensor
	  in this platform. If this option
	  is set, it will support ambient
	  and light sensor CM36652.
```

## drivers/misc/mediatek/alsps/ltr778/Kconfig
```kconfig
#tuwenzan@wind-mobi.com modify at 20161108 begin
config MTK_LTR778
	bool "MTK_LTR778 for MediaTek package"
	default n
	help
	It support different type sensor
	in this platform. If this option
	is set, it will support ambient
	and light sensor MTK_LTR778.
#tuwenzan@wind-mobi.com modify at 20161108 end
```

## drivers/misc/mediatek/alsps/mn66238tkdn/Kconfig
```kconfig
#tuwenzan@wind-mobi.com modify at 20161108 begin
config MTK_MN66238TKDN
	bool "MTK_MN66238TKDN for MediaTek package"
	default n
	help
	It support different type sensor
	in this platform. If this option
	is set, it will support ambient
	and light sensor MTK_MN66238TKDN.
#tuwenzan@wind-mobi.com modify at 20161108 end
```

## drivers/misc/mediatek/auxadc/Kconfig
```kconfig
config MTK_AUXADC
    tristate "MediaTek AUXADC driver"
    default y
    help
      AUXADC driver support for MediaTek SOC
      If you want to use MediaTek AUXADC driver, say Y or M here.If unsure, say N.

config AUXADC_NEED_POWER_ON
    tristate "Support MediaTek IC that need to enable power for AUXADC"
    depends on MTK_AUXADC
    help
      AUXADC driver support for MediaTek IC which need to enbale power.
      If you want to use MediaTek AUXADC driver to enable power for these IC, say Y or M here.If unsure, say N.
```

## drivers/misc/mediatek/barometer/Kconfig
```kconfig
config CUSTOM_KERNEL_BAROMETER
	bool "CUSTOM KERNEL BAROMETER sensoor support"
	help
	  To detect barometer raw data

source "drivers/misc/mediatek/barometer/barohub/Kconfig"
source "drivers/misc/mediatek/barometer/BMP280-new/Kconfig"
```

## drivers/misc/mediatek/base/power/Kconfig
```kconfig
config PROFILE_CPU
	bool "Support for CPU hot-plug profiling"
	default y
	help
	  This kernel config can be used to enable basic CPU hot-plug
	  latency for each one. This information is useful for someone who
	  care the latency, for example, thermal.
	  If unsure, say Y.

config MTK_CPU_HOTPLUG_DEBUG_0
	bool "MediaTek CPU Hotplug DEBUG 0"
	default y
	help
	  This kernel config can be used to enable log message in cpu notify
	  callback function in register_cpu_notifier. This is useful for CPU
	  hotplug debug.
	  If unsure, say Y.

config MTK_CPU_HOTPLUG_DEBUG_1
	bool "MediaTek CPU Hotplug DEBUG 1"
	default n
	help
	  This kernel config can be used to enable log message in cpu notify
	  callback function in notifier_call_chain. This is useful for CPU
	  hotplug debug but the performance will be drop down.
	  If unsure, say N.

config MTK_CPU_HOTPLUG_DEBUG_2
	bool "MediaTek CPU Hotplug DEBUG 2"
	default y
	help
	  This kernel config can be used to enable aee to log cpu notify
	  callback in notifier_call_chain. This is useful for CPU hotplug
	  debug.
	  If unsure, say Y.

config MTK_CPU_HOTPLUG_DEBUG_3
	bool "MediaTek CPU Hotplug DEBUG 3"
	default y
	help
	  This kernel config can be used to enable advanced CPU hot-plug
	  latency profiling. This information is useful for someone who
	  care the latency, for example, thermal.
	  If unsure, say Y.

config MTK_UNIFY_POWER
	bool "MTK UNIFY POWER"
	default n
	---help---
	  This kernel config can be used to enable unified power table.
	  This table can provide power data and capacity to someone who
	  need it.
	  If unsure, say Y.

config MTK_CM_MGR
	bool "MTK CM MGR"
	default n
	---help---
	  This kernel config can be used to enable CM MGR.
	  If unsure, say N.

config MTK_DISABLE_DRAM_FH_ERROR_LOG
	bool "MTK DISABLE DRAM FH ERROR LOG"
	default n
	---help---
	  This kernel config can be used to disable dram fh error log.
	  In order to avoid printk error logs quently, that caused by
	  32bit system run in 4G RAM, but 32bit system can't support
	  4G RAM, since Google’s CDD rule.
	  If unsure, say N.
```

## drivers/misc/mediatek/base/power/mcdi/Kconfig
```kconfig
config MTK_ACAO_SUPPORT
	bool "Enable MediaTek All Core Always Online"
	default n
	help
	  All Core Always Online is an option to keep
	  All CPU online, instead of frequently hotplug
	  on/off CPUs by hotplug sevice (HPS).
	  With MTK_ACAO_SUPPORT, CPU low power features will
	  implements in CPUidle framework
```

## drivers/misc/mediatek/base/power/mt6735/Kconfig
```kconfig
config CPU_DVFS_SYSTEM_BOOTUP_BOOST
	bool "cpu dvfs system bootup boost"
	default n
	help
		CPU_DVFS_SYSTEM_BOOTUP_BOOST is used to enhance system bootup time by fixing
		CPU at max CPU frequency before bootup procedure finished. Say y here to enable
		it and say n to disable it.
```

## drivers/misc/mediatek/bias/Kconfig
```kconfig
config PANEL_BIAS
	bool "Bias Support"
	default n
	help
	  This feature is used to configure the external bias chip

config PANEL_BIAS_LIST
	string "define bias chip"
	help
	  Choose which bias chip to use
```

## drivers/misc/mediatek/blocktag/Kconfig
```kconfig
#
# block tag trace
#

comment "Storage Block Tag"

config MTK_BLOCK_TAG
	bool "Storage Block Tag"
	depends on BLOCK
	default y
	help
	  Enable block tagging at block driver, tag requester pid to
	  the accessing pages. This allows MMC/UFS Block IO log to obtian
	  IO statistics of each process. The Block Tag also provides
	  utility functions to MMC/UFS Block IO log, such as throughput
	  calculation, log printing, and ring trace handling.

config MTK_PID_MAP
	bool "Map of PID and Task Name"
	help
	  Enable task name recorder to
	  provide more pid and task name mappings.
	  More memory will be required for this feature,
	  so please consider the trade-off.
```

## drivers/misc/mediatek/boot/Kconfig
```kconfig
config MTK_BOOT
	bool "Enable MTK Boot information Driver"
	default y
	help
	  Boot information driver includes specific information about booting process, such as boot mode.

config LCT_BOOT_REASON
	bool "enable lct boot reason"
	default n
```

## drivers/misc/mediatek/boot_reason/Kconfig
```kconfig
config MTK_BOOT_REASON
	bool "Enable MTK Boot Reason Driver"
	default y
	help
	  MTK Boot Reason Driver is in charge of returning boot reason passing from early booting stage

config LCT_BOOTINFO_SUPPORT
	bool "Enable LCT boot info"
	default n
	help
	  Based MTK Boot Reason Driver, designed for Lenovo(Moto).
```

## drivers/misc/mediatek/cam_cal/Kconfig
```kconfig
config MTK_CAM_CAL
  bool CONFIG_MTK_CAM_CAL
  default n
  help
    CONFIG_MTK_CAM_CAL define if the camera cal driver should be built in or not
#lenovo.sw START huangsh4 config taido camera
config MTK_CAM_CAL_IMX219OTP_SUPPORT
       bool "IMX219OTP EEPROM Driver"
       default n
#lenovo.sw END huangsh4 config taido camera
```

## drivers/misc/mediatek/camera_ldo/Kconfig
```kconfig
config MOT_CAMERA_LDO
	bool CONFIG_MOT_CAMERA_LDO
	default n
	help
	  MOT CAMERA LDO driver
```

## drivers/misc/mediatek/cameraisp/src/Kconfig
```kconfig
config MTK_CAMERA_ISP_CAMERA_SUPPORT
	tristate "[ISP] Image Signal Processor"
	depends on MTK_CAMERA_ISP
	help
	  Image Signal Processor.
	  Enable to do image Signal process.
	  Disable if it is not supported or
	  not wanted.

#Enable the P1 node to prevent dropped frames, this patch just for low performance chip,
#the relevant CR are IKSWS-137754 and ALPS07466003.
config MOTO_MAUI_PANORAMA_FRAMEDROPPED_PREVENT
        bool "Maui panorama frame dropped prevent"
        default n
        help
	  Image Signal Processor.
	  Enable P1 node to prevent dropped frames.
	  Disable if it is not supported or
	  not wanted.
```

## drivers/misc/mediatek/captouch/Kconfig
```kconfig
config LCT_CUSTOM_KERNEL_CAPSENSOR
	bool "LCT_CUSTOM_KERNEL_CAPSENSOR"
	default n
	help
	It support different type sensor
	in this platform. If this option
	is set, it will support ambient
	and light sensor MTK_SX9310.

source "drivers/misc/mediatek/captouch/LCT_sx9310/Kconfig"
```

## drivers/misc/mediatek/captouch/LCT_sx9310/Kconfig
```kconfig
config LCT_CAPSENSOR_SX9310

	bool "MTK_SX9311 for MediaTek package"
	default n
	help
	It support different type sensor
	in this platform. If this option
	is set, it will support ambient
	and light sensor MTK_SX9310.
```

## drivers/misc/mediatek/ccci_util/Kconfig
```kconfig
menuconfig MTK_CCCI_DEVICES
	bool "CCCI Devices"
	default y
	help
	  Say Y here to enable CCCI basic support.
	  If you say N, all CCCI related code (including dummy API) will be disable.

config MTK_ENABLE_MD1
	bool "MTK_ENABLE_MD1"
	depends on MTK_CCCI_DRIVER || MTK_CCCI_EXT || MTK_ECCCI_DRIVER
	default y
	help
	   Set to yes,
	   	   the first modem is enabled
	   Set to no,
	   	   the first modem is not enabled

config MTK_MD1_SUPPORT
	int "MTK_MD1_SUPPORT"
	depends on MTK_ENABLE_MD1
	default 3
	help
	  modem 1 mode:	1=>2g,2=>3g,3=>wg,4=>tg,5=>lwg,6=>ltg,7=>sglte,0=>invalid



config MD1_SIZE
	hex "MD1_SIZE"
	depends on MTK_ENABLE_MD1
	default 0x5000000
 	help
	   modem 1 memory size.



config MD1_SMEM_SIZE
	hex "MD1_SMEM_SIZE"
	depends on MTK_ENABLE_MD1
	default 0x200000
 	help
	   modem 1 share memory size.



config MTK_ENABLE_MD2
	bool "MTK_ENABLE_MD2"
	depends on MTK_CCCI_EXT || MTK_ECCCI_DRIVER
	default n
	help
	   Set to yes,
	   	   the second modem is enabled
	   Set to no,
	   	   the second modem is not enabled

config MTK_MD2_SUPPORT
	int "MTK_MD2_SUPPORT"
	depends on MTK_ENABLE_MD2
	default 1
	help
	  modem 2 mode:
		1=>2g,
		2=>3g,
		3=>wg,
		4=>tg,
		5=>lwg,
		6=>ltg,
		7=>sglte,
	 	0=>invalid

config MD2_SIZE
	hex "MD2_SIZE"
	depends on MTK_ENABLE_MD2
	default 0x1000000
 	help
	   modem 2 memory size.



config MD2_SMEM_SIZE
	hex "MD2_SMEM_SIZE"
	depends on MTK_ENABLE_MD2
	default 0x400000
	help
	   modem 2 share memory size.



config MTK_MD_SBP_CUSTOM_VALUE
	string "MTK_MD_SBP_CUSTOM_VALUE"
	default ""
	help
	  Disable MD SBP(Single Binary Platform) feature or not.
	  Defined: enable MD SBP feature.


config MTK_MD2_SBP_CUSTOM_VALUE
	string "MTK_MD2_SBP_CUSTOM_VALUE"
	default ""
	help
	  Disable MD2 SBP(Single Binary Platform) feature or not.
	  Defined: enable MD2 SBP feature.
```

## drivers/misc/mediatek/ccmni/Kconfig
```kconfig
config MTK_NET_CCMNI
	bool "MediaTek CCMNI driver"
	depends on MTK_CCCI_DEVICES
	default n
	select WIRELESS_EXT
	select WEXT_PRIV
	help
	  This option enables CCMNI driver,
	  if yes, then CCMNI driver is used to communicate with CCCI driver by Kernel network,
	  if no, Kernel network uses ccci port_net to send and recevie data.
	  The option default depends on MTK_CCCI_DEVICES.

config MTK_IRAT_SUPPORT
	bool "Mediatek IRAT feature support"
	depends on MTK_NET_CCMNI
	default n
	help
	  This option enables CCMNI driver,
	  if yes, then CCMNI & Modem driver support IRAT feature,
	  if no, CCMNI & Modem driver do not support IRAT feature.
	  The option default depends on MTK_CCCI_DEVICES.

config MTK_C2K_SLOT2_SUPPORT
	bool "Mediatek C2K SLOT2 feature support"
	default n
	help
	  This option enables CCMNI driver,
	  if yes, then CCMNI & Modem driver support IRAT feature,
	  if no, CCMNI & Modem driver do not support IRAT feature.
	  The option default disabled.
```

## drivers/misc/mediatek/chip/Kconfig
```kconfig
config MTK_CHIP
	bool "Enable MTK Chip Version Driver"
	default y
	help
	  MTK chip version driver will provide information about chip version, such as hardware code, hardware version, software version.
```

## drivers/misc/mediatek/cmdq/Kconfig
```kconfig
config MTK_CMDQ
	bool "build CMDQ driver"
	default n
	help
	  enable this config to build CMDQ
	  This CMDQ module is used for Display/MDP to write HW register

config MTK_CMDQ_TAB
	bool "enable CMDQ Tablet compatibility"
	help
	  enable this config to be compatible with Tablet architecture
	  especially SVP path
```

## drivers/misc/mediatek/conn_md/Kconfig
```kconfig
config MTK_CONN_MD
  bool CONFIG_MTK_CONN_MD
  depends on MTK_ECCCI_DRIVER
  default y if MTK_CONN_LTE_IDC_SUPPORT
  help
    CONFIG_MTK_CONN_MD
```
