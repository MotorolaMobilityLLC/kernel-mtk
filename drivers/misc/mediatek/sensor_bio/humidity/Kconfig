## drivers/misc/mediatek/sensor_bio/humidity/Kconfig
```kconfig
config CUSTOM_KERNEL_HUMIDITY
	bool "CUSTOM KERNEL HUMIDITY Config"
	help
	  To detect humidity raw data

source "drivers/misc/mediatek/sensor_bio/humidity/hmdyhub/Kconfig"
```

## drivers/misc/mediatek/sensor_bio/situation/Kconfig
```kconfig
config CUSTOM_KERNEL_SITUATION
	bool "mediatek situation sensor tag"
	help
	  Kernel space support situation sensor driver.
	  If the platform is supported for gesture, this
	  configuration should be configured, and the situation
	  driver configuration should be configured as well.

source "drivers/misc/mediatek/sensor_bio/situation/stationary/Kconfig"
source "drivers/misc/mediatek/sensor_bio/situation/inpocket/Kconfig"
source "drivers/misc/mediatek/sensor_bio/situation/wake_gesture/Kconfig"
source "drivers/misc/mediatek/sensor_bio/situation/glance_gesture/Kconfig"
source "drivers/misc/mediatek/sensor_bio/situation/answercall/Kconfig"
source "drivers/misc/mediatek/sensor_bio/situation/pickup_gesture/Kconfig"
source "drivers/misc/mediatek/sensor_bio/situation/device_orientation/Kconfig"
source "drivers/misc/mediatek/sensor_bio/situation/motion_detect/Kconfig"
source "drivers/misc/mediatek/sensor_bio/situation/tilt_detector/Kconfig"
```

## drivers/misc/mediatek/sensor_bio/situation/motion_detect/Kconfig
```kconfig
config MTK_MOTION_DETECT_HUB
	bool "motion detect hub for MediaTek package"
	default n
```

## drivers/misc/mediatek/sensors-1.0/accelerometer/KX126_1063/Kconfig
```kconfig
config MTK_KX126_1063
  bool "KX126_1063 for MediaTek package"
  default n
	help
	  It support different accelerometer sensor.
          If this option is set,
	  it will support
          MTK_KX126_1063 Accelerometer.


config KX126_1063_LOWPASS
	bool "MTK_KX126_1063 for Mediatek package"
	default n
	help
	Say Y here if you have MTK_KX126_1063 accelerometer sensor KX126_1063_LOWPASS.

	If unsure, say N.

	To compile this dirver as a module, choose M here: the
	module will be called.

config CUSTOM_KERNEL_SENSORHUB
	bool "MTK_KX126_1063 for Mediatek package"
	default n
	help
	Say Y here if you have MTK_KX126_1063 accelerometer sensor CUSTOM_KERNEL_SENSORHUB.

	If unsure, say N.

	To compile this dirver as a module, choose M here: the
	module will be called.
```

## drivers/misc/mediatek/sensors-1.0/accelerometer/bma222e/Kconfig
```kconfig
config MTK_BMA222E
	bool "for support BMA222E gsensor"
	default n
	help
		This configuration is for enable or disable BMA222E accelerometer sensor support.
		Say Y here if you want to support this sensor.
		Say N if you not support it.
		If no sure, say N.
```

## drivers/misc/mediatek/sensors-1.0/accelerometer/bma455/Kconfig
```kconfig
#
# Makefile for Bosch sensors driver.
#

config MTK_BMA455
	tristate "BMA4XY acceleration sensor support"
	depends on I2C
	help
	  If you say yes here, you get support for Bosch Sensortec's
	  acceleration sensors BMA4XY.
```

## drivers/misc/mediatek/sensors-1.0/accelerometer/icm20645g/Kconfig
```kconfig
config MTK_ICM20645G
	bool "ICM20645 for MediaTek package"
	default n
	help
	  It support different accelerometer sensor.
          If this option is set,
	  it will support
          ICM20645 Accelerometer.
```

## drivers/misc/mediatek/sensors-1.0/accelerometer/lis3dh/Kconfig
```kconfig
config MTK_LIS3DH
	bool "LIS3DH for MediaTek package"
	help
	  It supports different accelerometer sensor.
	  If this option is set, it will support
	  LIS3DH Accelerometer.
```

## drivers/misc/mediatek/sensors-1.0/accelerometer/mc34xx/Kconfig
```kconfig
config MTK_MC34XX
	bool "mc34xx g-sensor for MediaTek package"
	help
	  mc3433 driver support some mc g-sensor chip
	  such as mc34xx, etc .
	  now this driver is used for mc34xx.
```

## drivers/misc/mediatek/sensors-1.0/accelerometer/mpu6050g/Kconfig
```kconfig
config MTK_MPU6050G
	bool "MPU6050G for MediaTek package"
	default n
	help
	  It support different accelerometer sensor.
          If this option is set,
	  it will support
          MPU6050G Accelerometer.
```

## drivers/misc/mediatek/sensors-1.0/accelgyro/lsm6dsmtr-spi/Kconfig
```kconfig
config LSM6DSMTR
	bool "LSM6DSMTR for MediaTek package"
	default n
	help
	  The LSM6DSMTR is a highly integrated,
	  low power internal measurement unit
	  that provides precise acceleration
	  and angular rate (gyroscopic) measurement.
	  this config will turn on accelerometer feature.
```

## drivers/misc/mediatek/sensors-1.0/activity_sensor/Kconfig
```kconfig
config CUSTOM_KERNEL_ACTIVITY_SENSOR
	bool "CUSTOM KERNEL ACTIVITY SENSOR"
	help
	  Kernel space activity sensor driver.

source "drivers/misc/mediatek/sensors-1.0/activity_sensor/activityhub/Kconfig"
```

## drivers/misc/mediatek/sensors-1.0/activity_sensor/activityhub/Kconfig
```kconfig
config MTK_ACTIVITYHUB
	bool "activityhub for MediaTek package"
	default n
	help
	  MTK sensor hub driver for activity sensor.
```

## drivers/misc/mediatek/sensors-1.0/alsps/APDS9930/Kconfig
```kconfig
config MTK_APDS9930
	bool "AVAGO APDS9930 for MediaTek package"
	help
	  If this option is set, it will support
	  ambient proximity and light sensor feature.
	  APDS9930 is a combo sensor chip provided by
	  AVAGO Technologies.
```

## drivers/misc/mediatek/sensors-1.0/alsps/cm36652/Kconfig
```kconfig
config MTK_CM36652
	tristate "cm36652 for MediaTek package"
	default n
	help
	  It support different type sensor
	  in this platform. If this option
	  is set, it will support sensor CM36652
	  which integrates a proximity sensor, a color sensor.
```

## drivers/misc/mediatek/sensors-1.0/alsps/cm36686/Kconfig
```kconfig
config MTK_CM36686
	bool "cm36686 for MediaTek package"
	default n
	help
	  It support different type sensor
	  in this platform. If this option
	  is set, it will support sensor CM36686
	  which integrates a proximity sensor, a color sensor.
```

## drivers/misc/mediatek/sensors-1.0/alsps/epl2182/Kconfig
```kconfig
config MTK_EPL2182
	bool "for support EPL2182 alsps sensor"
	help
	  This configuration is for enable or disable EPL2182 alsps sensor support.
	  Say Y here if you want to support this sensor.
	  Say N if you not support it.
	  If no sure, say N.
```

## drivers/misc/mediatek/sensors-1.0/alsps/ltr577/Kconfig
```kconfig
config MTK_LTR577
	bool "ltr577 for MediaTek package"
	default n
	help
	  It support different type sensor
	  in this platform. If this option
	  is set, it will support ambient
	  and light sensor ltr577.
```

## drivers/misc/mediatek/sensors-1.0/alsps/stk3a5x/Kconfig
```kconfig
config MTK_STK3A5X
        bool "stk3a5x_ontim for MediaTek package"
        default n
```

## drivers/misc/mediatek/sensors-1.0/alsps/stk3x1x/Kconfig
```kconfig
config MTK_STK3x1x
        bool "stk3x1x_ontim for MediaTek package"
        default n
```

## drivers/misc/mediatek/sensors-1.0/geofence/Kconfig
```kconfig
config MTK_KERNEL_GEOFENCE
	bool "MTK KERNEL GEOFENCE CONFIG"
	help
	  GEOFENCE is a feature that uses fused location position (GPS, sensor, cell)
	  to define geographical boundaries and report transitions (enter, exit)
	  Kernel space geofence sensor driver can get ccci data and motion data
	  to help to reach low power geofence.
```

## drivers/misc/mediatek/sensors-1.0/gyroscope/mpu6050gy/Kconfig
```kconfig
config MTK_MPU6050GY
	bool "MPU6050GY gyroscope for MediaTek package"
	default n
	help
	  It support different gyroscope sensor.
	  If this option is set,
	  it will support MPU6050 gyroscope.
```

## drivers/misc/mediatek/sensors-1.0/humidity/Kconfig
```kconfig
config CUSTOM_KERNEL_HUMIDITY
	bool "CUSTOM KERNEL HUMIDITY Config"
	help
	  To detect humidity raw data

source "drivers/misc/mediatek/sensors-1.0/humidity/hmdyhub/Kconfig"
```

## drivers/misc/mediatek/sensors-1.0/magnetometer/afx133/Kconfig
```kconfig
config MTK_AFX133
	tristate "AFX133 for MediaTek package"
	default n
	help
	  It support different magnetometer sensor.
	  If this option is set, it will support
	  AFX133 magnetometer which is a 3-axis electronic
	  compass IC with high sensitive Hall sensor technology.
```
