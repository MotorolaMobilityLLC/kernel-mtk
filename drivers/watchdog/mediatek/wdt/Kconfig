## drivers/watchdog/mediatek/wdt/Kconfig
```kconfig
# WatchDog
config MTK_WATCHDOG
	tristate "WatchDog Enable"
	default y
	---help---
	Watch dog mtk driver enable/disable in the kernel.
	Say Y here if you want to use mediatek watchdog driver
	please note that mediatek watchdog driver don't use
	watchdog core which define by WATCHDOG_CORE.

# WatchDog
config MTK_WD_KICKER
	tristate "WatchDog Kicer"
	default y
	---help---
	Watch dog kicker is a module in the kernel for kicking the watch dog.
	Say Y here if you want to use the mediatek watchdog timer driver.
```

## kernel-3.18/drivers/misc/mediatek/base/power/mt6735/Kconfig
```kconfig
config CPU_DVFS_SYSTEM_BOOTUP_BOOST
	bool "cpu dvfs system bootup boost"
	default y
	depends on MT_BOOT_TIME_CPU_BOOST
	help
		CPU_DVFS_SYSTEM_BOOTUP_BOOST is used to enhance system bootup time by fixing
		CPU at max CPU frequency before bootup procedure finished. Say y here to enable
		it and say n to disable it.
```

## kernel-3.18/drivers/misc/mediatek/sar/Kconfig
```kconfig
#
# Input misc drivers configuration
#
menuconfig INPUT_MISC
	bool "Miscellaneous devices"
	help
	  Say Y here, and a list of miscellaneous input drivers will be displayed.
	  Everything that didn't fit into the other categories is here. This option
	  doesn't affect the kernel.

	  If unsure, say Y.

if INPUT_MISC

config INPUT_SX9310
	tristate "SX9310_SAR_sensor"
	depends on I2C
	default n
	help 
	  Say Y to enable the SAR detection application, if N here not to use the 
	  this SAR sensor

endif
```

## kernel-3.18/drivers/misc/mediatek/wind_device_info/Kconfig
```kconfig
# add wind_device_info for A158---qiumeng@wind-mobi.com 20161123 begin
config WIND_DEVICE_INFO
	bool "CONFIG_WIND_DEVICE_INFO"
	default n
	help
		Select y or n
# add wind_device_info for A158---qiumeng@wind-mobi.com 20161123 end
```

## sound/lct_aw87319/Kconfig
```kconfig
config EXTPA_AW87319
	tristate "Exteral Audio Amp driver"
	help
	  add exteral amp aw87319 driver.
```

## sound/lct_aw8731x/Kconfig
```kconfig
config EXTPA_AW87318_AW87319_SWITCH
	tristate "Exteral Audio Amp driver"
	help
	  add exteral amp aw87319 driver.
```

## sound/soc/codecs/aw883xx/Kconfig
```kconfig
config SND_SMARTPA_AW883XX
    tristate "SoC Audio for awinic aw883xx series"
    depends on I2C
    help
      This option enables support for aw883xx series Smart PA.
```

## sound/soc/codecs/cs35l41/Kconfig
```kconfig
config SND_SOC_CS35L41
	tristate "cirrus Semiconductors cs35l34 amplifier"
	default n
```

## sound/soc/mediatek/Kconfig
```kconfig
config SND_SOC_MEDIATEK
	tristate "ASoC support for Mediatek chip"
	depends on ARCH_MEDIATEK
	help
	  This adds ASoC platform driver support for Mediatek chip
	  that can be used with other codecs.
	  Select Y if you have such device.
	  Ex: MT8173

config SND_SOC_MT8173_MAX98090
	tristate "ASoC Audio driver for MT8173 with MAX98090 codec"
	depends on SND_SOC_MEDIATEK
	select SND_SOC_MAX98090
	help
	  This adds ASoC driver for Mediatek MT8173 boards
	  with the MAX98090 audio codec.
	  Select Y if you have such device.
	  If unsure select "N".

config SND_SOC_MT8173_RT5650_RT5676
	tristate "ASoC Audio driver for MT8173 with RT5650 RT5676 codecs"
	depends on SND_SOC_MEDIATEK
	select SND_SOC_RT5645
	select SND_SOC_RT5677
	help
	  This adds ASoC driver for Mediatek MT8173 boards
	  with the RT5650 and RT5676 codecs.
	  Select Y if you have such device.
	  If unsure select "N".

config MT_SND_SOC_6797
	bool "MT 6797 PLATFORM AUDIO DRIVER"
	default n
	help
	  If you say Y, enable MTK 6797 audio driver.
	  Must enable this to use medatek audio driver.
	  The default value is y for MT6797.
	  It's recommended no to change this.

config SND_SOC_MT8167
	tristate

config SND_SOC_MT8167_MT6392_MACH
	tristate "ASoC Audio driver for MT8167 with internal codec"
	depends on MACH_MT8167
	select SND_SOC_MT8167
	select SND_SOC_MT8167_CODEC
	help
	  This adds support for ASoC machine driver for Mediatek MT8167
	  platforms with internal audio codec and speaker amplifier MT6392.
	  Select Y if you have such device.
	  If unsure select "N".

config MT_SND_SOC_CODEC
	string "String for Mediatek audio codec"
	help
	  Specify Mediatek audio codec.
	  Say "mt6351" if you have mt6351 audio codec.

config MTK_SPEAKER
	bool "MTK SPEAKER AMP"
	default n
	help
	  If you say Y, enable MTK_SPEAKER_AMP

config MTK_NXP_TFA9890
	bool "MTK NXP TFA9890 SMART PA DRIVER"
	default n
	help
	  If you say Y, enable MTK_NXP_TFA9890 driver.

config MTK_SPKGPIO_REWORK
	bool "MTK SPEAKER GPIO REWORK"
	default n
	help
	  This is only for MTK internal phone only
	  Enable SPKGPIO REWORK check functionality
	  Will choose the correct GPIO for external AMP
          If you say Y, enable MTK_SPKGPIO_REWORK

config MTK_HP_ANASWITCH
	bool "MTK HEADPHONE ANALOG SWITCH"
	default n
	help
	  This will enable headphone analog switch control
	  for de-pop functionality
	  Only enable this when you have headphone analog switch
          If you say Y, enable MTK_HP_ANASWITCH

config MTK_BTCVSD_ALSA
	bool "MTK BT CVSD ALSA ARICHITECTURE"
	default n
	help
	  If you say Y, enable MTK_BTCVSD_ALSA.

config MTK_SND_SOC_NEW_ARCH
	bool "Support new audio architecture"
	help
	  If you say Y, enable MTK_SND_SOC_NEW_ARCH.
	  Only enable this when you use refactored audio driver architecture.

config MTK_OFFLOAD_PLAYBACK
	bool "Audio playback through dsp"
	help
	  If you say Y, enable MTK_OFFLOAD_PLAYBACK.
	  Only enable this when we have DSP.
	  This makes audio out pass bitstream, and decoding process is done in DSP.

config MTK_HYBRIDDRE_SUPPORT
	bool "Audio Hybrid DRE support"
	help
	  If you say Y, enable MTK_HYBRIDDRE_SUPPORT.
	  Only enable this when we have Hybrid DRE feature.
```

## sound/soc/mediatek/audio_pa/Kconfig
```kconfig
menuconfig AUDIO_PA_S
	bool "Audio PA enable"
	help
	  Support Audio PA Enable

if AUDIO_PA_S

config SND_SOC_AW87519
	bool "Awinic smart k pa aw87519"
	default n
	help
          Support awinic as87519 smart K pa

source "sound/soc/mediatek/audio_pa/aw87519/Kconfig"

endif
```

## sound/soc/mediatek/audio_pa/aw87519/Kconfig
```kconfig
config SND_SOC_AW87519
	bool "SoC Audio for awinic AW87519 Smart K PA"
	depends on I2C
	help
	  This option enables support for AW87519 Smart K PA.
```

## tinno/common_features/Kconfig
```kconfig
menuconfig TINNO
	bool "tinno kernel code"
	help
	  You can build and test tinno kernel code here.

# zane add bring up smartpa AW87390 20211010
source "tinno/common_features/smartpa/aw87xxx/Kconfig"
# FM ANT
source "tinno/common_features/ant_det/Kconfig"
config TINNO_V770
    bool "TINNO_V770"
    default n

# product info.
config TINNO_PRODUCT_INFO
    bool "TINNO_PRODUCT_INFO"
    default n

config LCM_BIAS_SUPPORT
    bool "LCM_BIAS_SUPPORT"
    default n

# tp ilitek
config TINNO_TP_ILITEK
    bool "TINNO_TP_ILITEK"
    default n

config TOUCHSCREEN_CHIPONE
    bool "TOUCHSCREEN_CHIPONE"
    default n

config TOUCHSCREEN_MTK_ILITEK
	bool "ILI9881 for Mediatek package"
	default n

config TOUCHSCREEN_NOVA_HOSTDL
	bool "TOUCHSCREEN_NOVA_HOSTDL"
	default n

config TOUCHSCREEN_FTS
	bool "TOUCHSCREEN_FTS"
	default n
```

## tinno/common_features/ant_det/Kconfig
```kconfig
config TINNO_ANT_DET

	bool "ANT detect support"

	default n
	help
	  Say Y here if you want to enable
```

## tinno/common_features/sensors/Kconfig
```kconfig
menuconfig TINNO
	bool "tinno kernel code"
	help
	  You can build and test tinno kernel code here.

config MTK_FOCALTECH_TOUCH_TS
	bool "FOCALTECH_TS for Mediatek package"
	help
	  Say Y here if you have FOCALTECH_TS touch panel.
	  If unsure, say N.
config MTK_TGESTURE
        bool "tGesture for Mediatek package"
        default n

#source "tinno/common_features/sensors/accelerometer/Kconfig"
#source "tinno/common_features/sensors/alsps/Kconfig"
#source "tinno/common_features/sensors/magnetometer/Kconfig"
source "tinno/common_features/sensors/hall/Kconfig"
#source "tinno/common_features/sensors/gyroscope/Kconfig"
```

## tinno/common_features/sensors/hall/Kconfig
```kconfig
config CUSTOM_KERNEL_HALL
	bool "MTK_TINNO_HALL"
	help
	  hall sensor driver to detect ambient light and the object is close
	  or far awary from device. After configure this configuration,
          the specific ambient light and proximity sensor driver configuration
          should be configured as well.
```
