## drivers/irqchip/Kconfig
```kconfig
config IRQCHIP
	def_bool y
	depends on OF_IRQ

config ARM_GIC
	bool
	select IRQ_DOMAIN
	select IRQ_DOMAIN_HIERARCHY
	select MULTI_IRQ_HANDLER

config ARM_GIC_V2M
	bool
	depends on ARM_GIC
	depends on PCI && PCI_MSI
	select PCI_MSI_IRQ_DOMAIN

config GIC_NON_BANKED
	bool

config ARM_GIC_V3
	bool
	select IRQ_DOMAIN
	select MULTI_IRQ_HANDLER
	select IRQ_DOMAIN_HIERARCHY

config ARM_GIC_V3_ITS
	bool
	select PCI_MSI_IRQ_DOMAIN

config ARM_NVIC
	bool
	select IRQ_DOMAIN
	select IRQ_DOMAIN_HIERARCHY
	select GENERIC_IRQ_CHIP

config ARM_VIC
	bool
	select IRQ_DOMAIN
	select MULTI_IRQ_HANDLER

config ARM_VIC_NR
	int
	default 4 if ARCH_S5PV210
	default 2
	depends on ARM_VIC
	help
	  The maximum number of VICs available in the system, for
	  power management.

config ATMEL_AIC_IRQ
	bool
	select GENERIC_IRQ_CHIP
	select IRQ_DOMAIN
	select MULTI_IRQ_HANDLER
	select SPARSE_IRQ

config ATMEL_AIC5_IRQ
	bool
	select GENERIC_IRQ_CHIP
	select IRQ_DOMAIN
	select MULTI_IRQ_HANDLER
	select SPARSE_IRQ

config I8259
	bool
	select IRQ_DOMAIN

config BCM7038_L1_IRQ
	bool
	select GENERIC_IRQ_CHIP
	select IRQ_DOMAIN

config BCM7120_L2_IRQ
	bool
	select GENERIC_IRQ_CHIP
	select IRQ_DOMAIN

config BRCMSTB_L2_IRQ
	bool
	select GENERIC_IRQ_CHIP
	select IRQ_DOMAIN

config DW_APB_ICTL
	bool
	select GENERIC_IRQ_CHIP
	select IRQ_DOMAIN

config IMGPDC_IRQ
	bool
	select GENERIC_IRQ_CHIP
	select IRQ_DOMAIN

config IRQ_MIPS_CPU
	bool
	select GENERIC_IRQ_CHIP
	select IRQ_DOMAIN

config CLPS711X_IRQCHIP
	bool
	depends on ARCH_CLPS711X
	select IRQ_DOMAIN
	select MULTI_IRQ_HANDLER
	select SPARSE_IRQ
	default y

config OR1K_PIC
	bool
	select IRQ_DOMAIN

config OMAP_IRQCHIP
	bool
	select GENERIC_IRQ_CHIP
	select IRQ_DOMAIN

config ORION_IRQCHIP
	bool
	select IRQ_DOMAIN
	select MULTI_IRQ_HANDLER

config RENESAS_INTC_IRQPIN
	bool
	select IRQ_DOMAIN

config RENESAS_IRQC
	bool
	select GENERIC_IRQ_CHIP
	select IRQ_DOMAIN

config ST_IRQCHIP
	bool
	select REGMAP
	select MFD_SYSCON
	help
	  Enables SysCfg Controlled IRQs on STi based platforms.

config TB10X_IRQC
	bool
	select IRQ_DOMAIN
	select GENERIC_IRQ_CHIP

config VERSATILE_FPGA_IRQ
	bool
	select IRQ_DOMAIN

config VERSATILE_FPGA_IRQ_NR
       int
       default 4
       depends on VERSATILE_FPGA_IRQ

config XTENSA_MX
	bool
	select IRQ_DOMAIN

config IRQ_CROSSBAR
	bool
	help
	  Support for a CROSSBAR ip that precedes the main interrupt controller.
	  The primary irqchip invokes the crossbar's callback which inturn allocates
	  a free irq and configures the IP. Thus the peripheral interrupts are
	  routed to one of the free irqchip interrupt lines.

config KEYSTONE_IRQ
	tristate "Keystone 2 IRQ controller IP"
	depends on ARCH_KEYSTONE
	help
		Support for Texas Instruments Keystone 2 IRQ controller IP which
		is part of the Keystone 2 IPC mechanism

config MIPS_GIC
	bool
	select MIPS_CM

config INGENIC_IRQ
	bool
	depends on MACH_INGENIC
	default y

config RENESAS_H8300H_INTC
        bool
	select IRQ_DOMAIN

config RENESAS_H8S_INTC
        bool
	select IRQ_DOMAIN

config IMX_GPCV2
	bool
	select IRQ_DOMAIN
	help
	  Enables the wakeup IRQs for IMX platforms with GPCv2 block

config IRQ_MXS
	def_bool y if MACH_ASM9260 || ARCH_MXS
	select IRQ_DOMAIN
	select STMP_DEVICE

config MTK_EIC
	bool
	select IRQ_DOMAIN
	help
	  This option is used to enable external interrupt controller for
	  MediaTek solutions.

config MTK_SEC_DEINT_SUPPORT
	bool
	def_bool n
	depends on MTK_EIC
	help
	  This option is used to enable a feature called secure direct eint support.
	  This feature have to be enabled with MTK_SEC_DEIC_SUPPORT in ATF. ATF direct
	  secure EINT driver have provide secure DEINT Configuration and Release command
	  for SMC call originated from TEE and filter the SMC call from kernel. The change for
	  kernel EINT driver is that mt_eint_set_deint() will check the wanted deint is secure
	  direct eint, if yes, skip the configuration. if not, kernel can configure this deint.
	  Since not every platform support secure direct eint, you must enable this config carefully.

config MTK_INTPOL
	bool
	help
	  Support for MediaTek intpol used on mt65xx/mt81xx.


config MTK_EIC_HISTORY_DUMP
	bool "Enable MTK EIC HISTORY Debugger"
	def_bool n
	depends on MTK_EIC
	help
	  This option is a debugging feature used to collect last eint interupts
	  and its property before WDT TIMEOUT.
	  With thie option, we could know which eint interrupt is triggered
	  too often to cause system watchdog timeout.

config MTK_IRQ_NEW_DESIGN
	bool
	help
	  Support for new interrupt distribution design for MediaTek solutions.
	  With this feature enabled, the SPI interrupts would be routed to all the
	  cores rather than cpu0 to achieve better load balance of interrupt handling.

config MTK_IRQ_NEW_DESIGN_DEBUG
	bool
	select MTK_IRQ_NEW_DESIGN
	help
	  Support for debugging feature for MediaTek new interrupt design.
	  With this feature enabled, system would assert when an error occurs rather than
	  output warning messages.

config MTK_SYSIRQ
	bool
	default y if ARCH_MEDIATEK
	help
	  GIC only support IRQ_TYPE_LEVEL_HIGH and IRQ_TYPE_EDGE_RISING,
	  so this driver is designed for polarity configuration
	  in order to make GIC driver support various trigger type
	  including IRQ_TYPE_LEVEL_LOW and IRQ_TYPE_EDGE_FALLING.
```

## drivers/media/platform/mediatek/Kconfig
```kconfig
config MEDIATEK_VPU
	bool
	---help---
	  This driver provides downloading firmware vpu (video processor unit) and
	  communicating with vpu.
```

## drivers/misc/aw8624_haptic/Kconfig
```kconfig
#
# Mediatek AW8624 Driver
#

config AW8624_HAPTIC
	tristate "Awinic AW8624 haptic driver"
	depends on I2C

	help
	  Say Y here if you have Awinic AW8624 haptic controller
	  chip in your system.
```

## drivers/misc/drv2624/Kconfig
```kconfig
#
# Mediatek DRV2624 Driver
#

config DRV2624
	tristate "DRV2624 haptic driver"
	depends on I2C

	help
	  Say Y here if you have DRV2624 haptic controller
	  chip in your system.
```

## drivers/misc/mediatek/Kconfig
```kconfig
menuconfig MEDIATEK_SOLUTION
	bool "MediaTek Properitary Configuration"
	select FW_LOADER_USER_HELPER_FALLBACK
	select I2C
	help
	  Check this to enable MediaTek properity configuration.

if MEDIATEK_SOLUTION
config MTK_PLATFORM
	string "MTK platform name"

config ARCH_MTK_PROJECT
	string "MTK project name"
endif

menu "Storage: EMMC, NAND, partition..."

source "drivers/misc/mediatek/mtk_sdio/Kconfig"

endmenu  # Storage

menu "Power, PMIC, Battery & Low Power related configs"

config MTK_FREQ_HOPPING
	bool "MediaTek FREQHOPPING SUPPORT"
	help
	  If you want to use MediaTek freqhopping, say Y here.If unsure, say N.
	  Please choose your desired freqhopping driver as well. E.g: MTK2712_FREQ_HOPPING=y

source "drivers/misc/mediatek/freqhopping/Kconfig"

endmenu  # Power

menu "MultiMedia, Display, Camera related configs"

endmenu  # MM

menu "Sensors"

config MTK_SENSOR_SUPPORT
	bool "MTK SENSOR SUPPORT"
	help
	  Sensor config for sensor feature in project.
	  Please say Y here if you want to support and sensors
	  with mediatek sensor architecture.
	  If unsure, say N.

source "drivers/misc/mediatek/alsps/Kconfig"

endmenu  # Sensors

menu "Modem & Connectivity related configs"

source "drivers/misc/mediatek/connectivity/Kconfig"

endmenu  # CONN

menu "Other Peripherals"

source "drivers/misc/mediatek/ice_debug/Kconfig"
source "drivers/misc/mediatek/udi/Kconfig"
source "drivers/misc/mediatek/devapc/Kconfig"
source "drivers/misc/mediatek/ext_gic/Kconfig"
source "drivers/misc/mediatek/uart/Kconfig"

endmenu # Peripheral

menu "Misc configs"

endmenu    # Misc
```

## drivers/misc/mediatek/accdet/Kconfig
```kconfig
config MTK_ACCDET
	bool "MediaTek ACCDET driver"
	---help---
	  ACCDET driver is for headset detect and support for MediaTek SOC
	  If you want to use MediaTek ACCDET driver,
	  say Y.
	  If unsure, say N.

config ACCDET_EINT
	bool "MediaTek ACCDET AP EINT"
	---help---
	  ACCDET External EINT(AP GPIO) support for MediaTek SOC
	  If you want to use MediaTek ACCDET EINT from AP GPIO,
	  say Y.
	  If unsure, say N.

config ACCDET_EINT_IRQ
	bool "MediaTek ACCDET PMIC EINT"
	---help---
	  ACCDET Internal EINT(PMIC) support for MediaTek SOC
	  If you want to use MediaTek ACCDET EINT from PMIC,
	  say Y.
	  If unsure, say N.

config ACCDET_SUPPORT_EINT0
	bool "MediaTek ACCDET PMIC EINT0"
	---help---
	  ACCDET use Internal EINT0(PMIC) support for MediaTek SOC
	  If you just want to use MediaTek PMIC ACCDET EINT0,
	  say Y.
	  If unsure, say N.

config ACCDET_SUPPORT_EINT1
	bool "MediaTek ACCDET PMIC EINT1"
	---help---
	  ACCDET use Internal EINT1(PMIC) support for MediaTek SOC
	  If you just want to use MediaTek PMIC ACCDET EINT1,
	  say Y.
	  If unsure, say N.

config ACCDET_SUPPORT_BI_EINT
	bool "MediaTek ACCDET PMIC EINT0 and EINT1"
	---help---
	  ACCDET use Internal EINT0&EINT1(PMIC) support for MediaTek SOC
	  If you want to use MediaTek PMIC ACCDET EINT0&EINT1,
	  say Y.
	  If unsure, say N.

config HEADSET_SUPPORT_FIVE_POLE
	bool "MediaTek five pole Headset"
	---help---
	  ACCDET support 5-pole headset support for MediaTek SOC
	  If you want to support 5-pole headset,
	  say Y.
	  If unsure, say N.

config ACCDET_PIN_SWAP
	bool "MediaTek ACCDET PIN_SWAP"
	---help---
	  ACCDET_PIN_SWAP support for MediaTek SOC
	  If you want to use MediaTek ACCDET PIN SWAP,
	  say Y.
	  If unsure, say N.

config ACCDET_PIN_RECOGNIZATION
	bool "MediaTek ACCDET PIN_RECONIZATION"
	---help---
	  ACCDET_PIN_RECOGNIZATION support for MediaTek SOC
	  If you want to use MediaTek ACCDET PIN RECOGNIZATION,
	  say Y.
	  If unsure, say N.

config FOUR_KEY_HEADSET
	bool "MediaTek four key headset"
	---help---
	  FOUR_KEY_HEADSET support for MediaTek SOC
	  If you want to use MediaTek ACCDET four key headset,
	  say Y.
	  If unsure, say N.

config TS3A225E_ACCDET
	bool "MediaTek ACCDET ts3a225e"
	---help---
	  TS3A225E support for MediaTek SOC
	  If you want to use TS3A225E
	  say Y.
	  If unsure, say N.
```

## drivers/misc/mediatek/accelerometer/KXTJ2_1009/Kconfig
```kconfig
config MTK_KXTJ2_1009_NEW
	bool "KXTJ2_1009 for MediaTek package"
	default n
	help
	  It support different accelerometer sensor.
          If this option is set,
	  it will support
          KXTJ2_1009 Accelerometer.
```

## drivers/misc/mediatek/accelerometer/LCT_bmi160-new/Kconfig
```kconfig
config LCT_MTK_BMI160_NEW
	bool "MTK_BMA222E_NEW for MediaTek package"
	default n
	help
	  It support different accelerometer sensor.
          If this option is set,
	  it will support
          MTK_BMA222E_NEW Accelerometer. BMI160 same with BMI120
```

## drivers/misc/mediatek/accelerometer/bma253/Kconfig
```kconfig
config MTK_BMA253
	tristate "BMA253 for MediaTek package"
	default n
	help
	  It support different accelerometer sensor.
          If this option is set,
	  it will support
          BMA253 Accelerometer.
```

## drivers/misc/mediatek/accelerometer/bma2x2/Kconfig
```kconfig
#tuwenzan@wind-mobi.com modify at 20161108 begin
config MTK_BMA2X2
	bool "BMA2X2 for MediaTek package"
	default n
#tuwenzan@wind-mobi.com modify at 20161108 end
```

## drivers/misc/mediatek/accelerometer/bma2xx-new/Kconfig
```kconfig
config MTK_BMA2XX_NEW
	bool "BMA2XX for MediaTek package"
	default n
	help
	  It support different accelerometer sensor.
          If this option is set,
	  it will support
          BMA2XX Accelerometer.
```

## drivers/misc/mediatek/accelerometer/bmi120-new/Kconfig
```kconfig
config MTK_BMI120_NEW
	bool "MTK_BMI120_NEW for MediaTek package"
	default n
	help
	  It support different accelerometer sensor.
          If this option is set,
	  it will support
          MTK_BMI120_NEW Accelerometer.
```

## drivers/misc/mediatek/accelerometer/icm206xx_a/Kconfig
```kconfig
config MTK_ICM206XX_A
	bool "ICM206XX for MediaTek package"
	default n
	help
	It support different accelerometer sensor.
	If this option is set,
	it will support
	ICM206XX accelerometer.
```

## drivers/misc/mediatek/accelerometer/lsm6ds3-k52/Kconfig
```kconfig
config MTK_LSM6DS3_K52
	bool "LSM6DS3_K52 for MediaTek package"
	default n
	help
	  It support different accelerometer sensor.
          If this option is set,
	  it will support
          MTK_LSM6DS3_K52 Accelerometer.
```

## drivers/misc/mediatek/accelerometer/mc3410-new/Kconfig
```kconfig
config MTK_MC3410_NEW
	bool "MC3410 for MediaTek package"
	default n
	help
	  It support different accelerometer sensor.
          If this option is set,
	  it will support
          MC3410 Accelerometer.
```

## drivers/misc/mediatek/accelerometer/mc3xxx_auto/Kconfig
```kconfig
config MTK_MC3XXX_AUTO
	bool "MC3xxx for MediaTek package"
	default n
	help
	  It support different accelerometer sensor.
          If this option is set,
	  it will support
          MC3xxx Accelerometer.

config CUSTOM_KERNEL_SENSORHUB
	bool "MTK_MC3XXX_AUTO for Mediatek package"
	default n
	help
	Say Y here if you have MTK_MC3XXX_AUTO touch panel CUSTOM_KERNEL_SENSORHUB.

	If unsure, say N.

	To compile this dirver as a module, choose M here: the
	module will be called.
```

## drivers/misc/mediatek/adsp/Kconfig
```kconfig
config MTK_AUDIODSP_SUPPORT
	bool "Specifiy If Platform Support Audio dsp"
	default n
	help
	  AUDIO_DSP is a MediaTek in-house DSP which can do
	  different audio process.
```

## drivers/misc/mediatek/alsps/Kconfig
```kconfig
config CUSTOM_KERNEL_ALSPS
	bool "CUSTOM_KERNEL_ALSPS"
	help
	  ALSPS sensor driver to detect ambient light and the object is close
	  or far awary from device. After configure this configuration,
          the specific ambient light and proximity sensor driver configuration
          should be configured as well.

config MTK_AUTO_DETECT_ALSPS
	bool "MTK_AUTO_DETECT_ALSPS"
	help
	  This feature Option is used for projects which using more than one
	  ALSPS sensors, more than one ALSPS drivers can be builded in to
	  project and be auto detected by setting this option to yes,
          usually only one ALSPS driver can be probed.

source "drivers/misc/mediatek/alsps/cm36652-new/Kconfig"
source "drivers/misc/mediatek/alsps/cm36686-new/Kconfig"
source "drivers/misc/mediatek/alsps/cm36558/Kconfig"
source "drivers/misc/mediatek/alsps/APDS9930-new/Kconfig"
source "drivers/misc/mediatek/alsps/EPL2182-new/Kconfig"
```

## drivers/misc/mediatek/alsps/LCT_MN66238T-new/Kconfig
```kconfig
config LCT_MTK_MN66238T_NEW
	bool "EPL2590 for MediaTek package"
	default n
	help
	It support different type sensor
	in this platform. If this option
	is set, it will support ambient
	and light sensor EPL2590.
```

## drivers/misc/mediatek/alsps/LCT_ltr778-new/Kconfig
```kconfig
config LCT_LTR778_NEW 
	bool "LTR778 for MediaTek package"
	default n
	help
	It support different type sensor
	in this platform. If this option
	is set, it will support ambient
	and light sensor LTR778.
```

## drivers/misc/mediatek/alsps/epl2590-new/Kconfig
```kconfig
config MTK_EPL2590_NEW
	bool "EPL2590 for MediaTek package"
	default n
	help
	It support different type sensor
	in this platform. If this option
	is set, it will support ambient
	and light sensor EPL2590.
```
