## Documentation/devicetree/bindings/arm/mediatek/mediatek,dip1.txt
```
Mediatek ispsys controller
============================

The Mediatek ispsys controller provides various clocks to the system.

Required Properties:

- compatible: Should be:
	- "mediatek,mt6739-ispsys", "syscon"
- #clock-cells: Must be 1

The ispsys controller uses the common clk binding from
Documentation/devicetree/bindings/clock/clock-bindings.txt
The available clocks are defined in dt-bindings/clock/mt*-clk.h.

Example:
dip1@15022000 {
	compatible = "mediatek,dip1";
	reg = <0 0x15022000 0 0x6000>;
	interrupts = <GIC_SPI 322 IRQ_TYPE_LEVEL_LOW>;
};
```

## Documentation/devicetree/bindings/arm/mediatek/mediatek,ispsys.txt
```
Mediatek ispsys controller
============================

The Mediatek ispsys controller provides various clocks to the system.

Required Properties:

- compatible: Should be:
	- "mediatek,mt6739-ispsys", "syscon"
- #clock-cells: Must be 1

The ispsys controller uses the common clk binding from
Documentation/devicetree/bindings/clock/clock-bindings.txt
The available clocks are defined in dt-bindings/clock/mt*-clk.h.

Example:

ispsys@15000000 {
	compatible = "mediatek,mt6739-ispsys";
	reg = <0x0 0x15004000 0x0 0x9000
		0x0 0x1500d000 0x0 0x1000
		0x0 0x15000000 0x0 0x10000
		0x0 0x10215000 0x0 0x3000
		0x0 0x10211000 0x0 0x1000>;
	interrupts = <GIC_SPI 217 IRQ_TYPE_LEVEL_LOW>, /* CAM0 */
	<GIC_SPI 218 IRQ_TYPE_LEVEL_LOW>, /* CAM1 */
	<GIC_SPI 219 IRQ_TYPE_LEVEL_LOW>, /* CAM2 */
	<GIC_SPI 220 IRQ_TYPE_LEVEL_LOW>, /* CAMSV0 */
	<GIC_SPI 221 IRQ_TYPE_LEVEL_LOW>; /* CAMSV1 */
	/* clocks = <&scpsys SCP_SYS_DIS>,
	*		<&scpsys SCP_SYS_ISP>,
	*		<&mmsys MM_DISP0_SMI_COMMON>,
	*		<&imgsys IMG_IMAGE_CAM_SMI>,
	*		<&imgsys IMG_IMAGE_CAM_CAM>,
	*		<&imgsys IMG_IMAGE_SEN_TG>,
	*		<&imgsys IMG_IMAGE_SEN_CAM>,
	*		<&imgsys IMG_IMAGE_CAM_SV>,
	*		<&imgsys IMG_IMAGE_LARB2_SMI>;
	*clock-names = "CG_SCP_SYS_DIS",
	*		"CG_SCP_SYS_ISP",
	*		"CG_DISP0_SMI_COMMON",
	*		"CG_IMAGE_CAM_SMI",
	*		"CG_IMAGE_CAM_CAM",
	*		"CG_IMAGE_SEN_TG",
	*		"CG_IMAGE_SEN_CAM",
	*		"CG_IMAGE_CAM_SV",
	*		"CG_IMAGE_LARB2_SMI";
	*/
};
```

## Documentation/devicetree/bindings/arm/mediatek/mediatek,mrdump-V2.txt
```
Mediatek MRDUMP control block reserved memory
============================

The mediatek MRDUMP function provide a full ram dump
for debug purpose

Required Properties:

- compatible: Should be:
	- "mediatek,mrdump-V2"

The MTK_MRDUMP function must obtain the control block memory address
through this node of reg value

Example:

        mrdump-reserved-memory@41F00000{
            compatible = "mediatek,mrdump-V2";
            reg = <0 0x41F00000 0 0x2000>;
        };
```

## Documentation/devicetree/bindings/gpio/gpio-madera.txt
```
Cirrus Logic Madera class audio codecs gpio driver

These codecs have a set of configurable GPIO pins. The bindings here configure
the driver that provides access to these GPIOs.

See also
- the core bindings for the parent MFD driver:
    See Documentation/devicetree/bindings/mfd/madera.txt
- the pinctrl bindings for these codecs
    See Documentation/devicetree/bindings/pinctrl/cirrus,madera-pinctrl.txt

Required properties:
  - compatible : must be "cirrus,madera-gpio"
  - gpio-controller : Indicates this device is a GPIO controller.
  - #gpio-cells : Must be 2. The first cell is the pin number. The second cell
    is reserved for future use and must be zero

Optional properties:
  - gpio-line-names : as described in bindings/gpio/gpio.txt

Example:

cs47l85@0 {
	compatible = "cirrus,cs47l85";

	gpio-controller;
	#gpio-cells = <2>;
};
```

## Documentation/devicetree/bindings/input/goodix,goodix-fp.txt
```
* Goodix Fingerprint sensors

Required properties:
- compatible : "goodix,goodix-fp".
- spi-max-frequency = <8000000>;

Example:

 &spi1 {
	fingerprint@0 {
		compatible = "goodix,goodix-fp";
		spi-max-frequency = <8000000>;
		status = "okay";
}
```

## Documentation/devicetree/bindings/isee/isee.txt
```
Microtrust tee interface

ISEE is a secure OS implementation developed by Microtrust.

Required properties:
- compatible: "microtrust,utos"
- compatible: "microtrust,tz-log"
```

## Documentation/devicetree/bindings/misc/mediatek,cmdq.txt
```
MediaTek SoC system GCE

Required properties:
- compatible : Should be "mediatek,gce"
- reg: Should contain dramc registers location and length

Examples:

		gce@10212000 {
			compatible = "mediatek,gce";
			reg = <0 0x10212000 0 0x1000>;
		};
```

## Documentation/devicetree/bindings/misc/mediatek,typec.txt
```
MediaTek PMIC Typec only

Required properties:
- compatible: Should be "mediatek,mt6392-typec"
- reg: Based on mt6932 PMIC

Examples:

	typec: typec {
		compatible = "mediatek,mt6392-typec";
	};
```

## Documentation/devicetree/bindings/misc/microtrust,tz-log.txt
```
MICROTRUST Incorporated

Required properties:
- compatible : Should be "microtrust,tz-log"

Examples:

         tz-log {
         compatible = "microtrust,tz-log";
         };
```

## Documentation/devicetree/bindings/misc/microtrust,utos.txt
```
MICROTRUST Incorporated

Required properties:
- compatible : Should be "microtrust,utos"

Examples:

         utos {
         compatible = "microtrust,utos";
         interrupts = <GIC_SPI 252 IRQ_TYPE_EDGE_RISING>,
                 <GIC_SPI 253 IRQ_TYPE_EDGE_RISING>;
         };
```

## Documentation/devicetree/bindings/power/mt6370/mt6370_pmu.txt
```
Mediatek MT6370 I2C Sub-pmic

Mediatek MT6370 is Integrated Sub Power Management Chips.
MT6370 integrates the functions included Charger, Backlight,
RGBLED, DisplayBias, Vib LDO, Flash LED.
Mediatek MT6370 is connected to an i2c bus.


Required properties:
- compatible : Must be "mediatek,mt6370_pmu";
- reg : Must be 0x34, it's MT6370 PMU default I2C Slave address.
- interrupt-controller : Since the MT6370 support several interrupts internally,
  it is considered as an interrupt controller cascaded to the SoC one.
- #interrupt-cells = <1>;
/* If CONFIG_MTK_GPIOLIB_STAND is defined, mt6370,intr_gpio_num is used. Otherwise we use mt6370,intr_gpio. */
- mt6370,intr_gpio_num : IRQ GPIO pin that's connected to MT6370 interrupt.
- mt6370,intr_gpio : general IRQ GPIO pin.

Optional node:
- core : core subdev for MT6370 core part.
- charger : charger subdev for MT6370 charger part.
- fled : flash led subdev for MT6370 flashLED part.
- ldo : ldo subdev for MT6370 Vib LDO part.
- rgbled : rgbled subdev for MT6370 RGB indicator part.
- bled : backlight subdev for MT6370 backlight led part.
- dsv : dsv subdev for MT6370 display bias part.


Example:
mt6370_pmu@34 {
	status = "ok";
	compatible = "mediatek,mt6370_pmu";
	reg = <0x34>;
	interrupt-controller;
	#interrupt-cells = <1>;
	mt6370,intr_gpio_num = <3>; /* direct defined GPIO num */
	mt6370,intr_gpio = <&pio 3 0>; /* genernal GPIO */
};
```

## Documentation/devicetree/bindings/power/mt6370/mt6370_pmu_bled.txt
```
Mediatek MT6370 backlight led subdev
MT6370 backlight led control.

Required properties:
- compatible : Must be "mediatek,mt6370_pmu_bled";
- interrupt-names : MT6370 bled enabled interrupts.
	(R: required, O: optional)
	1. (O)bled_ocp: Backlight over current flag.
	2. (O)bled_ovp: Backlight over voltage protection flag.

- mt,bled_name : led classdev name.
- mt,chan_en : channel enabled bit 0 1 2 3 -> chan 1 2 3 4.
	       ex. enable all 4 channal 0xf. only enable channel 1 and 3 configure 0x5.
- mt,bl_ovp_level : 0 -> 17V, 1 -> 21V, 2 -> 25V, 3 -> 29V.
- mt,bl_ocp_level : 0 -> 900mA, 1 -> 1200mA, 2 -> 1500mA, 3 -> 1800mA.
- mt,pwm_fsample : 0 -> 1MHz, 1 -> 4MHz, 2 or 3 24MHz.
- mt,pwm_deglitch : 0 -> no filter, 1 -> 100ns, 2 -> 160ns, 3 -> 200ns.
- mt,pwm_avg_cycle : 0 -> disable avg, 1 -> avg 2 cycles, 2 -> avg 4 cycles.
		     3 -> avg 8 cycles, 4 -> avg 16 cycles, 5 -> avg 32 cycles.
- mt,bled_ramptime : 0 -> 0us, 1 -> 500us, 2 -> 750us, 3 -> 1ms, 4 -> 2ms, 5 -> 5ms, 6 -> 10ms,
		     7 -> 20ms, 8 -> 50ms, 9 -> 100ms, 10 -> 250ms, 11 -> 800ms, 12 -> 1s,
		     13 -> 2s, 14 -> 4s, 15 -> 8s.
- mt,bled_flash_ramp : 0 -> 0us, 1 -> 500us, 2 -> 750us, 3 -> 1ms, 4 -> 2ms, 5 -> 5ms.
- mt,max_bled_brightness : default max backlight brightness setting.

Optional node:

Example:
mt6370_pmu@34 {
	status = "ok";
	compatible = "mediatek,mt6370_pmu";
	reg = <0x34>;
	interrupt-controller;
	#interrupt-cells = <1>;
	mt6370,intr_gpio_num = <3>; /* direct defined GPIO num */
	mt6370,intr_gpio = <&pio 3 0>; /* genernal GPIO */
	bled {
		compatible = "mediatek,mt6370_pmu_bled";
		interrupt-names = "bled_ocp", "bled_ovp";
		mt,bled_name = "mt6370_pmu_bled";
		//mt,ext_en_pin;
		mt,chan_en  = <0xf>; /* bit 0 1 2 3 -> chan 1 2 3 4 */
		mt,map_linear;
		mt,bl_ovp_level = <3>; /* 0 17v, 1 21v, 2 25v, 3 29v */
		mt,bl_ocp_level = <2>; /* 0 900mA, 1 1200mA, 2 1500mA, 3 1800mA */
		//mt,use_pwm;
		mt,pwm_fsample = <2>; /* 0 1MHz, 1 4MHz, 2 or 3 24mHz */
		mt,pwm_deglitch = <1>; /* 0 no filter, 1 100ns, 2 160ns, 3 200ns */
		mt,pwm_avg_cycle = <0>; /* 0 disable avg, 1 avg 2 cycle, 2 avg 4 cycle */
					/* 3 avg 8 cycle, 4 avg 16 cycle, 5 avg 32 cycle */
		mt,bled_ramptime = <3>; /* 0, 500us, 750us, 1ms, 2ms, 5ms, 10ms, 20ms */
					/* 50ms, 100ms, 250ms, 800ms, 1s, 2s, 4s, 8s */
		mt,bled_flash_ramp = <1>; /* 0, 500us, 750us, 1ms, 2ms, 5ms */
		mt,max_bled_brightness = <512>; /* we have 11 bit resolution, quantize in driver */
	};
};
```

## Documentation/devicetree/bindings/power/mt6370/mt6370_pmu_fled.txt
```
Mediatek MT6370 flashligh led subdev
MT6370 flashlight led control.

Required properties:
- compatible : Must be "mediatek,mt6370_pmu_fled";
- interrupt-names : MT6370 fled enabled interrupts.
	(R: required, O: optional)
	1.  (O)fled_strbpin: report whether the event of FLED strobe pin occurs.
	2.  (O)fled_torpin: report whether the event of FLED torch pin occures.
	3.  (O)fled_tx: report whether the event of FLED TX occurs.
	4.  (O)fled_lvp: report whether the event of FLED low VF occurs.
	5.  (R)fled2_short: report whether the event of FLED2 short occurs.
	6.  (R)fled1_short: report whether the event of FLED1 short occurs.
	7.  (O)fled2_strb: report whether the event of FLED2 strobe occurs.
	8.  (O)fled1_strb: report whether the event of FLED1 strobe occurs.
	9.  (O)fled2_strb_to: report whether the event of FLED2 strobe timeout occurs.
	10. (O)fled1_strb_to: report whether the event of FLED1 strobe timeout occurs.
	11. (O)fled2_tor: report whether the event of FLED2 torch occurs.
	12. (O)fled1_tor: repower whether the event of FLED1 torch occurs.


Optional node:
- torch_cur : 25000 ~ 400000 uA
- strobe_cur : 100000 ~  1500000 uA
- strobe_timeout : 64 ~ 2432 ms

Example:
mt6370_pmu@34 {
	status = "ok";
	compatible = "mediatek,mt6370_pmu";
	reg = <0x34>;
	interrupt-controller;
	#interrupt-cells = <1>;
	mt6370,intr_gpio_num = <3>; /* direct defined GPIO num */
	mt6370,intr_gpio = <&pio 3 0>; /* genernal GPIO */
	mt6370_pmu_fled1 {
		compatible = "mediatek,mt6370_pmu_fled1";
		interrupt-names = "fled_lvf", "fled2_short",
				  "fled1_short";
		torch_cur = <300000>;
		strobe_cur = <1200000>;
		strobe_timeout = <2400>;
	};
	mt6370_pmu_fled2 {
		compatible = "mediatek,mt6370_pmu_fled2";
		interrupt-names = "fled_lvf", "fled2_short",
				  "fled1_short";
		torch_cur = <200000>;
		strobe_cur = <1000000>;
		strobe_timeout = <1200>;
	};
};
```

## Documentation/devicetree/bindings/power/mt6370/mt6370_pmu_ldo.txt
```
Mediatek MT6370 Vib LDO subdev
MT6370 Vibrator ldo control.

Required properties:
- compatible : Must be "mediatek,mt6370_pmu_ldo";
- interrupt-names : MT6370 ldo enabled interrupts.
	(R:required, O:optional)
	1. (O)ldo_oc: report whether the event of LDO over current occurs.

- ldo_oms : ldo oms function, 0 -> floating, 1 -> discharge to ground for off mode.

Optional node:
- ldo_vrc : ldo voltage rampping control.
	    0 -> 1 step/16us, 1 -> 2 steps/16us, 2 -> 4 steps/16us, 3 -> 8 steps/16us.

Child node:
- mt6370_ldo : vib ldo regulator init setting.

Example:
mt6370_pmu@34 {
	status = "ok";
	compatible = "mediatek,mt6370_pmu";
	reg = <0x34>;
	interrupt-controller;
	#interrupt-cells = <1>;
	mt6370,intr_gpio_num = <3>; /* direct defined GPIO num */
	mt6370,intr_gpio = <&pio 3 0>; /* genernal GPIO */
	ldo {
		compatible = "mediatek,mt6370_pmu_ldo";
		interrupt-names = "ldo_oc";
		ldo_oms = <1>; /* 0: floating ; 1: discharge to ground for off mode */
		/* 0:  1 step/16us; 1 : 2 steps/16us; 2: 4 steps/16us; 3: 8steps/16us */
		/*ldo_vrc = <0>; */ /* to assign this  a value will also set en_vrc = 1 */
		ldo_vrc_lt = <1>; /* 0 : disable; 1: 10 us; 2: 20 us; 3: 40 us */
		mt6370_ldo {
			regulator-name = "mt6370_ldo"; /* change name by yourself */
			regulator-min-microvolt = <1600000>;
			regulator-max-microvolt = <4000000>; /* max == min then apply_uV = 1 */
			/* regulator-microvolt-offset = < 0>; optional*/
			/* regulator-boot-on = "yes"; optional, exist = enabled */
			/* regulator-always-on = "yes"; optional, exist = enabled */
			/* regulator-ramp-delay = <100>; optional*/
		};
	};
};
```

## Documentation/devicetree/bindings/richtek/rt5081/rt5081_pmu.txt
```
Richtek RT5081 I2C Sub-pmic

Richtek RT5081 is Integrated Sub Power Management Chips.
RT5081 integrates the functions included Charger, Backlight,
RGBLED, DisplayBias, Vib LDO, Flash LED.
Richtek RT5081 is connected to an i2c bus.


Required properties:
- compatible : Must be "richtek,rt5081_pmu";
- reg : Must be 0x34, it's RT5081 PMU default I2C Slave address.
- interrupt-controller : Since the RT5081 support several interrupts internally,
  it is considered as an interrupt controller cascaded to the SoC one.
- #interrupt-cells = <1>;
/* If CONFIG_MTK_GPIOLIB_STAND is defined, rt,intr_gpio_num is used. Otherwise we use rt,intr_gpio. */
- rt,intr_gpio_num : IRQ GPIO pin that's connected to RT5081 interrupt.
- rt,intr_gpio : general IRQ GPIO pin.

Optional node:
- core : core subdev for RT5081 core part.
- charger : charger subdev for RT5081 charger part.
- fled : flash led subdev for RT5081 flashLED part.
- ldo : ldo subdev for RT5081 Vib LDO part.
- rgbled : rgbled subdev for RT5081 RGB indicator part.
- bled : backlight subdev for RT5081 backlight led part.
- dsv : dsv subdev for RT5081 display bias part.


Example:
rt5081_pmu@34 {
	status = "ok";
	compatible = "richtek,rt5081_pmu";
	reg = <0x34>;
	interrupt-controller;
	#interrupt-cells = <1>;
	rt,intr_gpio_num = <3>; /* direct defined GPIO num */
	rt,intr_gpio = <&pio 3 0>; /* genernal GPIO */
};
```
