## Documentation/devicetree/bindings/richtek/rt5081/rt5081_pmu_rgbled.txt
```
Richtek RT5081 rgb led subdev
RT5081 rgb led control.

Required properties:
- compatible : Must be "richtek,rt5081_pmu_rgbled";
- interrupt-names : RT5081 rgbled enabled interrupts.
	(R:required, O:optional)
	1. (O)isink4_short: isink4 short led event.
	2. (O)isink3_short: isink3 short led event.
	3. (O)isink2_short: isink2 short led event.
	4. (O)isink1_short: isink1 short led event.
	5. (O)isink4_open: isink4 open led event.
	6. (O)isink3_open: isink3 open led event.
	7. (O)isink2_open: isink2 open led event.
	8. (O)isink1_open: isink1 open led event.

- rt,led_name : led classdev name for each led channel.
- rt,led_default_trigger : default led trigger mode. cc_mode -> constant current mode,
			   pwm_mode -> pwm mode, breath_mode -> breath mode.

Optional node:

Example:
rt5081_pmu@34 {
	status = "ok";
	compatible = "richtek,rt5081_pmu";
	reg = <0x34>;
	interrupt-controller;
	#interrupt-cells = <1>;
	rt,intr_gpio_num = <3>; /* direct defined GPIO num */
	rt,intr_gpio = <&pio 3 0>; /* genernal GPIO */
	rgbled {
		compatible = "richtek,rt5081_pmu_rgbled";
		interrupt-names = "isink4_short", "isink3_short",
				  "isink2_short", "isink1_short",
				  "isink4_open", "isink3_open",
				  "isink2_open", "isink1_open";
		/* name cnt must be 4 */
		rt,led_name = "rt5081_pmu_led1", "rt5081_pmu_led2",
			      "rt5081_pmu_led3", "rt5081_pmu_led4";
		/* trigger cnt must be 4, mode can be selected as */
		/* cc_mode -> const current mode */
		/* pwm_mode -> pwm dimming mode */
		/* breath_mode -> as the name */
		rt,led_default_trigger = "cc_mode", "cc_mode",
					 "cc_mode", "cc_mode";
	};
};
```

## Documentation/devicetree/bindings/soc/mediatek/scpsys.txt
```
MediaTek SCPSYS
===============

The System Control Processor System (SCPSYS) has several power management
related tasks in the system. The tasks include thermal measurement, dynamic
voltage frequency scaling (DVFS), interrupt filter and lowlevel sleep control.
The System Power Manager (SPM) inside the SCPSYS is for the MTCMOS power
domain control.

The driver implements the Generic PM domain bindings described in
power/power_domain.txt. It provides the power domains defined in
include/dt-bindings/power/mt8173-power.h.

Required properties:
- compatible: Must be "mediatek,mt8173-scpsys"
- #power-domain-cells: Must be 1
- reg: Address range of the SCPSYS unit
- infracfg: must contain a phandle to the infracfg controller

Example:

	scpsys: scpsys@10006000 {
		#power-domain-cells = <1>;
		compatible = "mediatek,mt8173-scpsys";
		reg = <0 0x10006000 0 0x1000>;
		infracfg = <&infracfg>;
	};

Example consumer:

	afe: mt8173-afe-pcm@11220000 {
		compatible = "mediatek,mt8173-afe-pcm";
		power-domains = <&scpsys MT8173_POWER_DOMAIN_AUDIO>;
	};
```

## Documentation/devicetree/bindings/spi/spi-mt65xx.txt
```
MTK SPI device

Required properties:
- compatible: should be one of the following.
    - mediatek,mt8173-spi: for mt8173 platforms
    - mediatek,mt8135-spi: for mt8135 platforms
    - mediatek,mt6589-spi: for mt6589 platforms
    - mediatek,mt8173-spi: for mt2701 platforms

- reg: Address and length of the register set for the device

- interrupts: Should contain spi interrupt

- clock-names: tuple listing input clock names.
	Required elements: "main"

- clocks: phandles to input clocks.

- pad-select: should specify spi pad used, only required for MT8173.
	This value should be 0~3.

Example:

- SoC Specific Portion:
spi: spi@1100a000 {
	compatible = "mediatek,mt8173-spi";
	reg = <0 0x1100a000 0 0x1000>;
	interrupts = <GIC_SPI 110 IRQ_TYPE_LEVEL_LOW>;
	clocks = <&pericfg PERI_SPI0>;
	clock-names = "main";
	pad-select = <1>;
	status = "disabled";
};
```

## Documentation/devicetree/bindings/watchdata/watchdata,wdtee.txt
```
Watchdata TEE Feature

Required properties
        - compatible: Should be "watchdata,wdtee.txt"

Example:
        wdtee {
                compatible = "watchdata,wdtee";
        };
```
