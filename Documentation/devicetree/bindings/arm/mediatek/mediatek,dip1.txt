## Documentation/devicetree/bindings/richtek/rt5081/rt5081_pmu_bled.txt
```
Richtek RT5081 backlight led subdev
RT5081 backlight led control.

Required properties:
- compatible : Must be "richtek,rt5081_pmu_bled";
- interrupt-names : RT5081 bled enabled interrupts.
	(R: required, O: optional)
	1. (O)bled_ocp: Backlight over current flag.
	2. (O)bled_ovp: Backlight over voltage protection flag.

- rt,bled_name : led classdev name.
- rt,chan_en : channel enabled bit 0 1 2 3 -> chan 1 2 3 4.
	       ex. enable all 4 channal 0xf. only enable channel 1 and 3 configure 0x5.
- rt,bl_ovp_level : 0 -> 17V, 1 -> 21V, 2 -> 25V, 3 -> 29V.
- rt,bl_ocp_level : 0 -> 900mA, 1 -> 1200mA, 2 -> 1500mA, 3 -> 1800mA.
- rt,pwm_fsample : 0 -> 1MHz, 1 -> 4MHz, 2 or 3 24MHz.
- rt,pwm_deglitch : 0 -> no filter, 1 -> 100ns, 2 -> 160ns, 3 -> 200ns.
- rt,pwm_avg_cycle : 0 -> disable avg, 1 -> avg 2 cycles, 2 -> avg 4 cycles.
		     3 -> avg 8 cycles, 4 -> avg 16 cycles, 5 -> avg 32 cycles.
- rt,bled_ramptime : 0 -> 0us, 1 -> 500us, 2 -> 750us, 3 -> 1ms, 4 -> 2ms, 5 -> 5ms, 6 -> 10ms,
		     7 -> 20ms, 8 -> 50ms, 9 -> 100ms, 10 -> 250ms, 11 -> 800ms, 12 -> 1s,
		     13 -> 2s, 14 -> 4s, 15 -> 8s.
- rt,bled_flash_ramp : 0 -> 0us, 1 -> 500us, 2 -> 750us, 3 -> 1ms, 4 -> 2ms, 5 -> 5ms.
- rt,max_bled_brightness : default max backlight brightness setting.

Optional node:

Example:
rt5081_pmu@34 {
	status = "ok";
	compatible = "richtek,rt5081_pmu";
	reg = <0x34>;
	interrupt-controller;
	#interrupt-cells = <1>;
	rt,intr_gpio_num = <3>; /* direct defined GPIO num */
	rt,intr_gpio = <&pio 3 0>; /* genernal GPIO */
	bled {
		compatible = "richtek,rt5081_pmu_bled";
		interrupt-names = "bled_ocp", "bled_ovp";
		rt,bled_name = "rt5081_pmu_bled";
		//rt,ext_en_pin;
		rt,chan_en  = <0xf>; /* bit 0 1 2 3 -> chan 1 2 3 4 */
		rt,map_linear;
		rt,bl_ovp_level = <3>; /* 0 17v, 1 21v, 2 25v, 3 29v */
		rt,bl_ocp_level = <2>; /* 0 900mA, 1 1200mA, 2 1500mA, 3 1800mA */
		//rt,use_pwm;
		rt,pwm_fsample = <2>; /* 0 1MHz, 1 4MHz, 2 or 3 24mHz */
		rt,pwm_deglitch = <1>; /* 0 no filter, 1 100ns, 2 160ns, 3 200ns */
		rt,pwm_avg_cycle = <0>; /* 0 disable avg, 1 avg 2 cycle, 2 avg 4 cycle */
					/* 3 avg 8 cycle, 4 avg 16 cycle, 5 avg 32 cycle */
		rt,bled_ramptime = <3>; /* 0, 500us, 750us, 1ms, 2ms, 5ms, 10ms, 20ms */
					/* 50ms, 100ms, 250ms, 800ms, 1s, 2s, 4s, 8s */
		rt,bled_flash_ramp = <1>; /* 0, 500us, 750us, 1ms, 2ms, 5ms */
		rt,max_bled_brightness = <512>; /* we have 11 bit resolution, quantize in driver */
	};
};
```

## Documentation/devicetree/bindings/richtek/rt5081/rt5081_pmu_charger.txt
```
Richtek RT5081 switching charger subdev
RT5081 switching charger control

Required properties:
- compatible : Must be "richtek,rt5081_pmu_charger";
- interrupt-names : RT5081 switching charger enabled interrupts.
	(R: required, O: optional, D: disable)
	1.  (O) chg_treg: thermal regulation loop active.
	2.  (O) chg_aicr: input current, AICR loop active.
	3.  (R) chg_mivr: input voltage, MIVR loop active.
	4.  (O) pwr_rdy: power ready detection result.
	5.  (O) chg_vinovp: CHG_VIN over voltage protection fault.
	6.  (O) chg_vsysuv: system UVP fault.
	7.  (O) chg_vsysov: system OVP fault.
	8.  (O) chg_vbatov: battery OVP fault.
	9.  (R) chg_vbusov: VBUS over voltage protection fault.
	10. (O) ts_bat_cold: battery temperature fault. temperature is in cold zone.
	11. (O) ts_bat_cool: battery temperature fault. temperature is in cool zone.
	12. (O) ts_bat_warm: battery temperature fault. temperature is in warm zone.
	13. (O) ts_bat_hot: battery temperature fault. temperature is in hot zone.
	14. (R) chg_tmri: charger timer timeout fault.
	15. (O) chg_batabsi: battery absence fault.
	16. (O) chg_adpbadi: charger bad adapter fault.
	17. (O) chg_rvpi: charger reverse protection fault.
	18. (O) otpi: thermal shutdown fault.
	19. (R) chg_aiclmeasi: AICL measurement function done event.
	20. (O) chg_ichgmeasi: ICHG measurement function done event.
	21. (O) chgdet_donei: charger type detection done event.
	22. (R) chg_wdtmri: watch dog timer timeout fault.
	23. (D) ssfinishi: charger or boost softstart finishes event.
	24. (R) chg_rechgi: recharge behavior ever occurs.
	25. (O) chg_termi: charge terminated event.
	26. (R) chg_ieoci: charging current is lower than EOC current ever occurs.
	27. (R) adc_donei: ADC measurement done event.
	28. (D) pumpx_donei: MTK pump express function done event.
	29. (O) bst_batuvi: boost low voltage input fault.
	30. (O) bst_vbusovi: boost VMID OVP fault event.
	31. (O) bst_olpi: boost overload protection event.
	32. (R) attachi: vbus attach.
	33. (O) detachi: vbus detach. VBUSPG_D goes from 1 to 0.
	34. (O) hvdcp_det: whether HVDCP is detected by DCP's pulling D- to GND.
	35. (O) chgdeti: Output of USB charger detection.
	36. (O) dcdti: Data contact detection event.
	37. (O) dirchg_vgoki: VG charge pump ready event.
	38. (O) dirchg_wdtmri: in LVHI mode, watchdog fault event.
	39. (O) dirchg_uci: in LVHI mode, TA un-connect fault event.
	40. (O) dirchg_oci: in LVHI mode, IBUS over current fault event.
	41. (O) dirchg_ovi: in LVHI mode, BAT over voltage fault event.
	42. (O) ovpctrl_swon_evt: OVPCTRL_MOS is turned on.
	43. (R) ovpctrl_uvp_d_evt: OVPCTRL_VBUS is under voltage protection fault with 128us deglitc time.
	44. (O) ovpctrl_uvp_evt: OVPCTRL_VBUS under voltage protection fault.
	45. (O) ovpctrl_ovp_d_evt: OVPCTRL_VBUS over voltage protection fault with 128us deglitch time.
	46. (O) ovpctrl_ovp_evt: OVPCTRL_VBUS over voltage protection fault.

Optional node:
- charger_name : charger classdev name.
- load_switch_name : charger classdev name for load switch.
- ichg : 100000 ~ 5000000 uA.
- aicr : 100000 ~ 3250000 uA.
- mivr : 3900000 ~ 13400000 uV.
- cv : 3900000 ~ 4710000 uV.
- ieoc : 100000 ~ 850000 uA.
- safety_timer : 4, 6, 8, 10, 12, 14, 16, 20 hours.
- dc_wdt : 125000, 250000, 500000, 1000000, 2000000, 4000000, 8000000 us.
- ircmp_resistor : 0, 25000, 50000, 75000, 100000, 125000, 150000, 175000 uohm.
- ircmp_vclamp : 0, 32000, 64000, 96000, 128000, 160000, 192000, 224000 uV.
- enable_te : Charging termination function enable.
              comment this line to disable this function.
- enable_wdt: Watchdog timer function enable.
              comment this line to disable this function.

Example:
rt5081_pmu@34 {
	status = "ok";
	compatible = "richtek,rt5081_pmu";
	reg = <0x34>;
	interrupt-controller;
	#interrupt-cells = <1>;
	rt,intr_gpio_num = <3>; /* direct defined GPIO num */
	rt,intr_gpio = <&pio 3 0>; /* genernal GPIO */
	charger {
		compatible = "richtek,rt5081_pmu_charger";
		interrupt-names = "adc_donei", "chg_mivr",
			"chg_aiclmeasi","attachi", "ovpctrl_uvp_d_evt",
			"chg_wdtmri", "chg_vbusov", "chg_rechgi";
		charger_name = "primary_chg";
		load_switch_name = "primary_load_switch";
		ichg = <2000000>;	/* uA */
		aicr = <500000>;	/* uA */
		mivr = <4400000>;	/* uV */
		cv = <4350000>;		/* uA */
		ieoc = <150000>;	/* uA */
		safety_timer = <12>;	/* hour */
		dc_wdt = <4000000>;	/* us */
		ircmp_resistor = <25000>;	/* uohm */
		ircmp_vclamp = <32000>;		/* uV */
		enable_te;
		enable_wdt;
		/* enable_polling; */	/* is this charger needs polling */
	};
};
```

## Documentation/devicetree/bindings/richtek/rt5081/rt5081_pmu_core.txt
```
Richtek RT5081 core subdev
RT5081 core control.

Required properties:
- compatible : Must be "richtek,rt5081_pmu_core";
- interrupt-names : RT5081 core enabled interrupts.
	(R:required, O:optional)
	1. (O)otpi: report whether the protection event of OTP ever occurs.
	2. (O)vdda_ovp: report whether the protection event of VDDA OVP occurs.
	3. (O)vdda_uv: report whether the protection event of VDDA UVLO occurs.

- i2cstmr_rst_tmr : i2c safe timer selection, 0 -> 0.5s, 1 -> 0.75s, 2 -> 1s, 3 -> 2s.
- mrstb_tmr : debounce time selection for external reset pin. 0 -> 0.75s, 1 -> 1s, 2 -> 1.25s,
	      3 -> 1.5s, 4 -> 1.75s, 5 -> 2s, 6 -> 2.25s, 7 -> 2.5s.
- int_wdt : interrupt pin watchdog timer selection, 0 -> disable interrupt watchdog timer, 1 -> 250ms,
	    2 -> 500ms, 3-> 1s.
- int_deg : interrupt pin deglitch timer selection, 0 -> 1ms, 1 -> 2ms, 2 -> 5ms, 3 -> 10ms.

Optional node:
- i2cstmr_rst_en : i2c safe timer reset function enable,
		   comment this line to disable this function.
- mrstb_en : external reset pin function enalbe,
	     comment this line to disable this function.

Example:
rt5081_pmu@34 {
	status = "ok";
	compatible = "richtek,rt5081_pmu";
	reg = <0x34>;
	interrupt-controller;
	#interrupt-cells = <1>;
	rt,intr_gpio_num = <3>; /* direct defined GPIO num */
	rt,intr_gpio = <&pio 3 0>; /* genernal GPIO */
	core {
		compatible = "richtek,rt5081_pmu_core";
		interrupt-names = "otp", "vdda_ovp", "vdda_uv";
		//i2cstmr_rst_en; /* i2c safe timer reset function */
		i2cstmr_rst_tmr = <0>; /* 0: 0.5s, 1: 0.75s, 2: 1s, 3: 2s */
		//mrstb_en; /* external reset pin enable */
		mrstb_tmr = <0>; /* 0: 0.75s, 1: 1s, 2: 1.25s, 3: 1.5s */
				 /* 4: 1.75s, 5: 2s, 6: 2.25s, 7: 2.5s */
		int_wdt = <0>; /* 0: disable, 1: 250ms, 2: 500ms, 3: 1s */
		int_deg = <0>; /* interrupt deglitch, 0: 1ms, 1: 2ms, 2: 5ms, 3: 10ms */
	};
};
```

## Documentation/devicetree/bindings/richtek/rt5081/rt5081_pmu_dsv.txt
```
Richtek RT5081 DSV display bias subdev
RT5081 display bias control.

Required properties:
- compatible : Must be "richtek,rt5081_pmu_dsv";
- interrupt-names : RT5081 dsv enabled interrupts.
	(R:required, O:optional)
	1. dsv_vneg_ocp: vneg's over current flag.
	2. dsv_vpos_ocp: vpos's over current flag.
	3. dsv_bst_ocp: boost voltage of DB's over circuit.
	4. dsv_vneg_scp: vneg's short circuit protection.
	5. dsv_vpos_scp: vpos's short circuit protection.

- db_ext_en : 0 for i2c control, 1 for external pin control.
- db_periodic_fix : 0 disable, 1 -> prevent from voltage drop when db is restart.
- db_single_pin : 0 -> vpos and vneg are controlled by db_enp and db_enm,
		  1 -> single pin control.
- db_freq_pm : 0 -> 20Hz, 1 -> 33Hz, the value is valid only when db_period_mode = 1.
- db_periodic_mode : 0 = always on if db is enabled; 1 = DB period mode.
- db_startup : 0 -> close loop, wait 80%; 1 = open loop, go after soft-start dimming.
- db_vneg_20ms : 0 disable, 1 -> DB_VNEG discharge 20ms when shutdown.
- db_vneg_disc : 0 disable, 1 -> discharge vneg when turn off.
- db_vpos_20ms : 0 disable, 1 -> DB_VPOS discharge 20ms when shutdown.
- db_vpos_disc : 0 disable, 1 -> discharge vpos when turn off.
- db_delay : 0 no constraint, 1 -> 0ms, 2 -> 1ms, 3, 4ms.
- db_vbst : vboost voltage, need greater than dsv_pos & dsv_neg 200mV.
- db_vpos_slew : 0 -> 8.46 V/ms, 1 -> 5.79 V/ms, 2 -> 3.87 V/ms, 3 -> 2.97 V/ms.
- db_vneg_slew : 0 -> -9.24V/ms, 1 -> -5.97V/ms, 2 -> -4.82V/ms, 3 -> -3.07V/ms.

Optional node:

Child node:
- rt5081_dsvn : rt5081_dsv vneg initial setting.
- rt5081_dsvp : rt5081_dsv vpos initial setting.

Example:
rt5081_pmu@34 {
	status = "ok";
	compatible = "richtek,rt5081_pmu";
	reg = <0x34>;
	interrupt-controller;
	#interrupt-cells = <1>;
	rt,intr_gpio_num = <3>; /* direct defined GPIO num */
	rt,intr_gpio = <&pio 3 0>; /* genernal GPIO */
	dsv {
		compatible = "richtek,rt5081_pmu_dsv";
		interrupt-names = "dsv_vneg_ocp", "dsv_vpos_ocp",
				  "dsv_bst_ocp", "dsv_vneg_scp",
				  "dsv_vpos_scp";
		db_ext_en = <0>;  /* 0 = i2c ctrl; 1 = ext pin */
		db_periodic_fix = <0>; /* 1 = prevent from voltage drop when db is restart */
		db_single_pin = <0>; /* 0 => VOS & VNEG are ctrled by DB_ENP & DB_ENN; 1 : single pin ctrl*/
		db_freq_pm = <0>; /*  0 = 20Hz ; 1 = 33Hz; valid if db_period_mode = 1 */
		db_periodic_mode = <0>; /* 0 = always on if DB is enabled; 1 = DB period mode */
		db_startup = <0>; /* 0 = close loop, wait 80%; 1 = open loop, go after soft-start dimming */
		db_vneg_20ms = <1>; /* 1 = DB VNEG discharge 20ms when shutdown; 0 = disable */
		db_vneg_disc = <0>; /*  1 = Discharge VNEG when turn off; 0 = disable */
		db_vpos_20ms = <1>; /* 1 = DB VPOS discharge 20ms when shutdown; 0 = disable */
		db_vpos_disc = <0>; /*  1 = Discharge VPOS when turn off; 0 = disable */
		db_delay = <3>; /* 0 = no constraint; 1 = 0 ms; 2 = 1 ms; 3 = 4 ms */
		db_vbst  = <5700>; /* mV */
		db_vpos_slew = <1>; /* 0 : 8.46 V/ms; 1 : 5.79 V/ms; 2: 3.87 V/ms; 3: 2.97V/ms */
		db_vneg_slew = <1>; /* 0: -9.24V/ms; 1: -5.97V/ms; 2: -4.82V/ms; 3: -3.07V/ms*/
		rt5081_dsvp {
			regulator-name = "dsv_pos"; /* change name by yourself */
			regulator-min-microvolt = <4000000>;
			regulator-max-microvolt = <6000000>; /* max == min then apply_uV = 1 */
			/* regulator-microvolt-offset = < 0>; optional*/
			/* regulator-boot-on = "yes"; optional, exist = enabled */
			/* regulator-always-on = "yes"; optional, exist = enabled */
			/* regulator-ramp-delay = <100>; optional*/
		};
		rt5081_dsvn {
			regulator-name = "dsv_neg"; /* change name by yourself */
			regulator-min-microvolt = <4000000>;
			regulator-max-microvolt = <6000000>; /* max == min then apply_uV = 1 */
			/* regulator-microvolt-offset = < 0>; optional*/
			/* regulator-boot-on = "yes"; optional, exist = enabled */
			/* regulator-always-on = "yes"; optional, exist = enabled */
			/* regulator-ramp-delay = <100>; optional*/
		};
	};
};
```

## Documentation/devicetree/bindings/richtek/rt5081/rt5081_pmu_fled.txt
```
Richtek RT5081 flashligh led subdev
RT5081 flashlight led control.

Required properties:
- compatible : Must be "richtek,rt5081_pmu_fled";
- interrupt-names : RT5081 fled enabled interrupts.
	(R: required, O: optional)
	1.  (O)fled_strbpin: report whether the event of FLED strobe pin occurs.
	2.  (O)fled_torpin: report whether the event of FLED torch pin occures.
	3.  (O)fled_tx: report whether the event of FLED TX occurs.
	4.  (O)fled_lvp: report whether the event of FLED low VF occurs.
	5.  (R)fled2_short: report whether the event of FLED2 short occurs.
	6.  (R)fled1_short: report whether the event of FLED1 short occurs.
	7.  (O)fled2_strb: report whether the event of FLED2 strobe occurs.
	8.  (O)fled1_strb: report whether the event of FLED1 strobe occurs.
	9.  (O)fled2_strb_to: report whether the event of FLED2 strobe timeout occurs.
	10. (O)fled1_strb_to: report whether the event of FLED1 strobe timeout occurs.
	11. (O)fled2_tor: report whether the event of FLED2 torch occurs.
	12. (O)fled1_tor: repower whether the event of FLED1 torch occurs.


Optional node:
- fled_ctrl_sel : 0 -> none, 1 -> control led1, 2 -> control led2, 3 -> control both
- torch_cur : 25000 ~ 400000 uA
- strobe_cur : 100000 ~  1500000 uA
- strobe_timeout : 64 ~ 2432 ms

Example:
rt5081_pmu@34 {
	status = "ok";
	compatible = "richtek,rt5081_pmu";
	reg = <0x34>;
	interrupt-controller;
	#interrupt-cells = <1>;
	rt,intr_gpio = <&msmgpio 66 0>;
	fled {
		compatible = "richtek,rt5081_pmu_fled";
		interrupt-names = "fled_lvf", "fled2_short",
				  "fled1_short";
		fled_ctrl_sel = <2>;
		torch_cur = <25000>;
		strobe_cur = <100000>;
		strobe_timeout = <96>;
	};
};
```
