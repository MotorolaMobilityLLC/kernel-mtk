## arch/arm64/mach-mtk/Kconfig
```kconfig
menu "MTK Board Configure"

config ARCH_MTK_FLORIDA_BOARD
      tristate "MTK Platform sound board Configure"
      default y if MFD_ARIZONA
      help 
           To add board for Soc audio on MTK Platform

endmenu
   
      
```

## drivers/block/zram/Kconfig
```kconfig
config ZRAM
	tristate "Compressed RAM block device support"
	depends on BLOCK && SYSFS && ZSMALLOC
	select LZO_COMPRESS
	select LZO_DECOMPRESS
	default n
	help
	  Creates virtual block devices called /dev/zramX (X = 0, 1, ...).
	  Pages written to these disks are compressed and stored in memory
	  itself. These disks allow very fast I/O and compression provides
	  good amounts of memory savings.

	  It has several use cases, for example: /tmp storage, use as swap
	  disks and maybe many more.

	  See zram.txt for more information.

config ZRAM_LZ4_COMPRESS
	bool "Enable LZ4 algorithm support"
	depends on ZRAM
	select LZ4_COMPRESS
	select LZ4_DECOMPRESS
	default n
	help
	  This option enables LZ4 compression algorithm support. Compression
	  algorithm can be changed using `comp_algorithm' device attribute.

config ZRAM_LZ4K_COMPRESS
	bool "Enable LZ4K algorithm support"
	depends on ZRAM
	select LZ4K
	default n
	help
	  This option enables Mediatek's LZ4K compression algorithm support.
	  Compression algorithm can be changed using `comp_algorithm' device
	  attribute.


config HWZRAM_IMPL
       bool "Hardware version of ZRAM"
       default n
       help
        This is a hardware implementation layer for hwzram block device driver,
        which is used to control hardware operations of specific HW modules.
        This is used to replace ZRAM with faster HW compression/decompression
        or better compression ratio.
        If there is corresponding hardware module, please enable it.

config HWZRAM_DRV
       bool "Block device on top of hardware version of ZRAM"
       default n
       help
        Block device on top of hardware version of ZRAM.
        Before enabling HWZRAM_IMPL, you should enable this option.
        This imitates the implementation of ZRAM but with the hook of HW
        implementation in HWZRAM_IMPL.

config HWZRAM_DEBUG
       bool "Debug message for hardware version of ZRAM"
       default n
       help
        Debug option for hwzram driver.
        This is an option for development. You can enable it to
        get more information about HW compression/decompression
        flow and try to enhance it.

if HWZRAM_IMPL

source "drivers/block/zram/vendor/Kconfig"

endif # HWZRAM_IMPL
```

## drivers/block/zram/vendor/Kconfig
```kconfig
config MTK_UFOZIP
       bool "MediaTek Hardware Compression Engine"
       default n
       help
        This is an implementation for MediaTek proprietary
	hardware compression engine. It can provide better
	compression ratio or power saving. Anyone wants to
	use it needs to implement upper SW layer to control
	compression/decompression operations.
```

## drivers/clk/mediatek/Kconfig
```kconfig
#
# MediaTek SoC drivers
#
config COMMON_CLK_MEDIATEK
	bool
	---help---
	  Mediatek SoCs' clock support.

config COMMON_CLK_MEDIATEK_NEW
	bool
	select COMMON_CLK_MEDIATEK
	---help---
	  A newer version of Mediatek clock common code support.

config COMMON_CLK_MEDIATEK_V1
	bool
	select COMMON_CLK_MEDIATEK
	---help---
	  An older version (V1) of Mediatek clock common code support.

config COMMON_CLK_MT6739
	bool "Clock driver for Mediatek MT6739"
	depends on COMMON_CLK
	select COMMON_CLK_MEDIATEK_NEW
	default y if MACH_MT6739 && !MTK_CLKMGR && !FPGA_EARLY_PORTING
	---help---
	  This driver supports Mediatek MT6739 clocks.
	  Use the config to support CCF on MT6739,
	  instead of old clkmgr architecture.
	  MT6739 default will use CCF.

config COMMON_CLK_MT6757
	bool "Clock driver for Mediatek MT6757"
	depends on COMMON_CLK
	select COMMON_CLK_MEDIATEK_V1
	default y if (MACH_MT6757 || MACH_KIBOPLUS) && !MTK_CLKMGR
	---help---
	  This driver supports Mediatek MT6757 clocks.
	  Use the config to support CCF on MT6757,
	  instead of old clkmgr architecture.
	  MT6757 default will use CCF.

config COMMON_CLK_MT6758
	bool "Clock driver for Mediatek MT6758"
	depends on COMMON_CLK
	select COMMON_CLK_MEDIATEK_NEW
	default y if MACH_MT6758 && !MTK_CLKMGR && !FPGA_EARLY_PORTING
	---help---
	  This driver supports Mediatek MT6758 clocks.
	  Use the config to support CCF on MT6758,
	  instead of old clkmgr architecture.
	  MT6758 default will use CCF.

config COMMON_CLK_MT6759
	bool "Clock driver for Mediatek MT6759"
	depends on COMMON_CLK
	select COMMON_CLK_MEDIATEK_NEW
	default y if MACH_MT6759 && !MTK_CLKMGR && !FPGA_EARLY_PORTING
	---help---
	  This driver supports Mediatek MT6759 clocks.
	  Use the config to support CCF on MT6759,
	  instead of old clkmgr architecture.
	  MT6759 default will use CCF.

config COMMON_CLK_MT6763
	bool "Clock driver for Mediatek MT6763"
	depends on COMMON_CLK
	select COMMON_CLK_MEDIATEK_NEW
	default y if MACH_MT6763 && !MTK_CLKMGR && !FPGA_EARLY_PORTING
	---help---
	  This driver supports Mediatek MT6763 clocks.
	  Use the config to support CCF on MT6763,
	  instead of old clkmgr architecture.
	  MT6763 default will use CCF.

config COMMON_CLK_MT6771
	bool "Clock driver for Mediatek MT6771"
	depends on COMMON_CLK
	select COMMON_CLK_MEDIATEK_NEW
	default y if MACH_MT6771 && !MTK_CLKMGR && !FPGA_EARLY_PORTING
	---help---
	  This driver supports Mediatek MT6771 clocks.
	  Use the config to support CCF on MT6771,
	  instead of old clkmgr architecture.
	  MT6771 default will use CCF.

config COMMON_CLK_MT6775
	bool "Clock driver for Mediatek MT6775"
	depends on COMMON_CLK
	select COMMON_CLK_MEDIATEK_NEW
	default y if MACH_MT6775 && !MTK_CLKMGR && !FPGA_EARLY_PORTING
	---help---
	  This driver supports Mediatek MT6775 clocks.
	  Use the config to support CCF on MT6775,
	  instead of old clkmgr architecture.
	  MT6775 default will use CCF.

config COMMON_CLK_MT6799
	bool "Clock driver for Mediatek MT6799"
	depends on COMMON_CLK
	select COMMON_CLK_MEDIATEK_NEW
	default y if MACH_MT6799 && !MTK_CLKMGR
	---help---
	  This driver supports Mediatek MT6799 clocks.
	  Use the config to support CCF on MT6799,
	  instead of old clkmgr architecture.
	  MT6799 default will use CCF.

config COMMON_CLK_MT8167
	bool "Clock driver for Mediatek MT8167"
	depends on COMMON_CLK
	select COMMON_CLK_MEDIATEK_NEW
	default y if MACH_MT8167 && !FPGA_EARLY_PORTING
	---help---
	  This driver supports Mediatek MT8167 clocks,
	  which descripts the whole clock hierarchy about
	  IC; It will be used to enable IC-special driver
	  part of CCF framework on MT8167 platform.
```

## drivers/fps/Kconfig
```kconfig
# SPDX-License-Identifier: GPL-2.0
menu "Fps Drivers"

source "drivers/fps/fpc/Kconfig"
source "drivers/fps/egis/Kconfig"
source "drivers/fps/goodix/Kconfig"
endmenu
```

## drivers/fps/egis/Kconfig
```kconfig
#
# fp_sensor driver configuration
#
config EGIS_FINGERPRINT
	tristate "egis fingerPrint sensor"
	default y
#	depends on SPI_MASTER
	help
		add for support egis FP Sensor.
```

## drivers/fps/fpc/Kconfig
```kconfig
config CONFIG_FPC1020_SUPPORT
    tristate "FPC Fingerprint"
    default y
    help
      Support FPC capacitive fingerprint sensor device.
```

## drivers/fps/goodix/Kconfig
```kconfig
#
#Fingerprint
#

config GOODIX_FINGERPRINT
	tristate "Goodix Fingerprint"
	default y
	help
	Goodix Fingerprint chip GF3208/GF3206/GF3266/GF3288/GF5206/GF5216/GF5208/GF3626ZS2 TEE driver

config GOODIX_SENSOR_TYPE
	string "SENSOR_TYPE"
	default "GF3626ZS2"
	help
	Must input sensor type, or default is GF3208 GF3206 GF3266 GF3288 GF5206 GF5216 GF5208 GF3626ZS2
```

## drivers/input/fingerprint/ET528/Kconfig
```kconfig
#
# fp_sensor driver configuration
#
config MTK_FINGERPRINT
	tristate "egis fingerPrint sensor"
	depends on SPI_MASTER
	help
		add for support egis FP Sensor.
```

## drivers/input/fingerprint/Kconfig
```kconfig
#
#Fingerprint
#
menu "Fingerprint support"
	depends on INPUT

config MTK_FINGERPRINT_SUPPORT
	bool "Mediatek Fingerprint"
	default n
	help
	  Fingerprint mtk driver enable/disable
	  in the kernel.Say Y here if you want to
	  use mediatek fingerprint driver,fingerprint
	  driver will support fingerprint function

config MTK_FINGERPRINT_SELECT
	string "sensor type"
	default "GF318M"

source drivers/input/fingerprint/fps_fpc_M00/Kconfig
source drivers/input/fingerprint/fps_egis_M00/Kconfig

endmenu
```

## drivers/input/fingerprint/betterlife_tee/Kconfig
```kconfig
config BETTERLIFE_FINGERPRINT
    bool "betterlife Fingerprint"
	default n
	---help---
	betterlife fingerprint.
```

## drivers/input/fingerprint/egistec/Kconfig
```kconfig
config FINGERPRINT_EGISTEC_ET360
	tristate "Egistec fingerprint drvier support"
	depends on INPUT_FINGERPRINT
	help
	  Say Y here to enable egistec fingerprint driver support!  
```

## drivers/input/fingerprint/focaltech/Kconfig
```kconfig
config MICROTRUST_FP_FOCALTECH
	tristate "Focaltech Finger Print Driver"
   	help
		Focaltech Finger Print Supported
```
