## arch/arm/mach-mediatek/Kconfig
```kconfig
menuconfig ARCH_MEDIATEK
	bool "Mediatek MT65xx & MT81xx SoC" if ARCH_MULTI_V7
	select ARM_GIC
	select PINCTRL
	select MTK_TIMER
	select MFD_SYSCON
	help
	  Support for Mediatek MT65xx & MT81xx SoCs

if ARCH_MEDIATEK

config MACH_MT6589
	bool "MediaTek MT6589 SoCs support"
	default ARCH_MEDIATEK

config MACH_MT6592
	bool "MediaTek MT6592 SoCs support"
	default ARCH_MEDIATEK

config MACH_MT8127
	bool "MediaTek MT8127 SoCs support"
	default ARCH_MEDIATEK

config MACH_MT8135
	bool "MediaTek MT8135 SoCs support"
	default ARCH_MEDIATEK

endif

config MACH_MT6757
	bool "MediaTek MT6757"
	select GENERIC_TIME
	select GENERIC_CLOCKEVENTS
	select ARCH_HAS_CPUFREQ
	select ARM_AMBA
	select CPU_V7
	select HAVE_SMP
	select IRQ_DOMAIN
	select IRQ_DOMAIN_DEBUG
	select GENERIC_SCHED_CLOCK
	select MTK_SYS_CIRQ
	select MTK_EIC
	select ARMV7_COMPAT
	select ARMV7_COMPAT_CPUINFO
	select CPU_IDLE
	select KERNEL_MODE_NEON
	select PINCTRL
	select PINCTRL_MT6757
	select MFD_SYSCON
	select MTK_BASE_POWER
	select MTK_POWER_GS
	select MTK_SYSTRACKER_V2
	select MTK_GIC_V3_EXT
	select ARM_GIC_V3
	select MTK_LM_MODE
	select MTK_EIC_HISTORY_DUMP
	select ARM_HAS_SG_CHAIN
	select POWER_SUPPLY
	select COMMON_CLK if !MTK_CLKMGR
	select MTK_IRQ_NEW_DESIGN
	select MTK_IRQ_NEW_DESIGN_DEBUG
	select MTK_L2C_PARITY_CHECK
	select MTK_LASTPC_V2
	select MTK_USB2JTAG_SUPPORT
	select ARM_ERRATA_855873
	select MTK_SEC_DEINT_SUPPORT
	select MTK_BOUNCING_CHECK
	select ARM_CRYPTO
	select CRYPTO_SHA2_ARM_CE
	select CRYPTO_AES_ARM_CE
	help
	  This enables support for MediaTek Helio P20 - MT6757
	  Highly power-efficient, performance-oriented 4G LTE processor for premium,
	  thin-design smartphones. The MediaTek Helio P20 is built on a 16nm process
	  node and offers 25% better power efficiency, higher processing performance
	  and our most advanced camera/video features to date. Helio P20 also offers
	  significant multitasking and multimedia improvements thanks to its new
	  LPDDR4X memory support.

config MACH_MT6763
	bool "MediaTek MT6763"
	select GENERIC_TIME
	select GENERIC_CLOCKEVENTS
	select ARCH_HAS_CPUFREQ
	select ARM_AMBA
	select CPU_V7
	select HAVE_SMP
	select IRQ_DOMAIN
	select IRQ_DOMAIN_DEBUG
	select GENERIC_SCHED_CLOCK
	select MTK_SYS_CIRQ
	select ARMV7_COMPAT
	select ARMV7_COMPAT_CPUINFO
	select CPU_IDLE
	select KERNEL_MODE_NEON
	select PINCTRL
	select PINCTRL_MT6763
	select MFD_SYSCON
	select MTK_BASE_POWER
	select MTK_GIC_V3_EXT
	select ARM_GIC_V3
	select MTK_LM_MODE if !MTK_GMO_RAM_OPTIMIZE
	select MTK_EIC_HISTORY_DUMP
	select MTK_EIC
	select MTK_BOUNCING_CHECK
	select MTK_SYSTRACKER_V2
	select MTK_IRQ_NEW_DESIGN
	select MTK_IRQ_NEW_DESIGN_DEBUG
	select ARM_CRYPTO
	select CRYPTO_SHA2_ARM_CE
	select CRYPTO_AES_ARM_CE
	help
	  This enables support for MediaTek MT6763
	  Support for arm Architecture
	  Support for k63v1 related projects

config MACH_MT6739
	bool "MediaTek MT6739"
	select GENERIC_TIME
	select GENERIC_CLOCKEVENTS
	select ARCH_HAS_CPUFREQ
	select ARM_AMBA
	select CPU_V7
	select HAVE_SMP
	select IRQ_DOMAIN
	select IRQ_DOMAIN_DEBUG
	select GENERIC_SCHED_CLOCK
	select MTK_SYS_CIRQ
	select ARMV7_COMPAT
	select ARMV7_COMPAT_CPUINFO
	select CPU_IDLE
	select KERNEL_MODE_NEON
	select PINCTRL
	select PINCTRL_MT6739
	select MFD_SYSCON
	select MTK_BASE_POWER
	select MTK_GIC_V3_EXT
	select ARM_GIC_V3
	select MTK_LM_MODE if !MTK_GMO_RAM_OPTIMIZE
	select MTK_BOUNCING_CHECK
	select MTK_SYSTRACKER_V2
	select MTK_IRQ_NEW_DESIGN
	select MTK_IRQ_NEW_DESIGN_DEBUG
	select MTK_SYSIRQ
	select MTK_CQDMA
	select FAST_CIRQ_CLONE_FLUSH
	select ARM_CRYPTO
	select CRYPTO_SHA2_ARM_CE
	select CRYPTO_AES_ARM_CE
	help
	  This enables support for MediaTek MT6739
	  Support for arm Architecture
	  Support for 4 core archtecture
	  Support for k39v1 related projects

config MACH_MT6771
	bool "MediaTek MT6771"
	select GENERIC_TIME
	select GENERIC_CLOCKEVENTS
	select ARCH_HAS_CPUFREQ
	select ARM_AMBA
	select CPU_V7
	select HAVE_SMP
	select IRQ_DOMAIN
	select IRQ_DOMAIN_DEBUG
	select GENERIC_SCHED_CLOCK
	select ARMV7_COMPAT
	select ARMV7_COMPAT_CPUINFO
	select PINCTRL
	select PINCTRL_MT6771
	select MFD_SYSCON
	select CPU_IDLE
	select KERNEL_MODE_NEON
	select MTK_BASE_POWER
	select MTK_GIC_V3_EXT
	select ARM_GIC_V3
	select MTK_LM_MODE if !MTK_GMO_RAM_OPTIMIZE
	select MTK_SYSIRQ
	select MTK_EINT_MULTI_TRIGGER_DESIGN
	select MTK_ES_REG
	select MTK_CQDMA
	select MTK_IRQ_NEW_DESIGN
	select MTK_SYS_CIRQ
	select FAST_CIRQ_CLONE_FLUSH
	select MTK_SYSTRACKER_V2
	select ARM_CRYPTO
	select CRYPTO_SHA2_ARM_CE
	select CRYPTO_AES_ARM_CE
	select MTK_BOUNCING_CHECK
	select MTK_CACHE_FLUSH_BY_SF
	help
	  This enables support for MediaTek MT6771
	  Support for aarch64 Architecture
	  Support for k71v1_bsp related projects
	  Support for mt6771 related projects

config MACH_MT8167
	bool "MediaTek MT8167"
	select GENERIC_TIME
	select GENERIC_CLOCKEVENTS
	select ARCH_HAS_CPUFREQ
	select ARM_AMBA
	select CPU_V7
	select HAVE_SMP
	select IRQ_DOMAIN
	select IRQ_DOMAIN_DEBUG
	select GENERIC_SCHED_CLOCK
	select MTK_SYS_CIRQ
	select ARMV7_COMPAT
	select ARMV7_COMPAT_CPUINFO
	select CPU_IDLE
	select PINCTRL
	select PINCTRL_MT8167
	select MFD_SYSCON
	select MTK_BASE_POWER
	select MTK_GIC_EXT
	select ARM_GIC_V3
	select SMP
	select POWER_SUPPLY
	select POWER_RESET
	select HAVE_ARM_ARCH_TIMER
	select ARM_PSCI
	select HAVE_MTK_IN_HOUSE_TEE_SUPPORT
	select MTK_ICE_DEBUG
	select VFP
	select AEABI
	select NEON
	select KERNEL_MODE_NEON
	select HAVE_FUTEX_CMPXCHG
	select HIGHMEM
	select ARM_CRYPTO
	select CRYPTO_SHA2_ARM_CE
	select CRYPTO_AES_ARM_CE
	help
	  This enables support for MediaTek MT8167
	  Support for arm Architecture
```

## arch/arm64/Kconfig.platforms
```kconfig
menu "Platform selection"

config ARCH_BCM_IPROC
	bool "Broadcom iProc SoC Family"
	help
	  This enables support for Broadcom iProc based SoCs

config ARCH_BERLIN
	bool "Marvell Berlin SoC Family"
	select ARCH_REQUIRE_GPIOLIB
	select DW_APB_ICTL
	help
	  This enables support for Marvell Berlin SoC Family

config ARCH_EXYNOS
	bool
	help
	  This enables support for Samsung Exynos SoC family

config ARCH_EXYNOS7
	bool "ARMv8 based Samsung Exynos7"
	select ARCH_EXYNOS
	select COMMON_CLK_SAMSUNG
	select HAVE_S3C2410_WATCHDOG if WATCHDOG
	select HAVE_S3C_RTC if RTC_CLASS
	select PINCTRL
	select PINCTRL_EXYNOS

	help
	  This enables support for Samsung Exynos7 SoC family

config ARCH_LAYERSCAPE
	bool "ARMv8 based Freescale Layerscape SoC family"
	help
	  This enables support for the Freescale Layerscape SoC family.

config ARCH_HISI
	bool "Hisilicon SoC Family"
	help
	  This enables support for Hisilicon ARMv8 SoC family

config ARCH_MEDIATEK
	bool "Mediatek MT65xx & MT81xx ARMv8 SoC"
	select ARM_GIC
	select PINCTRL
	help
	  Support for Mediatek MT65xx & MT81xx ARMv8 SoCs

config MACH_MT6757
	bool "MediaTek MT6757"
	select GENERIC_TIME
	select GENERIC_CLOCKEVENTS
	select ARCH_HAS_CPUFREQ
	select ARM_AMBA
	select CPU_V7
	select HAVE_SMP
	select NEED_MACH_MEMORY_H
	select IRQ_DOMAIN
	select IRQ_DOMAIN_DEBUG
	select GENERIC_SCHED_CLOCK
	select MTK_SYS_CIRQ
	select ARMV7_COMPAT
	select ARMV7_COMPAT_CPUINFO
	select CPU_IDLE
	select PINCTRL
	select PINCTRL_MT6757
	select MFD_SYSCON
	select MTK_BASE_POWER
	select MTK_SYSTRACKER_V2
	select MTK_GIC_V3_EXT
	select MTK_CPU_STRESS
	select MTK_LM_MODE if !MTK_GMO_RAM_OPTIMIZE
	select MTK_EIC_HISTORY_DUMP
	select MTK_EIC
	select MTK_L2C_PARITY_CHECK
	select MTK_LASTPC_V2
	select MTK_USB2JTAG_SUPPORT
	select MTK_IRQ_NEW_DESIGN
	select MTK_IRQ_NEW_DESIGN_DEBUG
	select MTK_WATCHPOINT
	select MTK_SEC_DEINT_SUPPORT
	select MTK_BOUNCING_CHECK
	help
	  This enables support for MediaTek Helio P20 - MT6757
	  Highly power-efficient, performance-oriented 4G LTE processor for premium,
	  thin-design smartphones. The MediaTek Helio P20 is built on a 16nm process
	  node and offers 25% better power efficiency, higher processing performance
	  and our most advanced camera/video features to date. Helio P20 also offers
	  significant multitasking and multimedia improvements thanks to its new
	  LPDDR4X memory support.

config MACH_MT6758
	bool "MediaTek MT6758"
	select GENERIC_TIME
	select GENERIC_CLOCKEVENTS
	select ARCH_HAS_CPUFREQ
	select ARM_AMBA
	select CPU_V7
	select HAVE_SMP
	select NEED_MACH_MEMORY_H
	select IRQ_DOMAIN
	select IRQ_DOMAIN_DEBUG
	select GENERIC_SCHED_CLOCK
	select MTK_SYS_CIRQ
	select ARMV7_COMPAT
	select ARMV7_COMPAT_CPUINFO
	select CPU_IDLE
	select PINCTRL
	select PINCTRL_MT6758
	select MFD_SYSCON
	select MTK_BASE_POWER
	select MTK_GIC_V3_EXT
	select MTK_LM_MODE if !MTK_GMO_RAM_OPTIMIZE
	select MTK_BOUNCING_CHECK
	select MTK_PLAT_SRAM_FLAG
	select MTK_WATCHPOINT
	select MTK_IRQ_NEW_DESIGN
	select MTK_IRQ_NEW_DESIGN_DEBUG
	select MTK_EIC_HISTORY_DUMP
	select MTK_EIC
	select MTK_SYSTRACKER_V2
	help
	  This enables support for MediaTek MT6758
	  Support for aarch64 Architecture
	  Support for fpga6758_64_emmc related projects
	  Support for fpga6758_64_ufs related projects

config MACH_MT6759
	bool "MediaTek MT6759"
	select MTK_BASE_POWER
	select PINCTRL
	select PINCTRL_MT6759
	select MFD_SYSCON
	select GENERIC_TIME
	select GENERIC_CLOCKEVENTS
	select ARCH_HAS_CPUFREQ
	select ARM_AMBA
	select CPU_V7
	select HAVE_SMP
	select NEED_MACH_MEMORY_H
	select IRQ_DOMAIN
	select IRQ_DOMAIN_DEBUG
	select GENERIC_SCHED_CLOCK
	select MTK_SYS_CIRQ
	select ARMV7_COMPAT
	select ARMV7_COMPAT_CPUINFO
	select CPU_IDLE
	select MTK_GIC_V3_EXT
	select MTK_LM_MODE if !MTK_GMO_RAM_OPTIMIZE
	select MTK_EIC_HISTORY_DUMP
	select MTK_EIC
	select MTK_IRQ_NEW_DESIGN
	select MTK_IRQ_NEW_DESIGN_DEBUG
	select MTK_WATCHPOINT
	select MTK_BOUNCING_CHECK
	select MTK_USB2JTAG_SUPPORT
	select MTK_CPU_STRESS
	select MTK_SYSTRACKER_V2
	help
	  This enables support for MediaTek MT6759
	  Highly power-efficient, performance-oriented 4G LTE processor for premium,
	  thin-design smartphones. MT6759 also offers significant multitasking and
	  multimedia improvements.

config MACH_KIBOPLUS
	bool "MediaTek KIBOPLUS"
	select GENERIC_TIME
	select GENERIC_CLOCKEVENTS
	select ARCH_HAS_CPUFREQ
	select ARM_AMBA
	select CPU_V7
	select HAVE_SMP
	select NEED_MACH_MEMORY_H
	select IRQ_DOMAIN
	select IRQ_DOMAIN_DEBUG
	select GENERIC_SCHED_CLOCK
	select MTK_SYS_CIRQ
	select ARMV7_COMPAT
	select ARMV7_COMPAT_CPUINFO
	select CPU_IDLE
	select PINCTRL
	select PINCTRL_MT6757
	select MFD_SYSCON
	select MTK_BASE_POWER
	select MTK_SYSTRACKER_V2
	select MTK_GIC_V3_EXT
	select MTK_CPU_STRESS
	select MTK_LM_MODE if !MTK_GMO_RAM_OPTIMIZE
	select MTK_EIC_HISTORY_DUMP
	select MTK_TIMER
	select MTK_EIC
	select MTK_LASTPC_V2
	select MTK_IRQ_NEW_DESIGN
	select MTK_IRQ_NEW_DESIGN_DEBUG
	select MTK_WATCHPOINT
	select MTK_BOUNCING_CHECK
	help
	  This enables support for KIBOPLUS
	  Support for aarch64 Architecture
	  Support for evb_kp_64 related projects
	  Support for phone_kp_64 related projects

config MACH_MT6763
	bool "MediaTek MT6763"
	select GENERIC_TIME
	select GENERIC_CLOCKEVENTS
	select ARCH_HAS_CPUFREQ
	select ARM_AMBA
	select CPU_V7
	select HAVE_SMP
	select NEED_MACH_MEMORY_H
	select IRQ_DOMAIN
	select IRQ_DOMAIN_DEBUG
	select GENERIC_SCHED_CLOCK
	select MTK_SYS_CIRQ
	select ARMV7_COMPAT
	select ARMV7_COMPAT_CPUINFO
	select CPU_IDLE
	select PINCTRL
	select PINCTRL_MT6763
	select MFD_SYSCON
	select MTK_BASE_POWER
	select MTK_GIC_V3_EXT
	select MTK_LM_MODE if !MTK_GMO_RAM_OPTIMIZE
	select MTK_EIC_HISTORY_DUMP
	select MTK_EIC
	select MTK_BOUNCING_CHECK
	select MTK_SYSTRACKER_V2
	select MTK_PLAT_SRAM_FLAG
	select MTK_WATCHPOINT
	select MTK_IRQ_NEW_DESIGN
	select MTK_IRQ_NEW_DESIGN_DEBUG
	help
	  This enables support for MediaTek MT6763
	  Support for aarch64 Architecture
	  Support for fpga6763_64_emmc related projects
	  Support for fpga6763_64_ufs related projects

config MACH_MT6799
	bool "MediaTek MT6799"
	select GENERIC_TIME
	select GENERIC_CLOCKEVENTS
	select ARCH_HAS_CPUFREQ
	select ARM_AMBA
	select CPU_V7
	select HAVE_SMP
	select NEED_MACH_MEMORY_H
	select IRQ_DOMAIN
	select IRQ_DOMAIN_DEBUG
	select GENERIC_SCHED_CLOCK
	select MTK_SYS_CIRQ
	select ARMV7_COMPAT
	select ARMV7_COMPAT_CPUINFO
	select CPU_IDLE
	select PINCTRL
	select PINCTRL_MT6799
	select MFD_SYSCON
	select MTK_BASE_POWER
	select MTK_SYSTRACKER_V2
	select MTK_GIC_V3_EXT
	select MTK_CPU_STRESS
	select MTK_USB2JTAG_SUPPORT if MU3_PHY
	select MTK_LM_MODE if !MTK_GMO_RAM_OPTIMIZE
	select MTK_EIC_HISTORY_DUMP
	select MTK_EIC
	select MTK_BOUNCING_CHECK
	select ARM64_ERRATUM_845719
	select MTK_WATCHPOINT
	select MTK_SEC_DEINT_SUPPORT
	select MTK_IRQ_NEW_DESIGN
	help
	  This enables support for MediaTek MT6799
	  Support for aarch64 Architecture
	  Support for fpga6799_64 related projects
	  Support for evb6799_64 related projects

config MACH_MT8167
	bool "MediaTek MT8167"
	select GENERIC_TIME
	select GENERIC_CLOCKEVENTS
	select ARCH_HAS_CPUFREQ
	select ARM_AMBA
	select CPU_V7
	select HAVE_SMP
	select NEED_MACH_MEMORY_H
	select IRQ_DOMAIN
	select IRQ_DOMAIN_DEBUG
	select GENERIC_SCHED_CLOCK
	select ARMV7_COMPAT
	select ARMV7_COMPAT_CPUINFO
	select CPU_IDLE
	select PINCTRL
	select PINCTRL_MT8167
	select MFD_SYSCON
	select MTK_BASE_POWER
	select MTK_TIMER
	select MTK_GIC_EXT
	select MTK_SYS_CIRQ
	select HAVE_MTK_IN_HOUSE_TEE_SUPPORT
	select MTK_ICE_DEBUG
	help
	  This enables support for MediaTek MT8167

config ARCH_QCOM
	bool "Qualcomm Platforms"
	select PINCTRL
	help
	  This enables support for the ARMv8 based Qualcomm chipsets.

config ARCH_ROCKCHIP
	bool "Rockchip Platforms"
	select ARCH_HAS_RESET_CONTROLLER
	select ARCH_REQUIRE_GPIOLIB
	select PINCTRL
	select PINCTRL_ROCKCHIP
	help
	  This enables support for the ARMv8 based Rockchip chipsets,
	  like the RK3368.

config ARCH_SEATTLE
	bool "AMD Seattle SoC Family"
	help
	  This enables support for AMD Seattle SOC Family

config ARCH_STRATIX10
	bool "Altera's Stratix 10 SoCFPGA Family"
	help
	  This enables support for Altera's Stratix 10 SoCFPGA Family.

config ARCH_TEGRA
	bool "NVIDIA Tegra SoC Family"
	select ARCH_HAS_RESET_CONTROLLER
	select ARCH_REQUIRE_GPIOLIB
	select CLKDEV_LOOKUP
	select CLKSRC_MMIO
	select CLKSRC_OF
	select GENERIC_CLOCKEVENTS
	select HAVE_CLK
	select PINCTRL
	select RESET_CONTROLLER
	help
	  This enables support for the NVIDIA Tegra SoC family.

config ARCH_TEGRA_132_SOC
	bool "NVIDIA Tegra132 SoC"
	depends on ARCH_TEGRA
	select PINCTRL_TEGRA124
	select USB_ULPI if USB_PHY
	select USB_ULPI_VIEWPORT if USB_PHY
	help
	  Enable support for NVIDIA Tegra132 SoC, based on the Denver
	  ARMv8 CPU.  The Tegra132 SoC is similar to the Tegra124 SoC,
	  but contains an NVIDIA Denver CPU complex in place of
	  Tegra124's "4+1" Cortex-A15 CPU complex.

config ARCH_SPRD
	bool "Spreadtrum SoC platform"
	help
	  Support for Spreadtrum ARM based SoCs

config ARCH_THUNDER
	bool "Cavium Inc. Thunder SoC Family"
	help
	  This enables support for Cavium's Thunder Family of SoCs.

config ARCH_VEXPRESS
	bool "ARMv8 software model (Versatile Express)"
	select ARCH_REQUIRE_GPIOLIB
	select COMMON_CLK_VERSATILE
	select POWER_RESET_VEXPRESS
	select VEXPRESS_CONFIG
	help
	  This enables support for the ARMv8 software model (Versatile
	  Express).

config ARCH_XGENE
	bool "AppliedMicro X-Gene SOC Family"
	help
	  This enables support for AppliedMicro X-Gene SOC Family

config ARCH_ZYNQMP
	bool "Xilinx ZynqMP Family"
	help
	  This enables support for Xilinx ZynqMP Family

endmenu
```
