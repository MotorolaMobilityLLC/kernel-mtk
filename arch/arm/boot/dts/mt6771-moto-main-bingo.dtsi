/*
 * MT6771 Bingo main dts override
 * Things can done here:
 * 	Add nodes or properties to root node
 * 	Delete nodes or properties
*/
&lk_charger {
	/delete-property/ enable_pe_plus;
};
&charger {
	/delete-property/ enable_pe_plus;
	/delete-property/ enable_pe_2;
	/delete-property/ enable_pe_3;
	/delete-property/ enable_pe_4;
	/delete-property/ enable_type_c;
};
