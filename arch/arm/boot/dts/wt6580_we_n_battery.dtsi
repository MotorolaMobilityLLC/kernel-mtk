&bat_meter{
	/* cust_battery_meter.h */
	/* ADC resistor  */
	r_bat_sense = <4 >;
	r_i_sense = <4 >;
	r_charger_1 = <330 >;
	r_charger_2 = <39 >;
	temperature_t0 = <110 >;
	temperature_t1 = <0 >;
	temperature_t2 = <25 >;
	temperature_t3 = <50 >;
	temperature_t = <255 >;	/* this should be fixed, never change the value */
	fg_meter_resistance = <0 >;

	/* Qmax for 0mA */
	q_max_pos_50 = <2250 >;
	q_max_pos_25 = <2288 >;
	q_max_pos_0 = <2274 >;
	q_max_neg_10 = <2289 >;
	/* Qmax for 400mA, said high current */
	q_max_pos_50_h_current = <2221 >;
	q_max_pos_25_h_current = <2256 >;
	q_max_pos_0_h_current = <1570 >;
	q_max_neg_10_h_current = <588 >;
	/* Discharge percentage, 1: D5, 0: D2 */
	oam_d5 = <1 >;

	change_tracking_point = <1 >;
	/* SW OCV tracking setting */
	cust_tracking_point = <0 >;
	cust_r_sense = <200 >;
	cust_hw_cc = <0 >;
	aging_tuning_value = <103 >;
	cust_r_fg_offset = <0 >;
	ocv_board_compesate = <0 >;
	r_fg_board_base = <1000 >;
	r_fg_board_slope = <1000 >;
	car_tune_value = <98 >;

	/* HW Fuel gague  */
	current_detect_r_fg = <10 >;	/* Unit: mA */
	minerroroffset = <1000 >;
	fg_vbat_average_size = <18 >;
	r_fg_value = <10 >;	/* Unit: mOhm */

	cust_poweron_delta_capacity_tolrance = <30 >;
	cust_poweron_low_capacity_tolrance = <5 >;
	cust_poweron_max_vbat_tolrance = <90 >;
	cust_poweron_delta_vbat_tolrance = <30 >;
	cust_poweron_delta_hw_sw_ocv_capacity_tolrance = <10 >;

	/* Fixed battery temperature */
	fixed_tbat_25 = <0 >;
	/* Dynamic change wake up period of battery thread when suspend */
	vbat_normal_wakeup = <3600 >;	/* Unit: mV */
	vbat_low_power_wakeup = <3500 >;	/* Unit: mV */
	normal_wakeup_period = <5400 >;	/* Unit: second */
	low_power_wakeup_period = <300 >;	/* Unit: second */
	close_poweroff_wakeup_period = <30 >;	/* Unit: second */

	rbat_pull_up_r = <16900 >;
	rbat_pull_up_volt = <1800 >;


	batt_temperature_table_num = <17 >;
	batt_temperature_table = <
	    (-20) 68237
	    (-15) 53650
	    (-10) 42506
	    (-5) 33892
	    0 27219
	    5 22021
	    10 17926
	    15 14674
	    20 12081
	    25 10000 30 8315 35 6948 40 5834 45 4917 50 4161 55 3535 60 3014 >;
	battery_profile_t0_num = <78 >;
	battery_profile_t0 = <
			0	4332
			1	4286
			3	4266
			4	4249
			5	4234
			7	4220
			8	4204
			9	4190
			10	4176
			12	4162
			13	4148
			14	4132
			16	4118
			17	4104
			18	4092
			20	4082
			21	4072
			22	4059
			24	4034
			25	4003
			26	3977
			28	3957
			29	3947
			30	3936
			31	3927
			33	3918
			34	3909
			35	3903
			37	3897
			38	3886
			39	3878
			41	3870
			42	3860
			43	3852
			45	3845
			46	3838
			47	3830
			48	3824
			50	3819
			51	3813
			52	3805
			54	3800
			55	3796
			56	3790
			58	3784
			59	3780
			60	3776
			62	3773
			63	3769
			64	3766
			66	3762
			67	3759
			68	3757
			69	3754
			71	3749
			72	3746
			73	3742
			75	3735
			76	3731
			77	3726
			79	3721
			80	3716
			81	3710
			83	3703
			84	3698
			85	3692
			87	3688
			88	3685
			89	3680
			90	3677
			92	3672
			93	3661
			94	3638
			96	3611
			97	3565
			98	3461
			100	3400
			100	3400 >;
	battery_profile_t1_num = <78 >;
	battery_profile_t1 = <
			0	4334
			1	4306
			3	4287
			4	4271
			5	4258
			7	4243
			8	4227
			9	4214
			11	4199
			12	4186
			13	4173
			15	4157
			16	4144
			17	4130
			18	4116
			20	4102
			21	4091
			22	4083
			24	4073
			25	4062
			26	4040
			28	4010
			29	3988
			30	3971
			32	3959
			33	3948
			34	3936
			36	3927
			37	3918
			38	3908
			40	3900
			41	3890
			42	3878
			44	3868
			45	3860
			46	3852
			47	3845
			49	3838
			50	3830
			51	3825
			53	3817
			54	3812
			55	3806
			57	3801
			58	3795
			59	3790
			61	3786
			62	3782
			63	3777
			65	3774
			66	3768
			67	3767
			69	3765
			70	3762
			71	3758
			73	3756
			74	3753
			75	3746
			77	3743
			78	3737
			79	3733
			80	3728
			82	3721
			83	3713
			84	3706
			86	3699
			87	3689
			88	3681
			90	3676
			91	3675
			92	3674
			94	3671
			95	3663
			96	3649
			98	3517
			99	3458
			100	3400
			100	3400>;
	battery_profile_t2_num = <78 >;
	battery_profile_t2 = <
			0	4332
			1	4306
			3	4286
			4	4268
			5	4253
			7	4238
			8	4221
			9	4206
			10	4192
			12	4178
			13	4164
			14	4148
			16	4134
			17	4120
			18	4106
			20	4093
			21	4081
			22	4073
			24	4065
			25	4052
			26	4027
			28	4003
			29	3989
			30	3977
			31	3969
			33	3963
			34	3958
			35	3952
			37	3942
			38	3930
			39	3920
			41	3909
			42	3894
			43	3880
			45	3867
			46	3856
			47	3847
			49	3838
			50	3830
			51	3824
			52	3817
			54	3811
			55	3806
			56	3800
			58	3794
			59	3790
			60	3786
			62	3782
			63	3777
			64	3774
			66	3768
			67	3765
			68	3763
			69	3760
			71	3755
			72	3753
			73	3750
			75	3743
			76	3740
			77	3733
			79	3728
			80	3723
			81	3719
			83	3710
			84	3702
			85	3695
			87	3688
			88	3677
			89	3669
			90	3666
			92	3669
			93	3667
			94	3645
			96	3623
			97	3537
			98	3481
			100	3400
			100	3400>;
	battery_profile_t3_num = <78 >;
	battery_profile_t3 = <
			0	4332
			1	4285
			3	4268
			4	4252
			5	4236
			7	4221
			8	4204
			9	4190
			11	4176
			12	4160
			13	4147
			15	4131
			16	4117
			17	4103
			19	4090
			20	4076
			21	4063
			23	4051
			24	4037
			25	4026
			27	4008
			28	3995
			29	3991
			31	3980
			32	3972
			33	3962
			35	3950
			36	3940
			37	3931
			39	3918
			40	3908
			41	3897
			43	3881
			44	3866
			45	3853
			47	3843
			48	3835
			49	3828
			51	3822
			52	3816
			53	3807
			55	3802
			56	3797
			57	3792
			59	3785
			60	3781
			61	3777
			63	3774
			64	3768
			65	3764
			67	3759
			68	3756
			69	3752
			71	3749
			72	3738
			73	3729
			75	3724
			76	3716
			77	3711
			79	3703
			80	3699
			81	3695
			83	3690
			84	3680
			85	3672
			87	3664
			88	3654
			89	3647
			91	3646
			92	3647
			93	3648
			95	3643
			96	3622
			97	3575
			99	3444
			100	3400
			100	3400
			100	3400>;
	r_profile_t0_num = <78 >;
	r_profile_t0 = <
			1146	4332
			1146	4287
			1145	4268
			1139	4251
			1131	4236
			1126	4222
			1111	4208
			1104	4194
			1095	4180
			1083	4166
			1075	4152
			1069	4138
			1059	4124
			1051	4110
			1048	4098
			1043	4088
			1043	4078
			1037	4065
			1025	4043
			1001	4012
			987	3986
			978	3966
			975	3953
			977	3942
			971	3931
			971	3922
			972	3915
			971	3909
			974	3903
			971	3895
			968	3887
			967	3879
			965	3872
			963	3864
			965	3857
			965	3850
			965	3842
			967	3836
			968	3831
			969	3825
			975	3819
			977	3814
			979	3810
			981	3804
			982	3800
			985	3796
			987	3792
			993	3789
			999	3787
			1002	3784
			1010	3782
			1016	3779
			1023	3777
			1031	3774
			1040	3771
			1048	3768
			1057	3764
			1066	3761
			1079	3757
			1090	3754
			1103	3749
			1118	3744
			1136	3738
			1151	3733
			1173	3728
			1196	3722
			1226	3718
			1258	3715
			1299	3710
			1345	3705
			1394	3698
			1455	3687
			1513	3664
			1585	3629
			1671	3581
			1684	3461
			1539	3400
			1358	3400>;

	r_profile_t1_num = <78 >;
	r_profile_t1 = <666	4334
			666	4307
			672	4289
			665	4273
			663	4260
			661	4245
			655	4231
			652	4218
			648	4203
			647	4190
			641	4177
			639	4163
			639	4150
			632	4136
			629	4122
			625	4108
			625	4097
			629	4089
			636	4082
			638	4071
			632	4049
			613	4019
			608	3994
			604	3977
			605	3963
			602	3952
			601	3942
			604	3933
			603	3924
			601	3917
			597	3909
			594	3899
			592	3890
			589	3880
			588	3872
			591	3864
			590	3857
			591	3850
			591	3842
			595	3837
			596	3831
			600	3826
			601	3820
			605	3815
			608	3811
			611	3806
			616	3802
			618	3798
			620	3795
			625	3792
			628	3788
			631	3787
			638	3785
			643	3782
			649	3780
			654	3778
			660	3775
			668	3772
			675	3769
			681	3765
			688	3761
			698	3756
			707	3749
			719	3743
			732	3736
			747	3729
			761	3719
			778	3711
			803	3706
			830	3703
			869	3700
			913	3697
			973	3689
			1026	3667
			1088	3533
			1197	3458
			1347	3400
			1347	3400 >;

	r_profile_t2_num = <78 >;
	r_profile_t2 = <177	4332
			177	4307
			178	4288
			179	4270
			177	4255
			176	4240
			179	4225
			178	4210
			180	4196
			182	4182
			183	4168
			185	4154
			186	4140
			185	4126
			185	4112
			187	4099
			188	4087
			196	4079
			207	4074
			206	4061
			196	4036
			192	4012
			195	3995
			196	3983
			195	3973
			202	3967
			205	3964
			207	3958
			203	3948
			202	3939
			203	3929
			199	3918
			192	3906
			187	3892
			181	3879
			175	3868
			171	3859
			170	3850
			171	3842
			172	3836
			172	3831
			171	3825
			173	3820
			172	3814
			176	3810
			176	3806
			176	3802
			178	3798
			180	3795
			181	3792
			181	3788
			181	3785
			182	3783
			183	3780
			184	3777
			185	3775
			183	3772
			182	3769
			183	3766
			181	3761
			181	3756
			182	3751
			184	3747
			183	3740
			183	3732
			185	3725
			186	3718
			186	3707
			186	3699
			190	3696
			193	3695
			200	3693
			211	3671
			221	3641
			214	3553
			229	3481
			259	3400
			371	3400>;

	r_profile_t3_num = <78 >;
	r_profile_t3 = <114	4332
			114	4286
			115	4270
			115	4254
			114	4238
			115	4223
			114	4208
			116	4194
			117	4180
			116	4164
			116	4151
			118	4137
			119	4123
			118	4109
			120	4096
			120	4082
			120	4069
			122	4057
			124	4046
			126	4035
			124	4017
			125	4004
			129	3997
			127	3986
			129	3976
			130	3966
			132	3956
			133	3946
			135	3937
			138	3927
			138	3917
			135	3906
			132	3893
			124	3878
			118	3865
			116	3855
			116	3847
			115	3840
			116	3834
			116	3828
			116	3821
			116	3816
			116	3811
			118	3806
			119	3801
			119	3797
			121	3793
			122	3790
			123	3786
			122	3782
			123	3779
			124	3776
			124	3772
			125	3769
			118	3760
			116	3751
			117	3746
			118	3742
			117	3737
			116	3731
			117	3727
			119	3723
			121	3718
			119	3710
			119	3702
			119	3694
			118	3684
			118	3677
			120	3676
			123	3675
			127	3674
			132	3669
			127	3648
			129	3593
			137	3460
			151	3400
			318	3400
			78	3400 >;
			};

         &bat_comm {
			/* cust_charging.h */
			/* stop charging while in talking mode */
			stop_charging_in_takling = <1 >;
			talking_recharge_voltage = <3800 >;
	talking_sync_time = <60 >;

	/* Battery Temperature Protection */
	mtk_temperature_recharge_support = <1 >;
	max_charge_temperature = <52 >;
	max_charge_temperature_minus_x_degree = <47 >;
	min_charge_temperature = <0 >;
	min_charge_temperature_plus_x_degree = <0 >;
	err_charge_temperature = <0xff >;

	/* Linear Charging Threshold */
	v_pre2cc_thres = <3400 >;	/* unit: mV */
	v_cc2topoff_thres = <4350 >;
	recharging_voltage = <4250 >;
	charging_full_current = <150 >;	/* unit: mA */

	/* Charging Current Setting */
	config_usb_if = <0 >;
	usb_charger_current_suspend = <0 >;	/* Unit: 0.01 mA */
	usb_charger_current_unconfigured = <7000 >;	/* Unit: 0.01 mA */
	usb_charger_current_configured = <50000 >;	/* Unit: 0.01 mA */
	usb_charger_current = <50000 >;	/* Unit: 0.01 mA */
	ac_charger_current = <95000 >;	/* Unit: 0.01 mA */
	non_std_ac_charger_current = <50000 >;	/* Unit: 0.01 mA */
	charging_host_charger_current = <65000 >;	/* Unit: 0.01 mA */
	apple_0_5a_charger_current = <50000 >;	/* Unit: 0.01 mA */
	apple_1_0a_charger_current = <65000 >;	/* Unit: 0.01 mA */
	apple_2_1a_charger_current = <80000 >;	/* Unit: 0.01 mA */

	/* charger error check */
	bat_low_temp_protect_enable = <1 >;
	v_charger_enable = <0 >;	/* 1:on , 0:off */
	v_charger_max = <6500 >;	/* unit: mV */
	v_charger_min = <4400 >;

	/*  Tracking TIME */
	onehundred_percent_tracking_time = <10 >;	/* Unit: second */
	npercent_tracking_time = <20 >;	/* Unit: second */
	sync_to_real_tracking_time = <60 >;	/* Unit: second */
	v_0percent_tracking = <3450 >;	/* Unit: mV */

	/* High battery support */
	high_battery_voltage_support = <1 >;
};

