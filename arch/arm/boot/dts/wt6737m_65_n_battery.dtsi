&bat_meter{
	/* cust_battery_meter.h */
	/* ADC resistor  */
	r_bat_sense = <4 >;
	r_i_sense = <4 >;
	r_charger_1 = <330 >;
	r_charger_2 = <39 >;
	temperature_t0 = <110 >;
	temperature_t1 = <0 >;
	temperature_t2 = <25 >;
	temperature_t3 = <50 >;
	temperature_t = <255 >;	/* this should be fixed, never change the value */
	fg_meter_resistance = <0 >;

	/* Qmax for 0mA */
	q_max_pos_50 = <2250 >;
	q_max_pos_25 = <2288 >;
	q_max_pos_0 = <2274 >;
	q_max_neg_10 = <2289 >;
	/* Qmax for 400mA, said high current */
	q_max_pos_50_h_current = <2221 >;
	q_max_pos_25_h_current = <2256 >;
	q_max_pos_0_h_current = <1570 >;
	q_max_neg_10_h_current = <588 >;
	/* Discharge percentage, 1: D5, 0: D2 */
	oam_d5 = <1 >;

	change_tracking_point = <1 >;
	/* SW OCV tracking setting */
	cust_tracking_point = <1 >;
	cust_r_sense = <56 >;
	cust_hw_cc = <0 >;
	aging_tuning_value = <103 >;
	cust_r_fg_offset = <0 >;
	ocv_board_compesate = <0 >;
	r_fg_board_base = <1000 >;
	r_fg_board_slope = <1000 >;
	car_tune_value = <98 >;

	/* HW Fuel gague  */
	current_detect_r_fg = <10 >;	/* Unit: mA */
	minerroroffset = <1000 >;
	fg_vbat_average_size = <18 >;
	r_fg_value = <10 >;	/* Unit: mOhm */

	cust_poweron_delta_capacity_tolrance = <30 >;
	cust_poweron_low_capacity_tolrance = <5 >;
	cust_poweron_max_vbat_tolrance = <90 >;
	cust_poweron_delta_vbat_tolrance = <30 >;
	cust_poweron_delta_hw_sw_ocv_capacity_tolrance = <10 >;

	/* Fixed battery temperature */
	fixed_tbat_25 = <0 >;
	/* Dynamic change wake up period of battery thread when suspend */
	vbat_normal_wakeup = <3600 >;	/* Unit: mV */
	vbat_low_power_wakeup = <3500 >;	/* Unit: mV */
	normal_wakeup_period = <5400 >;	/* Unit: second */
	low_power_wakeup_period = <300 >;	/* Unit: second */
	close_poweroff_wakeup_period = <30 >;	/* Unit: second */

	rbat_pull_up_r = <16900 >;
	rbat_pull_up_volt = <1800 >;


	batt_temperature_table_num = <17 >;
	batt_temperature_table = <
	    (-20) 68237
	    (-15) 53650
	    (-10) 42506
	    (-5) 33892
	    0 27219
	    5 22021
	    10 17926
	    15 14674
	    20 12081
	    25 10000 30 8315 35 6948 40 5834 45 4917 50 4161 55 3535 60 3014 >;
	battery_profile_t0_num = <78 >;
	battery_profile_t0 = <0	4332
                        1	4287
			3	4268
			4	4251
			5	4236
			7	4222
			8	4208
			9	4194
			10	4180
			12	4166
			13	4152
			14	4138
			16	4124
			17	4110
			18	4098
			20	4088
			21	4078
			22	4065
			24	4043
			25	4012
			26	3986
			28	3966
			29	3953
			30	3942
			31	3931
			33	3922
			34	3915
			35	3909
			37	3903
			38	3895
			39	3887
			41	3879
			42	3872
			43	3864
			45	3857
			46	3850
			47	3842
			48	3836
			50	3831
			51	3825
			52	3819
			54	3814
			55	3810
			56	3804
			58	3800
			59	3796
			60	3792
			62	3789
			63	3787
			64	3784
			66	3782
			67	3779
			68	3777
			69	3774
			71	3771
			72	3768
			73	3764
			75	3761
			76	3757
			77	3754
			79	3749
			80	3744
			81	3738
			83	3733
			84	3728
			85	3722
			87	3718
			88	3715
			89	3710
			90	3705
			92	3698
			93	3687
			94	3664
			96	3629
			97	3581
			98	3461
			100	3400
			100	3400 >;
	battery_profile_t1_num = <78 >;
	battery_profile_t1 = <0	4334
			1	4307
			3	4289
			4	4273
			5	4260
			7	4245
			8	4231
			9	4218
			11	4203
			12	4190
			13	4177
			15	4163
			16	4150
			17	4136
			18	4122
			20	4108
			21	4097
			22	4089
			24	4082
			25	4071
			26	4049
			28	4019
			29	3994
			30	3977
			32	3963
			33	3952
			34	3942
			36	3933
			37	3924
			38	3917
			40	3909
			41	3899
			42	3890
			44	3880
			45	3872
			46	3864
			47	3857
			49	3850
			50	3842
			51	3837
			53	3831
			54	3826
			55	3820
			57	3815
			58	3811
			59	3806
			61	3802
			62	3798
			63	3795
			65	3792
			66	3788
			67	3787
			69	3785
			70	3782
			71	3780
			73	3778
			74	3775
			75	3772
			77	3769
			78	3765
			79	3761
			80	3756
			82	3749
			83	3743
			84	3736
			86	3729
			87	3719
			88	3711
			90	3706
			91	3703
			92	3700
			94	3697
			95	3689
			96	3667
			98	3533
			99	3458
			100	3400
			100	3400>;
	battery_profile_t2_num = <78 >;
	battery_profile_t2 = <0	4332
			1	4307
			3	4288
			4	4270
			5	4255
			7	4240
			8	4225
			9	4210
			10	4196
			12	4182
			13	4168
			14	4154
			16	4140
			17	4126
			18	4112
			20	4099
			21	4087
			22	4079
			24	4074
			25	4061
			26	4036
			28	4012
			29	3995
			30	3983
			31	3973
			33	3967
			34	3964
			35	3958
			37	3948
			38	3939
			39	3929
			41	3918
			42	3906
			43	3892
			45	3879
			46	3868
			47	3859
			49	3850
			50	3842
			51	3836
			52	3831
			54	3825
			55	3820
			56	3814
			58	3810
			59	3806
			60	3802
			62	3798
			63	3795
			64	3792
			66	3788
			67	3785
			68	3783
			69	3780
			71	3777
			72	3775
			73	3772
			75	3769
			76	3766
			77	3761
			79	3756
			80	3751
			81	3747
			83	3740
			84	3732
			85	3725
			87	3718
			88	3707
			89	3699
			90	3696
			92	3695
			93	3693
			94	3671
			96	3641
			97	3553
			98	3481
			100	3400
			100	3400>;
	battery_profile_t3_num = <78 >;
	battery_profile_t3 = <0	4332
			1	4286
			3	4270
			4	4254
			5	4238
			7	4223
			8	4208
			9	4194
			11	4180
			12	4164
			13	4151
			15	4137
			16	4123
			17	4109
			19	4096
			20	4082
			21	4069
			23	4057
			24	4046
			25	4035
			27	4017
			28	4004
			29	3997
			31	3986
			32	3976
			33	3966
			35	3956
			36	3946
			37	3937
			39	3927
			40	3917
			41	3906
			43	3893
			44	3878
			45	3865
			47	3855
			48	3847
			49	3840
			51	3834
			52	3828
			53	3821
			55	3816
			56	3811
			57	3806
			59	3801
			60	3797
			61	3793
			63	3790
			64	3786
			65	3782
			67	3779
			68	3776
			69	3772
			71	3769
			72	3760
			73	3751
			75	3746
			76	3742
			77	3737
			79	3731
			80	3727
			81	3723
			83	3718
			84	3710
			85	3702
			87	3694
			88	3684
			89	3677
			91	3676
			92	3675
			93	3674
			95	3669
			96	3648
			97	3593
			99	3460
			100	3400
			100	3400
			100	3400>;

	r_profile_t0_num = <78 >;
	r_profile_t0 = <1146	4332
			1146	4287
			1145	4268
			1139	4251
			1131	4236
			1126	4222
			1111	4208
			1104	4194
			1095	4180
			1083	4166
			1075	4152
			1069	4138
			1059	4124
			1051	4110
			1048	4098
			1043	4088
			1043	4078
			1037	4065
			1025	4043
			1001	4012
			987	3986
			978	3966
			975	3953
			977	3942
			971	3931
			971	3922
			972	3915
			971	3909
			974	3903
			971	3895
			968	3887
			967	3879
			965	3872
			963	3864
			965	3857
			965	3850
			965	3842
			967	3836
			968	3831
			969	3825
			975	3819
			977	3814
			979	3810
			981	3804
			982	3800
			985	3796
			987	3792
			993	3789
			999	3787
			1002	3784
			1010	3782
			1016	3779
			1023	3777
			1031	3774
			1040	3771
			1048	3768
			1057	3764
			1066	3761
			1079	3757
			1090	3754
			1103	3749
			1118	3744
			1136	3738
			1151	3733
			1173	3728
			1196	3722
			1226	3718
			1258	3715
			1299	3710
			1345	3705
			1394	3698
			1455	3687
			1513	3664
			1585	3629
			1671	3581
			1684	3461
			1539	3400
			1358	3400>;

	r_profile_t1_num = <78 >;
	r_profile_t1 = <666	4334
			666	4307
			672	4289
			665	4273
			663	4260
			661	4245
			655	4231
			652	4218
			648	4203
			647	4190
			641	4177
			639	4163
			639	4150
			632	4136
			629	4122
			625	4108
			625	4097
			629	4089
			636	4082
			638	4071
			632	4049
			613	4019
			608	3994
			604	3977
			605	3963
			602	3952
			601	3942
			604	3933
			603	3924
			601	3917
			597	3909
			594	3899
			592	3890
			589	3880
			588	3872
			591	3864
			590	3857
			591	3850
			591	3842
			595	3837
			596	3831
			600	3826
			601	3820
			605	3815
			608	3811
			611	3806
			616	3802
			618	3798
			620	3795
			625	3792
			628	3788
			631	3787
			638	3785
			643	3782
			649	3780
			654	3778
			660	3775
			668	3772
			675	3769
			681	3765
			688	3761
			698	3756
			707	3749
			719	3743
			732	3736
			747	3729
			761	3719
			778	3711
			803	3706
			830	3703
			869	3700
			913	3697
			973	3689
			1026	3667
			1088	3533
			1197	3458
			1347	3400
			1347	3400 >;

	r_profile_t2_num = <78 >;
	r_profile_t2 = <177	4332
			177	4307
			178	4288
			179	4270
			177	4255
			176	4240
			179	4225
			178	4210
			180	4196
			182	4182
			183	4168
			185	4154
			186	4140
			185	4126
			185	4112
			187	4099
			188	4087
			196	4079
			207	4074
			206	4061
			196	4036
			192	4012
			195	3995
			196	3983
			195	3973
			202	3967
			205	3964
			207	3958
			203	3948
			202	3939
			203	3929
			199	3918
			192	3906
			187	3892
			181	3879
			175	3868
			171	3859
			170	3850
			171	3842
			172	3836
			172	3831
			171	3825
			173	3820
			172	3814
			176	3810
			176	3806
			176	3802
			178	3798
			180	3795
			181	3792
			181	3788
			181	3785
			182	3783
			183	3780
			184	3777
			185	3775
			183	3772
			182	3769
			183	3766
			181	3761
			181	3756
			182	3751
			184	3747
			183	3740
			183	3732
			185	3725
			186	3718
			186	3707
			186	3699
			190	3696
			193	3695
			200	3693
			211	3671
			221	3641
			214	3553
			229	3481
			259	3400
			371	3400>;

	r_profile_t3_num = <78 >;
	r_profile_t3 = <114	4332
			114	4286
			115	4270
			115	4254
			114	4238
			115	4223
			114	4208
			116	4194
			117	4180
			116	4164
			116	4151
			118	4137
			119	4123
			118	4109
			120	4096
			120	4082
			120	4069
			122	4057
			124	4046
			126	4035
			124	4017
			125	4004
			129	3997
			127	3986
			129	3976
			130	3966
			132	3956
			133	3946
			135	3937
			138	3927
			138	3917
			135	3906
			132	3893
			124	3878
			118	3865
			116	3855
			116	3847
			115	3840
			116	3834
			116	3828
			116	3821
			116	3816
			116	3811
			118	3806
			119	3801
			119	3797
			121	3793
			122	3790
			123	3786
			122	3782
			123	3779
			124	3776
			124	3772
			125	3769
			118	3760
			116	3751
			117	3746
			118	3742
			117	3737
			116	3731
			117	3727
			119	3723
			121	3718
			119	3710
			119	3702
			119	3694
			118	3684
			118	3677
			120	3676
			123	3675
			127	3674
			132	3669
			127	3648
			129	3593
			137	3460
			151	3400
			318	3400
			78	3400 >;
			};

         &bat_comm {
			/* cust_charging.h */
			/* stop charging while in talking mode */
			stop_charging_in_takling = <1 >;
			talking_recharge_voltage = <3800 >;
	talking_sync_time = <60 >;

	/* Battery Temperature Protection */
	mtk_temperature_recharge_support = <1 >;
	max_charge_temperature = <52 >;
	max_charge_temperature_minus_x_degree = <47 >;
	min_charge_temperature = <0 >;
	min_charge_temperature_plus_x_degree = <0 >;
	err_charge_temperature = <0xff >;

	/* Linear Charging Threshold */
	v_pre2cc_thres = <3400 >;	/* unit: mV */
	v_cc2topoff_thres = <4200 >;
	recharging_voltage = <4250 >;
	charging_full_current = <180 >;	/* unit: mA */

	/* Charging Current Setting */
	config_usb_if = <0 >;
	usb_charger_current_suspend = <0 >;	/* Unit: 0.01 mA */
	usb_charger_current_unconfigured = <7000 >;	/* Unit: 0.01 mA */
	usb_charger_current_configured = <50000 >;	/* Unit: 0.01 mA */
	usb_charger_current = <50000 >;	/* Unit: 0.01 mA */
	ac_charger_current = <100000 >;	/* Unit: 0.01 mA */
	non_std_ac_charger_current = <50000 >;	/* Unit: 0.01 mA */
	charging_host_charger_current = <65000 >;	/* Unit: 0.01 mA */
	apple_0_5a_charger_current = <50000 >;	/* Unit: 0.01 mA */
	apple_1_0a_charger_current = <65000 >;	/* Unit: 0.01 mA */
	apple_2_1a_charger_current = <80000 >;	/* Unit: 0.01 mA */

	/* charger error check */
	bat_low_temp_protect_enable = <1 >;
	v_charger_enable = <0 >;	/* 1:on , 0:off */
	v_charger_max = <6500 >;	/* unit: mV */
	v_charger_min = <4400 >;

	/*  Tracking TIME */
	onehundred_percent_tracking_time = <10 >;	/* Unit: second */
	npercent_tracking_time = <20 >;	/* Unit: second */
	sync_to_real_tracking_time = <60 >;	/* Unit: second */
	v_0percent_tracking = <3450 >;	/* Unit: mV */

	/* High battery support */
	high_battery_voltage_support = <1 >;
};
