&charger
{

	battery_cv = <4400000>;

	jeita_temp_above_t4_cv = <4200000>;
	jeita_temp_t3_to_t4_cv = <4200000>;
	jeita_temp_t2_to_t3_cv = <4400000>;
	jeita_temp_t1_to_t2_cv = <4400000>;
	jeita_temp_t0_to_t1_cv = <4400000>;
	jeita_temp_below_t0_cv = <4200000>;

	temp_t4_thres = <55>;
	temp_t4_thres_minus_x_degree = <52>;
	temp_t3_thres = <45>;
	temp_t3_thres_minus_x_degree = <39>;
	temp_t2_thres = <15>;
	temp_t2_thres_plus_x_degree = <18>;
	temp_t1_thres = <15>;
	temp_t1_thres_plus_x_degree = <18>;
	temp_t0_thres = <0>;
	temp_t0_thres_plus_x_degree = <2>;
	temp_neg_10_thres = <0>;

	/* battery temperature protection */
	enable_min_charge_temp;
	min_charge_temp= <0>;
	min_charge_temp_plus_x_degree = <2>;
	max_charge_temp = <55>;
	max_charge_temp_minus_x_degree = <52>;


       ac_charger_current = <2050000>;

};

&bat_gm30
{
	TEMPERATURE_T0 = <(50)>;	/*	Battery temperature T0*/
	TEMPERATURE_T1 = <(25)>;	/*	Battery temperature T1*/
	TEMPERATURE_T2 = <(0)>;	/*	Battery temperature T2*/
	TEMPERATURE_T3 = <(-10)>;	/*	Battery temperature T3*/
	g_FG_PSEUDO100_T0 = <(97)>;	/*	Pseudo 100% percentage at T0.*/
	g_FG_PSEUDO100_T1 = <(97)>;	/*	Pseudo 100% percentage at T1.*/
	g_FG_PSEUDO100_T2 = <(95)>;	/*	Pseudo 100% percentage at T2.*/
	g_FG_PSEUDO100_T3 = <(90)>;	/*	Pseudo 100% percentage at T3.*/

};


&bat_gm30
{
	battery_total_number =<3>;
	battery0_name ="KS40-Sunwoda-2820mAh";
	battery1_name ="KS40-SCUD-2820mAh";
	battery2_name ="KS40-ATL-2820mAh";
	
	battery0_profile_t0_num = <100>;
	battery0_profile_t0 =
	<
	0	43650	1380
	303	43517	1380
	605	43386	1380
	908	43259	1380
	1210	43136	1380
	1513	43015	1380
	1815	42888	1380
	2118	42763	1380
	2421	42642	1380
	2723	42517	1380
	3026	42391	1381
	3328	42276	1393
	3631	42158	1400
	3933	42037	1400
	4236	41921	1400
	4539	41805	1400
	4841	41684	1400
	5144	41566	1400
	5446	41451	1400
	5749	41336	1400
	6052	41222	1400
	6354	41113	1400
	6657	41004	1409
	6959	40895	1427
	7262	40792	1440
	7564	40689	1450
	7867	40586	1450
	8170	40483	1450
	8472	40380	1450
	8775	40283	1466
	9077	40186	1483
	9380	40089	1495
	9682	40000	1511
	9985	39915	1529
	10288	39825	1530
	10590	39737	1542
	10893	39659	1585
	11195	39576	1612
	11498	39492	1630
	11800	39401	1642
	12103	39304	1640
	12406	39195	1610
	12708	39070	1531
	13011	38938	1429
	13313	38841	1399
	13616	38753	1380
	13918	38681	1380
	14221	38612	1367
	14524	38547	1351
	14826	38492	1369
	15129	38438	1380
	15431	38383	1380
	15734	38333	1380
	16037	38286	1381
	16339	38243	1393
	16642	38201	1400
	16944	38159	1400
	17247	38116	1400
	17549	38075	1403
	17852	38038	1421
	18155	38005	1436
	18457	37975	1448
	18760	37945	1465
	19062	37914	1480
	19365	37884	1480
	19667	37854	1486
	19970	37824	1499
	20273	37793	1500
	20575	37758	1493
	20878	37703	1463
	21180	37638	1426
	21483	37566	1383
	21785	37521	1391
	22088	37479	1400
	22391	37436	1400
	22693	37394	1393
	22996	37352	1380
	23298	37315	1380
	23601	37281	1389
	23903	37250	1420
	24206	37204	1418
	24509	37150	1400
	24811	37089	1400
	25114	37031	1406
	25416	36976	1425
	25719	36905	1417
	26022	36829	1400
	26324	36805	1400
	26627	36788	1419
	26929	36782	1467
	27232	36762	1502
	27534	36731	1533
	27837	36635	1563
	28140	36403	1572
	28442	35998	1554
	28745	35413	1621
	29047	34700	1753
	29350	33466	2165
	29652	32820	2380
	29955	32820	2380
	>;
	battery0_profile_t1_num = <100>;
	battery0_profile_t1 =
	<
	0	43815	2030
	303	43655	2030
	605	43505	2036
	908	43372	2054
	1210	43240	2060
	1513	43109	2060
	1815	42983	2054
	2118	42857	2048
	2421	42732	2042
	2723	42610	2044
	3026	42490	2049
	3328	42368	2043
	3631	42247	2037
	3933	42126	2031
	4236	42009	2035
	4539	41893	2040
	4841	41777	2040
	5144	41663	2043
	5446	41550	2049
	5749	41436	2050
	6052	41322	2051
	6354	41211	2057
	6657	41101	2063
	6959	40990	2069
	7262	40889	2070
	7564	40797	2085
	7867	40729	2158
	8170	40644	2217
	8472	40547	2266
	8775	40379	2199
	9077	40212	2138
	9380	40068	2132
	9682	39958	2145
	9985	39869	2169
	10288	39813	2222
	10590	39756	2267
	10893	39693	2291
	11195	39619	2296
	11498	39540	2290
	11800	39450	2278
	12103	39355	2249
	12406	39247	2189
	12708	39134	2116
	13011	39018	2038
	13313	38913	1971
	13616	38816	1921
	13918	38734	1897
	14221	38660	1872
	14524	38589	1850
	14826	38531	1857
	15129	38475	1860
	15431	38420	1860
	15734	38370	1869
	16037	38321	1880
	16339	38275	1880
	16642	38231	1886
	16944	38190	1898
	17247	38149	1905
	17549	38110	1911
	17852	38072	1917
	18155	38037	1929
	18457	38004	1947
	18760	37973	1950
	19062	37943	1952
	19365	37913	1965
	19667	37886	1980
	19970	37861	1998
	20273	37834	1989
	20575	37805	1978
	20878	37775	1972
	21180	37746	1974
	21483	37719	1980
	21785	37685	1963
	22088	37650	1948
	22391	37613	1942
	22693	37573	1944
	22996	37532	1950
	23298	37493	1962
	23601	37458	1984
	23903	37428	2026
	24206	37387	2061
	24509	37339	2091
	24811	37276	2109
	25114	37216	2136
	25416	37161	2178
	25719	37093	2221
	26022	37021	2263
	26324	36959	2299
	26627	36917	2358
	26929	36904	2449
	27232	36888	2563
	27534	36868	2691
	27837	36825	2879
	28140	36685	3041
	28442	36432	3175
	28745	35939	3430
	29047	35327	3774
	29350	34377	4440
	29652	33906	4770
	29955	33906	4770
	>;
	battery0_profile_t2_num = <100>;
	battery0_profile_t2 =
	<
	0	43846	8120
	303	43634	8120
	605	43434	8122
	908	43258	8128
	1210	43096	8101
	1513	42941	8058
	1815	42800	8016
	2118	42661	7964
	2421	42526	7897
	2723	42395	7844
	3026	42266	7797
	3328	42142	7761
	3631	42021	7719
	3933	41903	7671
	4236	41788	7622
	4539	41673	7576
	4841	41559	7546
	5144	41445	7513
	5446	41330	7476
	5749	41219	7445
	6052	41113	7424
	6354	41032	7448
	6657	40950	7494
	6959	40868	7561
	7262	40756	7544
	7564	40630	7492
	7867	40467	7359
	8170	40298	7212
	8472	40126	7054
	8775	39986	6969
	9077	39856	6902
	9380	39747	6872
	9682	39655	6860
	9985	39574	6860
	10288	39501	6877
	10590	39426	6883
	10893	39345	6859
	11195	39262	6834
	11498	39178	6810
	11800	39093	6768
	12103	39009	6732
	12406	38927	6708
	12708	38848	6688
	13011	38771	6670
	13313	38698	6670
	13616	38626	6668
	13918	38557	6662
	14221	38496	6678
	14524	38438	6702
	14826	38381	6726
	15129	38327	6753
	15431	38277	6783
	15734	38229	6809
	16037	38183	6835
	16339	38139	6877
	16642	38097	6920
	16944	38056	6962
	17247	38022	7009
	17549	37992	7061
	17852	37967	7127
	18155	37945	7209
	18457	37927	7306
	18760	37909	7419
	19062	37893	7536
	19365	37876	7663
	19667	37860	7797
	19970	37845	7936
	20273	37830	8092
	20575	37814	8254
	20878	37793	8429
	21180	37774	8612
	21483	37755	8799
	21785	37733	8998
	22088	37710	9203
	22391	37685	9421
	22693	37656	9639
	22996	37624	9857
	23298	37591	10099
	23601	37555	10343
	23903	37516	10591
	24206	37471	10851
	24509	37423	11118
	24811	37369	11403
	25114	37313	11707
	25416	37255	12046
	25719	37192	12385
	26022	37126	12726
	26324	37058	13095
	26627	36998	13470
	26929	36949	13851
	27232	36915	14278
	27534	36885	14726
	27837	36847	15216
	28140	36784	15714
	28442	36690	16223
	28745	36399	16726
	29047	36011	17307
	29350	35355	18311
	29652	34488	19390
	29955	33147	17870
	>;
	battery0_profile_t3_num = <100>;
	battery0_profile_t3 =
	<
	0	43870	16430
	303	43598	16430
	605	43338	16325
	908	43102	16023
	1210	42896	15699
	1513	42703	15367
	1815	42528	15046
	2118	42359	14740
	2421	42202	14456
	2723	42062	14225
	3026	41929	14013
	3328	41796	13801
	3631	41666	13595
	3933	41539	13395
	4236	41416	13233
	4539	41300	13093
	4841	41215	13032
	5144	41125	12972
	5446	41028	12911
	5749	40902	12802
	6052	40762	12661
	6354	40586	12419
	6657	40417	12193
	6959	40254	11981
	7262	40116	11836
	7564	39988	11712
	7867	39879	11621
	8170	39780	11554
	8472	39690	11505
	8775	39610	11489
	9077	39531	11480
	9380	39453	11480
	9682	39374	11462
	9985	39295	11432
	10288	39211	11402
	10590	39130	11375
	10893	39057	11357
	11195	38981	11342
	11498	38902	11330
	11800	38830	11330
	12103	38759	11324
	12406	38692	11306
	12708	38622	11300
	13011	38549	11300
	13313	38495	11318
	13616	38441	11334
	13918	38386	11346
	14221	38336	11371
	14524	38288	11402
	14826	38246	11451
	15129	38206	11497
	15431	38169	11539
	15734	38138	11608
	16037	38108	11688
	16339	38084	11779
	16642	38060	11875
	16944	38035	11977
	17247	38016	12094
	17549	37998	12219
	17852	37980	12370
	18155	37959	12516
	18457	37934	12655
	18760	37915	12814
	19062	37896	12980
	19365	37872	13162
	19667	37851	13343
	19970	37833	13525
	20273	37809	13722
	20575	37785	13920
	20878	37761	14114
	21180	37733	14301
	21483	37703	14482
	21785	37678	14691
	22088	37652	14900
	22391	37622	15100
	22693	37592	15314
	22996	37562	15538
	23298	37526	15750
	23601	37488	15962
	23903	37445	16173
	24206	37399	16385
	24509	37351	16597
	24811	37296	16796
	25114	37242	17014
	25416	37188	17268
	25719	37133	17547
	26022	37079	17838
	26324	37037	18171
	26627	36997	18542
	26929	36960	18977
	27232	36920	19491
	27534	36875	20045
	27837	36803	20741
	28140	36683	21494
	28442	36495	22329
	28745	36141	23416
	29047	35714	24287
	29350	35071	22679
	29652	34060	20156
	29955	33870	19680
	>;

	battery1_profile_t0_num = <100>;
	battery1_profile_t0 =
	<
	0	43812	1290
	298	43705	1290
	596	43597	1290
	894	43490	1290
	1192	43378	1278
	1490	43264	1261
	1788	43149	1266
	2086	43033	1270
	2384	42915	1270
	2682	42797	1277
	2980	42679	1289
	3278	42564	1296
	3576	42448	1303
	3874	42330	1315
	4172	42212	1313
	4470	42094	1301
	4768	41972	1300
	5066	41853	1303
	5364	41742	1315
	5662	41629	1320
	5960	41515	1320
	6258	41400	1320
	6556	41287	1321
	6854	41180	1327
	7152	41071	1327
	7449	40960	1321
	7747	40855	1335
	8045	40751	1351
	8343	40647	1357
	8641	40546	1366
	8939	40446	1378
	9237	40347	1389
	9535	40248	1401
	9833	40156	1407
	10131	40065	1423
	10429	39976	1453
	10727	39887	1465
	11025	39798	1473
	11323	39710	1502
	11621	39619	1535
	11919	39527	1570
	12217	39408	1532
	12515	39278	1465
	12813	39142	1376
	13111	39023	1316
	13409	38934	1304
	13707	38856	1296
	14005	38782	1290
	14303	38719	1290
	14601	38657	1290
	14899	38593	1290
	15197	38535	1282
	15495	38480	1270
	15793	38432	1288
	16091	38383	1300
	16389	38331	1300
	16687	38287	1307
	16985	38246	1319
	17283	38202	1320
	17581	38159	1322
	17879	38122	1328
	18177	38085	1337
	18475	38048	1349
	18773	38014	1355
	19071	37983	1367
	19369	37957	1397
	19667	37927	1410
	19965	37894	1410
	20263	37857	1410
	20561	37813	1399
	20859	37739	1345
	21157	37669	1314
	21455	37603	1302
	21753	37555	1300
	22051	37511	1302
	22348	37466	1314
	22646	37422	1314
	22944	37377	1302
	23242	37339	1300
	23540	37302	1302
	23838	37265	1314
	24136	37218	1328
	24434	37159	1346
	24732	37100	1350
	25030	37040	1351
	25328	36973	1357
	25626	36908	1350
	25924	36846	1326
	26222	36824	1333
	26520	36816	1352
	26818	36806	1388
	27116	36790	1440
	27414	36768	1518
	27712	36625	1481
	28010	36423	1401
	28308	35954	1437
	28606	35378	1498
	28904	34610	1605
	29202	33164	4573
	29500	31398	8900
	>;
	battery1_profile_t1_num = <100>;
	battery1_profile_t1 =
	<
	0	43861	1710
	298	43735	1710
	596	43613	1712
	894	43499	1718
	1192	43382	1716
	1490	43264	1710
	1788	43142	1710
	2086	43021	1712
	2384	42903	1718
	2682	42782	1709
	2980	42660	1691
	3278	42542	1701
	3576	42425	1712
	3874	42310	1717
	4172	42193	1720
	4470	42075	1720
	4768	41957	1720
	5066	41841	1724
	5364	41730	1742
	5662	41617	1750
	5960	41502	1750
	6258	41394	1765
	6556	41286	1780
	6854	41175	1780
	7152	41066	1792
	7449	40959	1816
	7747	40855	1825
	8045	40757	1838
	8343	40695	1892
	8641	40609	1920
	8939	40499	1920
	9237	40346	1906
	9535	40189	1892
	9833	40066	1910
	10131	39970	1941
	10429	39908	1989
	10727	39851	2023
	11025	39793	2051
	11323	39711	2063
	11621	39627	2075
	11919	39539	2087
	12217	39439	2064
	12515	39334	2024
	12813	39201	1911
	13111	39077	1811
	13409	38966	1734
	13707	38873	1689
	14005	38788	1660
	14303	38717	1648
	14601	38651	1640
	14899	38592	1640
	15197	38535	1636
	15495	38480	1630
	15793	38425	1618
	16091	38373	1614
	16389	38328	1626
	16687	38287	1641
	16985	38246	1659
	17283	38202	1660
	17581	38160	1665
	17879	38127	1683
	18177	38091	1690
	18475	38054	1690
	18773	38021	1706
	19071	37990	1724
	19369	37964	1742
	19667	37933	1743
	19965	37900	1731
	20263	37873	1751
	20561	37847	1770
	20859	37817	1770
	21157	37784	1754
	21455	37747	1725
	21753	37707	1705
	22051	37667	1688
	22348	37630	1676
	22646	37591	1661
	22944	37551	1643
	23242	37513	1650
	23540	37476	1660
	23838	37443	1660
	24136	37406	1674
	24434	37366	1703
	24732	37305	1687
	25030	37239	1662
	25328	37184	1680
	25626	37122	1698
	25924	37052	1715
	26222	36990	1698
	26520	36934	1672
	26818	36915	1695
	27116	36900	1731
	27414	36889	1785
	27712	36865	1847
	28010	36829	1910
	28308	36633	1910
	28606	36324	1927
	28904	35811	1975
	29202	35060	2127
	29500	34195	2330
	>;
	battery1_profile_t2_num = <100>;
	battery1_profile_t2 =
	<
	0	43898	6480
	298	43754	6480
	596	43614	6495
	894	43485	6543
	1192	43353	6537
	1490	43221	6501
	1788	43091	6442
	2086	42965	6400
	2384	42847	6400
	2682	42726	6385
	2980	42604	6362
	3278	42486	6316
	3576	42369	6277
	3874	42254	6265
	4172	42140	6239
	4470	42025	6204
	4768	41913	6168
	5066	41803	6133
	5364	41692	6104
	5662	41583	6090
	5960	41476	6090
	6258	41366	6069
	6556	41256	6044
	6854	41149	6015
	7152	41051	6009
	7449	40962	6027
	7747	40886	6075
	8045	40808	6122
	8343	40708	6134
	8641	40573	6083
	8939	40399	5964
	9237	40214	5821
	9535	40031	5682
	9833	39887	5610
	10131	39760	5549
	10429	39657	5501
	10727	39570	5476
	11025	39490	5457
	11323	39416	5428
	11621	39340	5400
	11919	39263	5376
	12217	39180	5322
	12515	39095	5258
	12813	39014	5216
	13111	38934	5183
	13409	38857	5165
	13707	38782	5148
	14005	38708	5130
	14303	38641	5112
	14601	38578	5106
	14899	38523	5124
	15197	38467	5138
	15495	38412	5150
	15793	38360	5156
	16091	38311	5169
	16389	38266	5199
	16687	38222	5214
	16985	38177	5220
	17283	38140	5248
	17581	38103	5278
	17879	38066	5308
	18177	38032	5338
	18475	37999	5367
	18773	37969	5392
	19071	37941	5421
	19369	37919	5469
	19667	37897	5510
	19965	37875	5546
	20263	37859	5608
	20561	37843	5673
	20859	37825	5739
	21157	37808	5817
	21455	37793	5906
	21753	37775	5986
	22051	37756	6067
	22348	37734	6168
	22646	37710	6264
	22944	37684	6353
	23242	37652	6467
	23540	37618	6585
	23838	37573	6699
	24136	37527	6831
	24434	37479	6986
	24732	37425	7150
	25030	37368	7318
	25328	37302	7497
	25626	37236	7704
	25924	37169	7948
	26222	37108	8223
	26520	37051	8518
	26818	37017	8929
	27116	36987	9391
	27414	36961	9934
	27712	36922	10637
	28010	36873	11411
	28308	36707	12317
	28606	36440	13186
	28904	35989	13991
	29202	35290	14913
	29500	34474	15890
	>;
	battery1_profile_t3_num = <100>;
	battery1_profile_t3 =
	<
	0	43911	11730
	298	43745	11730
	596	43583	11740
	894	43432	11769
	1192	43280	11738
	1490	43129	11672
	1788	42995	11601
	2086	42862	11512
	2384	42729	11381
	2682	42601	11246
	2980	42475	11109
	3278	42353	10978
	3576	42233	10850
	3874	42118	10731
	4172	42004	10611
	4470	41889	10492
	4768	41778	10389
	5066	41667	10292
	5364	41556	10208
	5662	41445	10115
	5960	41335	10014
	6258	41224	9928
	6556	41118	9851
	6854	41033	9803
	7152	40946	9777
	7449	40857	9771
	7747	40744	9706
	8045	40617	9611
	8343	40439	9420
	8641	40257	9224
	8939	40068	9021
	9237	39912	8890
	9535	39768	8784
	9833	39654	8730
	10131	39554	8695
	10429	39472	8683
	10727	39400	8657
	11025	39329	8629
	11323	39255	8624
	11621	39183	8601
	11919	39113	8553
	12217	39037	8514
	12515	38960	8478
	12813	38890	8449
	13111	38819	8428
	13409	38749	8422
	13707	38684	8395
	14005	38621	8360
	14303	38562	8366
	14601	38504	8376
	14899	38449	8394
	15197	38396	8396
	15495	38344	8390
	15793	38296	8396
	16091	38248	8404
	16389	38200	8416
	16687	38157	8424
	16985	38116	8430
	17283	38079	8475
	17581	38044	8520
	17879	38014	8555
	18177	37987	8609
	18475	37961	8674
	18773	37942	8729
	19071	37923	8788
	19369	37905	8866
	19667	37886	8960
	19965	37868	9067
	20263	37850	9190
	20561	37832	9312
	20859	37817	9419
	21157	37800	9539
	21455	37782	9670
	21753	37760	9806
	22051	37737	9940
	22348	37707	10059
	22646	37679	10225
	22944	37654	10440
	23242	37622	10621
	23540	37587	10799
	23838	37547	11014
	24136	37505	11239
	24434	37460	11477
	24732	37410	11739
	25030	37357	12008
	25328	37294	12289
	25626	37230	12581
	25924	37164	12891
	26222	37111	13277
	26520	37064	13686
	26818	37030	14074
	27116	36999	14489
	27414	36969	14948
	27712	36924	15445
	28010	36868	15955
	28308	36687	16396
	28606	36402	16841
	28904	35929	17294
	29202	35180	18103
	29500	34301	19080
	>;


	battery2_profile_t0_num = <100>;
	battery2_profile_t0 =
	<
	0	43650	1450
	303	43498	1450
	606	43357	1450
	909	43224	1447
	1212	43095	1440
	1516	42966	1440
	1819	42843	1445
	2122	42718	1447
	2425	42590	1441
	2728	42469	1448
	3031	42353	1450
	3334	42236	1453
	3637	42115	1462
	3940	41994	1477
	4244	41879	1474
	4547	41761	1474
	4850	41641	1480
	5153	41528	1480
	5456	41414	1480
	5759	41300	1484
	6062	41188	1493
	6365	41082	1508
	6668	40969	1510
	6972	40860	1514
	7275	40756	1520
	7578	40657	1520
	7881	40552	1534
	8184	40450	1549
	8487	40352	1558
	8790	40253	1550
	9093	40155	1557
	9396	40061	1570
	9699	39973	1582
	10003	39889	1590
	10306	39806	1605
	10609	39722	1620
	10912	39639	1638
	11215	39556	1661
	11518	39480	1684
	11821	39399	1701
	12124	39316	1716
	12427	39230	1727
	12731	39124	1697
	13034	39000	1626
	13337	38878	1553
	13640	38769	1498
	13943	38685	1483
	14246	38614	1468
	14549	38550	1460
	14852	38491	1460
	15155	38438	1460
	15459	38385	1466
	15762	38336	1466
	16065	38290	1463
	16368	38245	1478
	16671	38199	1480
	16974	38154	1484
	17277	38110	1492
	17580	38072	1500
	17883	38042	1507
	18187	38007	1515
	18490	37971	1522
	18793	37941	1530
	19096	37910	1537
	19399	37880	1550
	19702	37852	1560
	20005	37829	1560
	20308	37799	1575
	20611	37769	1585
	20915	37730	1573
	21218	37675	1527
	21521	37600	1474
	21824	37546	1466
	22127	37501	1470
	22430	37456	1471
	22733	37418	1478
	23036	37380	1474
	23339	37342	1474
	23642	37306	1481
	23946	37275	1489
	24249	37239	1496
	24552	37189	1496
	24855	37129	1489
	25158	37068	1481
	25461	37008	1493
	25764	36939	1500
	26067	36866	1491
	26370	36806	1454
	26674	36793	1471
	26977	36781	1498
	27280	36766	1532
	27583	36751	1578
	27886	36714	1645
	28189	36567	1627
	28492	36280	1594
	28795	35825	1640
	29098	35175	1722
	29402	34254	1918
	29705	33570	2080
	30008	33570	2080
	>;
	battery2_profile_t1_num = <100>;
	battery2_profile_t1 =
	<
	0	43800	1730
	303	43648	1730
	606	43507	1730
	909	43374	1725
	1212	43245	1711
	1516	43116	1726
	1819	42993	1735
	2122	42868	1737
	2425	42740	1730
	2728	42619	1730
	3031	42498	1742
	3334	42377	1750
	3637	42255	1752
	3940	42134	1767
	4244	42013	1764
	4547	41895	1760
	4850	41782	1761
	5153	41668	1769
	5456	41555	1783
	5759	41441	1798
	6062	41327	1812
	6365	41214	1819
	6668	41100	1833
	6972	40991	1840
	7275	40886	1845
	7578	40788	1868
	7881	40696	1898
	8184	40596	1928
	8487	40488	1950
	8790	40375	1950
	9093	40261	1972
	9396	40157	1980
	9699	40058	1987
	10003	39960	2010
	10306	39869	2018
	10609	39783	2025
	10912	39705	2041
	11215	39637	2070
	11518	39561	2078
	11821	39475	2080
	12124	39384	2068
	12427	39291	2035
	12731	39177	1966
	13034	39064	1892
	13337	38953	1817
	13640	38850	1745
	13943	38767	1708
	14246	38689	1682
	14549	38621	1670
	14852	38560	1670
	15155	38500	1670
	15459	38445	1664
	15762	38396	1660
	16065	38351	1662
	16368	38305	1669
	16671	38260	1677
	16974	38219	1684
	17277	38181	1692
	17580	38143	1699
	17883	38105	1700
	18187	38072	1705
	18490	38041	1710
	18793	38011	1710
	19096	37981	1717
	19399	37951	1715
	19702	37920	1712
	20005	37890	1720
	20308	37867	1728
	20611	37845	1735
	20915	37819	1737
	21218	37789	1729
	21521	37758	1714
	21824	37728	1694
	22127	37698	1674
	22430	37667	1659
	22733	37629	1652
	23036	37591	1644
	23339	37553	1640
	23642	37516	1641
	23946	37486	1648
	24249	37450	1656
	24552	37405	1660
	24855	37349	1659
	25158	37281	1651
	25461	37225	1663
	25764	37168	1674
	26067	37102	1677
	26370	37011	1662
	26674	36973	1667
	26977	36956	1687
	27280	36946	1721
	27583	36931	1766
	27886	36916	1819
	28189	36865	1876
	28492	36719	1907
	28795	36393	1862
	29098	35864	1940
	29402	35151	2086
	29705	34084	2469
	30008	32470	3280
	>;
	battery2_profile_t2_num = <100>;
	battery2_profile_t2 =
	<
	0	43900	4450
	303	43733	4450
	606	43587	4445
	909	43454	4432
	1212	43325	4408
	1516	43196	4363
	1819	43067	4312
	2122	42941	4271
	2425	42820	4248
	2728	42699	4225
	3031	42583	4203
	3334	42466	4180
	3637	42345	4158
	3940	42224	4143
	4244	42109	4128
	4547	41995	4120
	4850	41881	4119
	5153	41768	4111
	5456	41654	4110
	5759	41540	4110
	6062	41427	4110
	6365	41313	4110
	6668	41199	4103
	6972	41090	4096
	7275	40986	4090
	7578	40887	4090
	7881	40796	4139
	8184	40705	4206
	8487	40605	4262
	8790	40484	4270
	9093	40326	4197
	9396	40172	4140
	9699	40028	4098
	10003	39899	4060
	10306	39801	4045
	10609	39712	4019
	10912	39626	3978
	11215	39535	3916
	11518	39444	3840
	11821	39354	3792
	12124	39266	3761
	12427	39182	3737
	12731	39091	3699
	13034	39006	3667
	13337	38922	3640
	13640	38841	3618
	13943	38773	3603
	14246	38705	3600
	14549	38636	3596
	14852	38571	3591
	15155	38518	3599
	15459	38458	3606
	15762	38402	3622
	16065	38350	3640
	16368	38305	3640
	16671	38259	3660
	16974	38218	3674
	17277	38178	3686
	17580	38133	3709
	17883	38095	3731
	18187	38061	3754
	18490	38029	3772
	18793	37991	3780
	19096	37960	3802
	19399	37930	3825
	19702	37900	3843
	20005	37870	3851
	20308	37847	3881
	20611	37829	3901
	20915	37811	3913
	21218	37789	3923
	21521	37774	3968
	21824	37759	3997
	22127	37744	4026
	22430	37728	4064
	22733	37705	4102
	23036	37676	4140
	23339	37646	4181
	23642	37616	4229
	23946	37585	4289
	24249	37543	4356
	24552	37497	4428
	24855	37450	4504
	25158	37397	4580
	25461	37338	4682
	25764	37277	4796
	26067	37211	4919
	26370	37128	5048
	26674	37065	5218
	26977	37018	5427
	27280	36982	5690
	27583	36952	6031
	27886	36921	6473
	28189	36882	7048
	28492	36806	7769
	28795	36662	8648
	29098	36279	9841
	29402	35731	11953
	29705	34973	15232
	30008	34000	19720
	>;
	battery2_profile_t3_num = <100>;
	battery2_profile_t3 =
	<
	0	43930	9640
	303	43725	9640
	606	43552	9635
	909	43401	9605
	1212	43264	9536
	1516	43128	9445
	1819	42992	9365
	2122	42861	9283
	2425	42740	9194
	2728	42619	9118
	3031	42498	9031
	3334	42376	8946
	3637	42255	8871
	3940	42134	8795
	4244	42013	8725
	4547	41895	8657
	4850	41781	8589
	5153	41668	8521
	5456	41554	8459
	5759	41436	8398
	6062	41317	8338
	6365	41203	8277
	6668	41089	8216
	6972	40980	8173
	7275	40876	8150
	7578	40777	8150
	7881	40672	8143
	8184	40556	8108
	8487	40424	8039
	8790	40265	7933
	9093	40098	7805
	9396	39942	7696
	9699	39798	7613
	10003	39669	7560
	10306	39570	7537
	10609	39488	7530
	10912	39412	7519
	11215	39336	7488
	11518	39260	7450
	11821	39190	7434
	12124	39122	7427
	12427	39054	7418
	12731	38985	7395
	13034	38911	7378
	13337	38839	7370
	13640	38771	7370
	13943	38703	7370
	14246	38641	7382
	14549	38580	7394
	14852	38519	7407
	15155	38459	7445
	15459	38405	7482
	15762	38352	7512
	16065	38300	7537
	16368	38255	7567
	16671	38209	7597
	16974	38164	7632
	17277	38118	7672
	17580	38073	7717
	17883	38034	7748
	18187	37997	7783
	18490	37961	7824
	18793	37931	7869
	19096	37900	7929
	19399	37875	7990
	19702	37852	8053
	20005	37830	8122
	20308	37815	8205
	20611	37794	8299
	20915	37771	8392
	21218	37749	8477
	21521	37734	8591
	21824	37713	8693
	22127	37687	8801
	22430	37658	8924
	22733	37635	9060
	23036	37606	9215
	23339	37576	9381
	23642	37545	9556
	23946	37507	9738
	24249	37469	9957
	24552	37427	10200
	24855	37382	10466
	25158	37336	10769
	25461	37278	11105
	25764	37221	11500
	26067	37168	11967
	26370	37115	12528
	26674	37069	13212
	26977	37028	14025
	27280	36988	14946
	27583	36942	15939
	27886	36883	16931
	28189	36803	17857
	28492	36686	18802
	28795	36512	19879
	29098	36173	21674
	29402	36060	22270
	29705	36060	22270
	30008	36060	22270
	>;

};
