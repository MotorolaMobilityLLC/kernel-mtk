&charger
{

	battery_cv = <4400000>;

	jeita_temp_above_t4_cv_voltage = <4200000>;
	jeita_temp_t3_to_t4_cv_voltage = <4200000>;
	jeita_temp_t2_to_t3_cv_voltage = <4400000>;
	jeita_temp_t1_to_t2_cv_voltage = <4400000>;
	jeita_temp_t0_to_t1_cv_voltage = <4400000>;
	jeita_temp_below_t0_cv_voltage = <4200000>;

#ifdef CONFIG_CHARGE_STOP_DEGREE55
	temp_t4_threshold = <55>;
	temp_t4_thres_minus_x_degree = <52>;
#else
	temp_t4_threshold = <50>;
	temp_t4_thres_minus_x_degree = <47>;
#endif
	temp_t3_threshold = <45>;
	temp_t3_thres_minus_x_degree = <39>;
	temp_t2_threshold = <15>;
	temp_t2_thres_plus_x_degree = <18>;
	temp_t1_threshold = <15>;
	temp_t1_thres_plus_x_degree = <18>;
	temp_t0_threshold = <0>;
	temp_t0_thres_plus_x_degree = <2>;
	temp_neg_10_threshold = <0>;

	/* battery temperature protection */
	enable_min_charge_temperature;
	min_charge_temperature = <0>;
	min_charge_temperature_plus_x_degree = <2>;
#ifdef CONFIG_CHARGE_STOP_DEGREE55
	max_charge_temperature = <55>;
	max_charge_temperature_minus_x_degree = <52>;
#else
	max_charge_temperature = <50>;
	max_charge_temperature_minus_x_degree = <47>;
#endif


       ac_charger_current = <2050000>;

};

&bat_gm30
{
	TEMPERATURE_T0 = <(50)>;	/*	Battery temperature T0*/
	TEMPERATURE_T1 = <(25)>;	/*	Battery temperature T1*/
	TEMPERATURE_T2 = <(0)>;	/*	Battery temperature T2*/
	TEMPERATURE_T3 = <(-10)>;	/*	Battery temperature T3*/
	g_FG_PSEUDO100_T0 = <(98)>;	/*	Pseudo 100% percentage at T0.*/
	g_FG_PSEUDO100_T1 = <(98)>;	/*	Pseudo 100% percentage at T1.*/
	g_FG_PSEUDO100_T2 = <(95)>;	/*	Pseudo 100% percentage at T2.*/
	g_FG_PSEUDO100_T3 = <(90)>;	/*	Pseudo 100% percentage at T3.*/

};


&bat_gm30
{
	battery_total_number =<2>;
	battery0_name ="KS40-Sunwoda-2820mAh";
	battery1_name ="KS40-Ningde-2820mAh";
	
	battery0_profile_t0_num = <100>;
	battery0_profile_t0 =
	<
	0	43650	1450
	303	43498	1450
	606	43357	1450
	909	43224	1447
	1212	43095	1440
	1516	42966	1440
	1819	42843	1445
	2122	42718	1447
	2425	42590	1441
	2728	42469	1448
	3031	42353	1450
	3334	42236	1453
	3637	42115	1462
	3940	41994	1477
	4244	41879	1474
	4547	41761	1474
	4850	41641	1480
	5153	41528	1480
	5456	41414	1480
	5759	41300	1484
	6062	41188	1493
	6365	41082	1508
	6668	40969	1510
	6972	40860	1514
	7275	40756	1520
	7578	40657	1520
	7881	40552	1534
	8184	40450	1549
	8487	40352	1558
	8790	40253	1550
	9093	40155	1557
	9396	40061	1570
	9699	39973	1582
	10003	39889	1590
	10306	39806	1605
	10609	39722	1620
	10912	39639	1638
	11215	39556	1661
	11518	39480	1684
	11821	39399	1701
	12124	39316	1716
	12427	39230	1727
	12731	39124	1697
	13034	39000	1626
	13337	38878	1553
	13640	38769	1498
	13943	38685	1483
	14246	38614	1468
	14549	38550	1460
	14852	38491	1460
	15155	38438	1460
	15459	38385	1466
	15762	38336	1466
	16065	38290	1463
	16368	38245	1478
	16671	38199	1480
	16974	38154	1484
	17277	38110	1492
	17580	38072	1500
	17883	38042	1507
	18187	38007	1515
	18490	37971	1522
	18793	37941	1530
	19096	37910	1537
	19399	37880	1550
	19702	37852	1560
	20005	37829	1560
	20308	37799	1575
	20611	37769	1585
	20915	37730	1573
	21218	37675	1527
	21521	37600	1474
	21824	37546	1466
	22127	37501	1470
	22430	37456	1471
	22733	37418	1478
	23036	37380	1474
	23339	37342	1474
	23642	37306	1481
	23946	37275	1489
	24249	37239	1496
	24552	37189	1496
	24855	37129	1489
	25158	37068	1481
	25461	37008	1493
	25764	36939	1500
	26067	36866	1491
	26370	36806	1454
	26674	36793	1471
	26977	36781	1498
	27280	36766	1532
	27583	36751	1578
	27886	36714	1645
	28189	36567	1627
	28492	36280	1594
	28795	35825	1640
	29098	35175	1722
	29402	34254	1918
	29705	33570	2080
	30008	33570	2080
	>;
	battery0_profile_t1_num = <100>;
	battery0_profile_t1 =
	<
	0	43800	1730
	303	43648	1730
	606	43507	1730
	909	43374	1725
	1212	43245	1711
	1516	43116	1726
	1819	42993	1735
	2122	42868	1737
	2425	42740	1730
	2728	42619	1730
	3031	42498	1742
	3334	42377	1750
	3637	42255	1752
	3940	42134	1767
	4244	42013	1764
	4547	41895	1760
	4850	41782	1761
	5153	41668	1769
	5456	41555	1783
	5759	41441	1798
	6062	41327	1812
	6365	41214	1819
	6668	41100	1833
	6972	40991	1840
	7275	40886	1845
	7578	40788	1868
	7881	40696	1898
	8184	40596	1928
	8487	40488	1950
	8790	40375	1950
	9093	40261	1972
	9396	40157	1980
	9699	40058	1987
	10003	39960	2010
	10306	39869	2018
	10609	39783	2025
	10912	39705	2041
	11215	39637	2070
	11518	39561	2078
	11821	39475	2080
	12124	39384	2068
	12427	39291	2035
	12731	39177	1966
	13034	39064	1892
	13337	38953	1817
	13640	38850	1745
	13943	38767	1708
	14246	38689	1682
	14549	38621	1670
	14852	38560	1670
	15155	38500	1670
	15459	38445	1664
	15762	38396	1660
	16065	38351	1662
	16368	38305	1669
	16671	38260	1677
	16974	38219	1684
	17277	38181	1692
	17580	38143	1699
	17883	38105	1700
	18187	38072	1705
	18490	38041	1710
	18793	38011	1710
	19096	37981	1717
	19399	37951	1715
	19702	37920	1712
	20005	37890	1720
	20308	37867	1728
	20611	37845	1735
	20915	37819	1737
	21218	37789	1729
	21521	37758	1714
	21824	37728	1694
	22127	37698	1674
	22430	37667	1659
	22733	37629	1652
	23036	37591	1644
	23339	37553	1640
	23642	37516	1641
	23946	37486	1648
	24249	37450	1656
	24552	37405	1660
	24855	37349	1659
	25158	37281	1651
	25461	37225	1663
	25764	37168	1674
	26067	37102	1677
	26370	37011	1662
	26674	36973	1667
	26977	36956	1687
	27280	36946	1721
	27583	36931	1766
	27886	36916	1819
	28189	36865	1876
	28492	36719	1907
	28795	36393	1862
	29098	35864	1940
	29402	35151	2086
	29705	34084	2469
	30008	32470	3280
	>;
	battery0_profile_t2_num = <100>;
	battery0_profile_t2 =
	<
	0	43900	4450
	303	43733	4450
	606	43587	4445
	909	43454	4432
	1212	43325	4408
	1516	43196	4363
	1819	43067	4312
	2122	42941	4271
	2425	42820	4248
	2728	42699	4225
	3031	42583	4203
	3334	42466	4180
	3637	42345	4158
	3940	42224	4143
	4244	42109	4128
	4547	41995	4120
	4850	41881	4119
	5153	41768	4111
	5456	41654	4110
	5759	41540	4110
	6062	41427	4110
	6365	41313	4110
	6668	41199	4103
	6972	41090	4096
	7275	40986	4090
	7578	40887	4090
	7881	40796	4139
	8184	40705	4206
	8487	40605	4262
	8790	40484	4270
	9093	40326	4197
	9396	40172	4140
	9699	40028	4098
	10003	39899	4060
	10306	39801	4045
	10609	39712	4019
	10912	39626	3978
	11215	39535	3916
	11518	39444	3840
	11821	39354	3792
	12124	39266	3761
	12427	39182	3737
	12731	39091	3699
	13034	39006	3667
	13337	38922	3640
	13640	38841	3618
	13943	38773	3603
	14246	38705	3600
	14549	38636	3596
	14852	38571	3591
	15155	38518	3599
	15459	38458	3606
	15762	38402	3622
	16065	38350	3640
	16368	38305	3640
	16671	38259	3660
	16974	38218	3674
	17277	38178	3686
	17580	38133	3709
	17883	38095	3731
	18187	38061	3754
	18490	38029	3772
	18793	37991	3780
	19096	37960	3802
	19399	37930	3825
	19702	37900	3843
	20005	37870	3851
	20308	37847	3881
	20611	37829	3901
	20915	37811	3913
	21218	37789	3923
	21521	37774	3968
	21824	37759	3997
	22127	37744	4026
	22430	37728	4064
	22733	37705	4102
	23036	37676	4140
	23339	37646	4181
	23642	37616	4229
	23946	37585	4289
	24249	37543	4356
	24552	37497	4428
	24855	37450	4504
	25158	37397	4580
	25461	37338	4682
	25764	37277	4796
	26067	37211	4919
	26370	37128	5048
	26674	37065	5218
	26977	37018	5427
	27280	36982	5690
	27583	36952	6031
	27886	36921	6473
	28189	36882	7048
	28492	36806	7769
	28795	36662	8648
	29098	36279	9841
	29402	35731	11953
	29705	34973	15232
	30008	34000	19720
	>;
	battery0_profile_t3_num = <100>;
	battery0_profile_t3 =
	<
	0	43930	9640
	303	43725	9640
	606	43552	9635
	909	43401	9605
	1212	43264	9536
	1516	43128	9445
	1819	42992	9365
	2122	42861	9283
	2425	42740	9194
	2728	42619	9118
	3031	42498	9031
	3334	42376	8946
	3637	42255	8871
	3940	42134	8795
	4244	42013	8725
	4547	41895	8657
	4850	41781	8589
	5153	41668	8521
	5456	41554	8459
	5759	41436	8398
	6062	41317	8338
	6365	41203	8277
	6668	41089	8216
	6972	40980	8173
	7275	40876	8150
	7578	40777	8150
	7881	40672	8143
	8184	40556	8108
	8487	40424	8039
	8790	40265	7933
	9093	40098	7805
	9396	39942	7696
	9699	39798	7613
	10003	39669	7560
	10306	39570	7537
	10609	39488	7530
	10912	39412	7519
	11215	39336	7488
	11518	39260	7450
	11821	39190	7434
	12124	39122	7427
	12427	39054	7418
	12731	38985	7395
	13034	38911	7378
	13337	38839	7370
	13640	38771	7370
	13943	38703	7370
	14246	38641	7382
	14549	38580	7394
	14852	38519	7407
	15155	38459	7445
	15459	38405	7482
	15762	38352	7512
	16065	38300	7537
	16368	38255	7567
	16671	38209	7597
	16974	38164	7632
	17277	38118	7672
	17580	38073	7717
	17883	38034	7748
	18187	37997	7783
	18490	37961	7824
	18793	37931	7869
	19096	37900	7929
	19399	37875	7990
	19702	37852	8053
	20005	37830	8122
	20308	37815	8205
	20611	37794	8299
	20915	37771	8392
	21218	37749	8477
	21521	37734	8591
	21824	37713	8693
	22127	37687	8801
	22430	37658	8924
	22733	37635	9060
	23036	37606	9215
	23339	37576	9381
	23642	37545	9556
	23946	37507	9738
	24249	37469	9957
	24552	37427	10200
	24855	37382	10466
	25158	37336	10769
	25461	37278	11105
	25764	37221	11500
	26067	37168	11967
	26370	37115	12528
	26674	37069	13212
	26977	37028	14025
	27280	36988	14946
	27583	36942	15939
	27886	36883	16931
	28189	36803	17857
	28492	36686	18802
	28795	36512	19879
	29098	36173	21674
	29402	36060	22270
	29705	36060	22270
	30008	36060	22270
	>;
	battery1_profile_t0_num = <100>;
	battery1_profile_t0 =
	<
	0	43650	1450
	303	43498	1450
	606	43357	1450
	909	43224	1447
	1212	43095	1440
	1516	42966	1440
	1819	42843	1445
	2122	42718	1447
	2425	42590	1441
	2728	42469	1448
	3031	42353	1450
	3334	42236	1453
	3637	42115	1462
	3940	41994	1477
	4244	41879	1474
	4547	41761	1474
	4850	41641	1480
	5153	41528	1480
	5456	41414	1480
	5759	41300	1484
	6062	41188	1493
	6365	41082	1508
	6668	40969	1510
	6972	40860	1514
	7275	40756	1520
	7578	40657	1520
	7881	40552	1534
	8184	40450	1549
	8487	40352	1558
	8790	40253	1550
	9093	40155	1557
	9396	40061	1570
	9699	39973	1582
	10003	39889	1590
	10306	39806	1605
	10609	39722	1620
	10912	39639	1638
	11215	39556	1661
	11518	39480	1684
	11821	39399	1701
	12124	39316	1716
	12427	39230	1727
	12731	39124	1697
	13034	39000	1626
	13337	38878	1553
	13640	38769	1498
	13943	38685	1483
	14246	38614	1468
	14549	38550	1460
	14852	38491	1460
	15155	38438	1460
	15459	38385	1466
	15762	38336	1466
	16065	38290	1463
	16368	38245	1478
	16671	38199	1480
	16974	38154	1484
	17277	38110	1492
	17580	38072	1500
	17883	38042	1507
	18187	38007	1515
	18490	37971	1522
	18793	37941	1530
	19096	37910	1537
	19399	37880	1550
	19702	37852	1560
	20005	37829	1560
	20308	37799	1575
	20611	37769	1585
	20915	37730	1573
	21218	37675	1527
	21521	37600	1474
	21824	37546	1466
	22127	37501	1470
	22430	37456	1471
	22733	37418	1478
	23036	37380	1474
	23339	37342	1474
	23642	37306	1481
	23946	37275	1489
	24249	37239	1496
	24552	37189	1496
	24855	37129	1489
	25158	37068	1481
	25461	37008	1493
	25764	36939	1500
	26067	36866	1491
	26370	36806	1454
	26674	36793	1471
	26977	36781	1498
	27280	36766	1532
	27583	36751	1578
	27886	36714	1645
	28189	36567	1627
	28492	36280	1594
	28795	35825	1640
	29098	35175	1722
	29402	34254	1918
	29705	33570	2080
	30008	33570	2080
	>;
	battery1_profile_t1_num = <100>;
	battery1_profile_t1 =
	<
	0	43800	1730
	303	43648	1730
	606	43507	1730
	909	43374	1725
	1212	43245	1711
	1516	43116	1726
	1819	42993	1735
	2122	42868	1737
	2425	42740	1730
	2728	42619	1730
	3031	42498	1742
	3334	42377	1750
	3637	42255	1752
	3940	42134	1767
	4244	42013	1764
	4547	41895	1760
	4850	41782	1761
	5153	41668	1769
	5456	41555	1783
	5759	41441	1798
	6062	41327	1812
	6365	41214	1819
	6668	41100	1833
	6972	40991	1840
	7275	40886	1845
	7578	40788	1868
	7881	40696	1898
	8184	40596	1928
	8487	40488	1950
	8790	40375	1950
	9093	40261	1972
	9396	40157	1980
	9699	40058	1987
	10003	39960	2010
	10306	39869	2018
	10609	39783	2025
	10912	39705	2041
	11215	39637	2070
	11518	39561	2078
	11821	39475	2080
	12124	39384	2068
	12427	39291	2035
	12731	39177	1966
	13034	39064	1892
	13337	38953	1817
	13640	38850	1745
	13943	38767	1708
	14246	38689	1682
	14549	38621	1670
	14852	38560	1670
	15155	38500	1670
	15459	38445	1664
	15762	38396	1660
	16065	38351	1662
	16368	38305	1669
	16671	38260	1677
	16974	38219	1684
	17277	38181	1692
	17580	38143	1699
	17883	38105	1700
	18187	38072	1705
	18490	38041	1710
	18793	38011	1710
	19096	37981	1717
	19399	37951	1715
	19702	37920	1712
	20005	37890	1720
	20308	37867	1728
	20611	37845	1735
	20915	37819	1737
	21218	37789	1729
	21521	37758	1714
	21824	37728	1694
	22127	37698	1674
	22430	37667	1659
	22733	37629	1652
	23036	37591	1644
	23339	37553	1640
	23642	37516	1641
	23946	37486	1648
	24249	37450	1656
	24552	37405	1660
	24855	37349	1659
	25158	37281	1651
	25461	37225	1663
	25764	37168	1674
	26067	37102	1677
	26370	37011	1662
	26674	36973	1667
	26977	36956	1687
	27280	36946	1721
	27583	36931	1766
	27886	36916	1819
	28189	36865	1876
	28492	36719	1907
	28795	36393	1862
	29098	35864	1940
	29402	35151	2086
	29705	34084	2469
	30008	32470	3280
	>;
	battery1_profile_t2_num = <100>;
	battery1_profile_t2 =
	<
	0	43900	4450
	303	43733	4450
	606	43587	4445
	909	43454	4432
	1212	43325	4408
	1516	43196	4363
	1819	43067	4312
	2122	42941	4271
	2425	42820	4248
	2728	42699	4225
	3031	42583	4203
	3334	42466	4180
	3637	42345	4158
	3940	42224	4143
	4244	42109	4128
	4547	41995	4120
	4850	41881	4119
	5153	41768	4111
	5456	41654	4110
	5759	41540	4110
	6062	41427	4110
	6365	41313	4110
	6668	41199	4103
	6972	41090	4096
	7275	40986	4090
	7578	40887	4090
	7881	40796	4139
	8184	40705	4206
	8487	40605	4262
	8790	40484	4270
	9093	40326	4197
	9396	40172	4140
	9699	40028	4098
	10003	39899	4060
	10306	39801	4045
	10609	39712	4019
	10912	39626	3978
	11215	39535	3916
	11518	39444	3840
	11821	39354	3792
	12124	39266	3761
	12427	39182	3737
	12731	39091	3699
	13034	39006	3667
	13337	38922	3640
	13640	38841	3618
	13943	38773	3603
	14246	38705	3600
	14549	38636	3596
	14852	38571	3591
	15155	38518	3599
	15459	38458	3606
	15762	38402	3622
	16065	38350	3640
	16368	38305	3640
	16671	38259	3660
	16974	38218	3674
	17277	38178	3686
	17580	38133	3709
	17883	38095	3731
	18187	38061	3754
	18490	38029	3772
	18793	37991	3780
	19096	37960	3802
	19399	37930	3825
	19702	37900	3843
	20005	37870	3851
	20308	37847	3881
	20611	37829	3901
	20915	37811	3913
	21218	37789	3923
	21521	37774	3968
	21824	37759	3997
	22127	37744	4026
	22430	37728	4064
	22733	37705	4102
	23036	37676	4140
	23339	37646	4181
	23642	37616	4229
	23946	37585	4289
	24249	37543	4356
	24552	37497	4428
	24855	37450	4504
	25158	37397	4580
	25461	37338	4682
	25764	37277	4796
	26067	37211	4919
	26370	37128	5048
	26674	37065	5218
	26977	37018	5427
	27280	36982	5690
	27583	36952	6031
	27886	36921	6473
	28189	36882	7048
	28492	36806	7769
	28795	36662	8648
	29098	36279	9841
	29402	35731	11953
	29705	34973	15232
	30008	34000	19720
	>;
	battery1_profile_t3_num = <100>;
	battery1_profile_t3 =
	<
	0	43930	9640
	303	43725	9640
	606	43552	9635
	909	43401	9605
	1212	43264	9536
	1516	43128	9445
	1819	42992	9365
	2122	42861	9283
	2425	42740	9194
	2728	42619	9118
	3031	42498	9031
	3334	42376	8946
	3637	42255	8871
	3940	42134	8795
	4244	42013	8725
	4547	41895	8657
	4850	41781	8589
	5153	41668	8521
	5456	41554	8459
	5759	41436	8398
	6062	41317	8338
	6365	41203	8277
	6668	41089	8216
	6972	40980	8173
	7275	40876	8150
	7578	40777	8150
	7881	40672	8143
	8184	40556	8108
	8487	40424	8039
	8790	40265	7933
	9093	40098	7805
	9396	39942	7696
	9699	39798	7613
	10003	39669	7560
	10306	39570	7537
	10609	39488	7530
	10912	39412	7519
	11215	39336	7488
	11518	39260	7450
	11821	39190	7434
	12124	39122	7427
	12427	39054	7418
	12731	38985	7395
	13034	38911	7378
	13337	38839	7370
	13640	38771	7370
	13943	38703	7370
	14246	38641	7382
	14549	38580	7394
	14852	38519	7407
	15155	38459	7445
	15459	38405	7482
	15762	38352	7512
	16065	38300	7537
	16368	38255	7567
	16671	38209	7597
	16974	38164	7632
	17277	38118	7672
	17580	38073	7717
	17883	38034	7748
	18187	37997	7783
	18490	37961	7824
	18793	37931	7869
	19096	37900	7929
	19399	37875	7990
	19702	37852	8053
	20005	37830	8122
	20308	37815	8205
	20611	37794	8299
	20915	37771	8392
	21218	37749	8477
	21521	37734	8591
	21824	37713	8693
	22127	37687	8801
	22430	37658	8924
	22733	37635	9060
	23036	37606	9215
	23339	37576	9381
	23642	37545	9556
	23946	37507	9738
	24249	37469	9957
	24552	37427	10200
	24855	37382	10466
	25158	37336	10769
	25461	37278	11105
	25764	37221	11500
	26067	37168	11967
	26370	37115	12528
	26674	37069	13212
	26977	37028	14025
	27280	36988	14946
	27583	36942	15939
	27886	36883	16931
	28189	36803	17857
	28492	36686	18802
	28795	36512	19879
	29098	36173	21674
	29402	36060	22270
	29705	36060	22270
	30008	36060	22270
	>;

};
