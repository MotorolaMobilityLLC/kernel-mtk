&bat_gm30
{
	battery1_name ="JK50-SUN-SB18C85291-5000mah";

	battery1_profile_t0_num = <100>;
	battery1_profile_t0 =
	<
	0	43760	0
	503	43639	1150
	1007	43519	1150
	1510	43399	1125
	2013	43288	1150
	2516	43167	1150
	3020	43047	1150
	3523	42926	1150
	4026	42806	1150
	4529	42685	1150
	5033	42565	1151
	5536	42454	1175
	6039	42333	1174
	6542	42213	1150
	7046	42092	1150
	7549	41973	1152
	8052	41861	1173
	8555	41742	1152
	9059	41630	1173
	9562	41511	1152
	10065	41400	1175
	10569	41290	1175
	11072	41179	1175
	11575	41069	1175
	12078	40958	1175
	12582	40849	1178
	13085	40747	1197
	13588	40638	1178
	14091	40537	1200
	14595	40437	1200
	15098	40338	1203
	15601	40246	1221
	16104	40147	1204
	16608	40057	1225
	17111	39966	1225
	17614	39877	1233
	18117	39795	1271
	18621	39707	1258
	19124	39626	1304
	19627	39544	1325
	20131	39454	1330
	20634	39358	1345
	21137	39230	1306
	21640	39075	1215
	22144	38952	1175
	22647	38862	1170
	23150	38775	1150
	23653	38707	1155
	24157	38647	1175
	24660	38587	1169
	25163	38526	1150
	25666	38468	1150
	26170	38418	1156
	26673	38366	1169
	27176	38310	1150
	27680	38268	1150
	28183	38220	1150
	28686	38180	1156
	29189	38140	1175
	29693	38099	1175
	30196	38059	1175
	30699	38022	1175
	31202	37989	1175
	31706	37951	1175
	32209	37921	1182
	32712	37891	1200
	33215	37861	1200
	33719	37831	1208
	34222	37801	1233
	34725	37764	1242
	35228	37702	1201
	35732	37618	1150
	36235	37554	1150
	36738	37507	1158
	37242	37467	1175
	37745	37423	1175
	38248	37373	1166
	38751	37330	1159
	39255	37296	1175
	39758	37259	1175
	40261	37226	1184
	40764	37178	1191
	41268	37118	1175
	41771	37057	1175
	42274	36997	1184
	42777	36929	1190
	43281	36849	1146
	43784	36792	1110
	44287	36776	1135
	44790	36766	1170
	45294	36756	1230
	45797	36742	1306
	46300	36713	1371
	46804	36623	1358
	47307	36369	1268
	47810	35935	1246
	48313	35359	1286
	48817	34559	1333
	49320	34020	1375
	49823	34020	1375
	>;
	battery1_profile_t1_num = <100>;
	battery1_profile_t1 =
	<
	0	43875	0
	503	43723	1195
	1007	43591	1195
	1510	43467	1200
	2013	43341	1195
	2516	43217	1200
	3020	43091	1203
	3523	42967	1205
	4026	42843	1209
	4529	42723	1230
	5033	42599	1230
	5536	42479	1233
	6039	42358	1237
	6542	42236	1236
	7046	42119	1243
	7549	42000	1248
	8052	41882	1250
	8555	41765	1253
	9059	41650	1258
	9562	41536	1266
	10065	41423	1273
	10569	41310	1278
	11072	41197	1281
	11575	41086	1287
	12078	40977	1299
	12582	40869	1309
	13085	40768	1323
	13588	40685	1345
	14091	40617	1383
	14595	40513	1381
	15098	40370	1366
	15601	40220	1370
	16104	40086	1374
	16608	39985	1393
	17111	39908	1408
	17614	39845	1435
	18117	39779	1456
	18621	39704	1470
	19124	39624	1484
	19627	39541	1501
	20131	39455	1513
	20634	39362	1512
	21137	39259	1494
	21640	39141	1443
	22144	39015	1368
	22647	38896	1300
	23150	38796	1261
	23653	38712	1240
	24157	38638	1226
	24660	38573	1221
	25163	38512	1218
	25666	38456	1218
	26170	38403	1220
	26673	38352	1219
	27176	38303	1221
	27680	38258	1228
	28183	38214	1228
	28686	38172	1230
	29189	38132	1236
	29693	38094	1241
	30196	38057	1246
	30699	38021	1247
	31202	37987	1256
	31706	37956	1259
	32209	37925	1266
	32712	37897	1274
	33215	37870	1283
	33719	37844	1291
	34222	37818	1295
	34725	37791	1293
	35228	37762	1289
	35732	37731	1281
	36235	37695	1263
	36738	37659	1246
	37242	37624	1236
	37745	37588	1230
	38248	37549	1220
	38751	37509	1215
	39255	37470	1215
	39758	37436	1221
	40261	37403	1233
	40764	37364	1238
	41268	37316	1241
	41771	37256	1240
	42274	37193	1236
	42777	37135	1246
	43281	37071	1255
	43784	36989	1242
	44287	36921	1224
	44790	36892	1231
	45294	36880	1253
	45797	36869	1278
	46300	36853	1318
	46804	36830	1377
	47307	36772	1427
	47810	36566	1381
	48313	36165	1355
	48817	35601	1405
	49320	34829	1506
	49823	34501	1553
	>;
	battery1_profile_t2_num = <100>;
	battery1_profile_t2 =
	<
	0	43898	0
	503	43761	2358
	1007	43636	2365
	1510	43515	2380
	2013	43387	2365
	2516	43256	2365
	3020	43131	2365
	3523	43007	2365
	4026	42885	2365
	4529	42763	2358
	5033	42644	2364
	5536	42523	2356
	6039	42401	2363
	6542	42282	2363
	7046	42165	2372
	7549	42049	2373
	8052	41934	2381
	8555	41822	2390
	9059	41712	2411
	9562	41600	2420
	10065	41490	2443
	10569	41375	2451
	11072	41263	2474
	11575	41152	2484
	12078	41046	2507
	12582	40945	2519
	13085	40863	2537
	13588	40800	2597
	14091	40729	2668
	14595	40606	2662
	15098	40430	2632
	15601	40240	2616
	16104	40073	2595
	16608	39937	2588
	17111	39826	2586
	17614	39737	2580
	18117	39666	2586
	18621	39605	2605
	19124	39537	2601
	19627	39459	2576
	20131	39365	2519
	20634	39262	2460
	21137	39159	2413
	21640	39057	2367
	22144	38959	2322
	22647	38871	2291
	23150	38789	2273
	23653	38715	2253
	24157	38645	2247
	24660	38582	2250
	25163	38522	2255
	25666	38465	2256
	26170	38414	2259
	26673	38363	2265
	27176	38314	2271
	27680	38270	2280
	28183	38228	2300
	28686	38187	2313
	29189	38148	2320
	29693	38109	2331
	30196	38072	2346
	30699	38038	2358
	31202	38006	2375
	31706	37977	2395
	32209	37947	2401
	32712	37919	2414
	33215	37893	2423
	33719	37869	2434
	34222	37847	2441
	34725	37826	2441
	35228	37810	2448
	35732	37798	2463
	36235	37784	2476
	36738	37768	2483
	37242	37748	2484
	37745	37723	2487
	38248	37697	2502
	38751	37664	2510
	39255	37628	2519
	39758	37591	2535
	40261	37551	2559
	40764	37504	2583
	41268	37446	2606
	41771	37380	2628
	42274	37318	2660
	42777	37259	2707
	43281	37186	2757
	43784	37100	2795
	44287	37035	2840
	44790	37002	2903
	45294	36979	2978
	45797	36957	3070
	46300	36935	3190
	46804	36904	3358
	47307	36836	3577
	47810	36602	3762
	48313	36147	4041
	48817	35502	4621
	49320	34600	5722
	49823	34213	6230
	>;
	battery1_profile_t3_num = <100>;
	battery1_profile_t3 =
	<
	0	43954	0
	503	43780	5210
	1007	43633	5239
	1510	43492	5200
	2013	43359	5176
	2516	43222	5123
	3020	43090	5066
	3523	42963	5037
	4026	42838	5014
	4529	42713	4989
	5033	42591	4974
	5536	42470	4960
	6039	42349	4960
	6542	42228	4931
	7046	42112	4935
	7549	41993	4914
	8052	41881	4927
	8555	41769	4923
	9059	41656	4929
	9562	41541	4938
	10065	41425	4940
	10569	41310	4962
	11072	41199	4977
	11575	41089	4974
	12078	40984	4980
	12582	40901	5054
	13085	40824	5161
	13588	40735	5244
	14091	40611	5253
	14595	40440	5191
	15098	40240	5091
	15601	40049	5011
	16104	39887	4956
	16608	39754	4928
	17111	39641	4915
	17614	39543	4903
	18117	39464	4926
	18621	39389	4943
	19124	39317	4960
	19627	39242	4960
	20131	39166	4956
	20634	39084	4943
	21137	39004	4936
	21640	38923	4928
	22144	38846	4922
	22647	38771	4921
	23150	38698	4927
	23653	38631	4945
	24157	38566	4969
	24660	38506	4997
	25163	38449	5030
	25666	38393	5055
	26170	38340	5086
	26673	38293	5120
	27176	38245	5154
	27680	38198	5180
	28183	38155	5217
	28686	38116	5265
	29189	38077	5306
	29693	38038	5342
	30196	38004	5382
	30699	37972	5420
	31202	37945	5459
	31706	37920	5494
	32209	37898	5535
	32712	37882	5583
	33215	37868	5636
	33719	37853	5687
	34222	37837	5758
	34725	37821	5831
	35228	37806	5909
	35732	37790	5995
	36235	37773	6103
	36738	37753	6220
	37242	37731	6339
	37745	37708	6480
	38248	37680	6632
	38751	37649	6799
	39255	37613	6986
	39758	37573	7203
	40261	37529	7445
	40764	37480	7688
	41268	37427	7965
	41771	37368	8281
	42274	37304	8617
	42777	37237	9005
	43281	37166	9444
	43784	37096	9964
	44287	37033	10611
	44790	36981	11400
	45294	36939	12363
	45797	36903	13449
	46300	36863	14486
	46804	36809	15369
	47307	36721	16176
	47810	36551	16980
	48313	36231	17864
	48817	35712	19035
	49320	34985	19741
	49823	33882	17215
	>;
};
