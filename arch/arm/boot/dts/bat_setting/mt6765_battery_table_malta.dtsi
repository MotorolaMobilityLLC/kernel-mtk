&charger
{

	battery_cv = <4400000>;

	jeita_temp_above_t4_cv = <4200000>;
	jeita_temp_t3_to_t4_cv = <4200000>;
	jeita_temp_t2_to_t3_cv = <4400000>;
	jeita_temp_t1_to_t2_cv = <4400000>;
	jeita_temp_t0_to_t1_cv = <4400000>;
	jeita_temp_below_t0_cv = <4200000>;

	temp_t4_thres = <55>;
	temp_t4_thres_minus_x_degree = <52>;
	temp_t3_thres = <45>;
	temp_t3_thres_minus_x_degree = <39>;
	temp_t2_thres = <15>;
	temp_t2_thres_plus_x_degree = <18>;
	temp_t1_thres = <15>;
	temp_t1_thres_plus_x_degree = <18>;
	temp_t0_thres = <0>;
	temp_t0_thres_plus_x_degree = <2>;
	temp_neg_10_thres = <0>;

	/* battery temperature protection */
	enable_min_charge_temp;
	min_charge_temp= <0>;
	min_charge_temp_plus_x_degree = <2>;
	max_charge_temp = <55>;
	max_charge_temp_minus_x_degree = <52>;


       ac_charger_current = <2050000>;

};

&bat_gm30
{
	TEMPERATURE_T0 = <(50)>;	/*	Battery temperature T0*/
	TEMPERATURE_T1 = <(25)>;	/*	Battery temperature T1*/
	TEMPERATURE_T2 = <(0)>;	/*	Battery temperature T2*/
	TEMPERATURE_T3 = <(-10)>;	/*	Battery temperature T3*/
	g_FG_PSEUDO100_T0 = <(97)>;	/*	Pseudo 100% percentage at T0.*/
	g_FG_PSEUDO100_T1 = <(97)>;	/*	Pseudo 100% percentage at T1.*/
	g_FG_PSEUDO100_T2 = <(95)>;	/*	Pseudo 100% percentage at T2.*/
	g_FG_PSEUDO100_T3 = <(90)>;	/*	Pseudo 100% percentage at T3.*/

};


&bat_gm30
{
	battery_total_number =<2>;
	battery0_name ="KG50-SB18C77666-4000mah";
	
	battery0_profile_t0_num = <100>;
	battery0_profile_t0 =
	<
	0	43670	980
	404	43508	976
	808	43365	975
	1213	43228	975
	1617	43095	975
	2021	42974	976
	2425	42852	996
	2830	42731	1000
	3234	42610	1000
	3638	42489	1000
	4042	42367	998
	4447	42246	978
	4851	42132	993
	5255	42013	1000
	5659	41895	1000
	6064	41782	1000
	6468	41669	1000
	6872	41556	1000
	7276	41443	1014
	7681	41329	1016
	8085	41216	1000
	8489	41103	1000
	8893	41006	1020
	9298	40901	1040
	9702	40795	1050
	10106	40690	1044
	10510	40585	1026
	10915	40488	1046
	11319	40391	1050
	11723	40294	1062
	12127	40197	1075
	12532	40101	1075
	12936	40012	1075
	13340	39930	1093
	13744	39844	1100
	14148	39761	1116
	14553	39686	1150
	14957	39597	1150
	15361	39516	1150
	15765	39440	1178
	16170	39360	1209
	16574	39265	1212
	16978	39144	1152
	17382	39007	1072
	17787	38893	1035
	18191	38800	1015
	18595	38721	1000
	18999	38648	1000
	19404	38584	1000
	19808	38525	984
	20212	38473	986
	20616	38422	1000
	21021	38366	1000
	21425	38318	1000
	21829	38269	983
	22233	38226	987
	22638	38185	1000
	23042	38145	1000
	23446	38104	1000
	23850	38071	1018
	24255	38034	1025
	24659	37996	1033
	25063	37964	1050
	25467	37932	1050
	25872	37907	1069
	26276	37877	1075
	26680	37849	1084
	27084	37822	1100
	27488	37789	1100
	27893	37740	1079
	28297	37667	1027
	28701	37590	989
	29105	37525	981
	29510	37477	1001
	29914	37437	1022
	30318	37389	1008
	30722	37346	1000
	31127	37308	1007
	31531	37276	1028
	31935	37244	1048
	32339	37204	1050
	32744	37158	1050
	33148	37103	1042
	33552	37040	1029
	33956	36983	1049
	34361	36919	1050
	34765	36849	1022
	35169	36795	1000
	35573	36768	1005
	35978	36760	1025
	36382	36752	1105
	36786	36726	1156
	37190	36672	1196
	37595	36533	1202
	37999	36218	1126
	38403	35741	1146
	38807	35107	1215
	39212	34200	1331
	39616	32552	3122
	40020	28820	2050
	>;
	battery0_profile_t1_num = <100>;
	battery0_profile_t1 =
	<
	0	43580	1150
	404	43434	1150
	808	43301	1165
	1213	43176	1175
	1617	43053	1175
	2021	42924	1175
	2425	42802	1175
	2830	42681	1175
	3234	42564	1187
	3638	42449	1193
	4042	42327	1175
	4447	42206	1175
	4851	42092	1193
	5255	41979	1200
	5659	41862	1200
	6064	41742	1200
	6468	41629	1200
	6872	41516	1200
	7276	41408	1214
	7681	41299	1225
	8085	41188	1229
	8489	41083	1249
	8893	40978	1270
	9298	40871	1275
	9702	40773	1296
	10106	40682	1325
	10510	40585	1325
	10915	40480	1325
	11319	40368	1325
	11723	40259	1337
	12127	40157	1357
	12532	40060	1375
	12936	39963	1375
	13340	39880	1410
	13744	39794	1425
	14148	39718	1441
	14553	39657	1475
	14957	39577	1475
	15361	39496	1494
	15765	39409	1500
	16170	39313	1482
	16574	39205	1433
	16978	39084	1352
	17382	38962	1272
	17787	38859	1220
	18191	38770	1190
	18595	38693	1175
	18999	38629	1175
	19404	38572	1175
	19808	38509	1159
	20212	38453	1150
	20616	38405	1156
	21021	38356	1173
	21425	38308	1153
	21829	38266	1167
	22233	38226	1175
	22638	38185	1175
	23042	38146	1180
	23446	38114	1221
	23850	38074	1207
	24255	38039	1200
	24659	38010	1217
	25063	37984	1250
	25467	37952	1250
	25872	37927	1269
	26276	37897	1275
	26680	37869	1275
	27084	37844	1275
	27488	37819	1275
	27893	37787	1275
	28297	37748	1259
	28701	37708	1239
	29105	37667	1225
	29510	37627	1224
	29914	37587	1203
	30318	37546	1200
	30722	37506	1188
	31127	37468	1182
	31531	37436	1200
	31935	37404	1200
	32339	37364	1200
	32744	37313	1200
	33148	37256	1200
	33552	37200	1204
	33956	37143	1224
	34361	37079	1225
	34765	37003	1211
	35169	36945	1200
	35573	36916	1200
	35978	36900	1200
	36382	36892	1240
	36786	36872	1281
	37190	36831	1342
	37595	36708	1377
	37999	36407	1302
	38403	35922	1342
	38807	35287	1432
	39212	34370	1614
	39616	32797	4088
	40020	29270	3900
	>;
	battery0_profile_t2_num = <100>;
	battery0_profile_t2 =
	<
	0	43610	2000
	404	43464	2000
	808	43331	1985
	1213	43202	1986
	1617	43075	1994
	2021	42953	1975
	2425	42824	1975
	2830	42708	1959
	3234	42585	1950
	3638	42461	1950
	4042	42347	1950
	4447	42226	1950
	4851	42112	1950
	5255	41999	1963
	5659	41885	1983
	6064	41772	2000
	6468	41659	2000
	6872	41546	2000
	7276	41438	2014
	7681	41329	2025
	8085	41216	2029
	8489	41103	2049
	8893	40998	2050
	9298	40897	2065
	9702	40803	2096
	10106	40714	2142
	10510	40625	2202
	10915	40528	2242
	11319	40398	2234
	11723	40261	2225
	12127	40129	2232
	12532	40011	2250
	12936	39922	2250
	13340	39854	2285
	13744	39779	2287
	14148	39698	2275
	14553	39617	2275
	14957	39537	2275
	15361	39448	2256
	15765	39354	2222
	16170	39250	2164
	16574	39136	2083
	16978	39023	2002
	17382	38934	1980
	17787	38845	1960
	18191	38760	1920
	18595	38683	1880
	18999	38618	1900
	19404	38554	1879
	19808	38495	1875
	20212	38443	1886
	20616	38395	1900
	21021	38346	1900
	21425	38298	1900
	21829	38256	1917
	22233	38216	1937
	22638	38172	1935
	23042	38126	1908
	23446	38094	1968
	23850	38061	1975
	24255	38029	1988
	24659	37996	1992
	25063	37966	1986
	25467	37941	2047
	25872	37909	2031
	26276	37883	2054
	26680	37859	2075
	27084	37834	2070
	27488	37809	2050
	27893	37785	2071
	28297	37761	2075
	28701	37741	2086
	29105	37720	2094
	29510	37688	2075
	29914	37655	2075
	30318	37616	2058
	30722	37581	2062
	31127	37548	2082
	31531	37515	2103
	31935	37474	2123
	32339	37427	2143
	32744	37373	2150
	33148	37316	2158
	33552	37260	2182
	33956	37203	2223
	34361	37124	2225
	34765	37049	2225
	35169	36995	2234
	35573	36966	2269
	35978	36950	2350
	36382	36934	2430
	36786	36906	2496
	37190	36848	2609
	37595	36694	2748
	37999	36345	2835
	38403	35803	3058
	38807	35065	3411
	39212	33947	4270
	39616	31995	6905
	40020	29510	3950
	>;
	battery0_profile_t3_num = <100>;
	battery0_profile_t3 =
	<
	0	43720	3580
	404	43566	3576
	808	43425	3560
	1213	43292	3529
	1617	43163	3494
	2021	43034	3474
	2425	42912	3454
	2830	42791	3450
	3234	42670	3438
	3638	42551	3425
	4042	42437	3425
	4447	42316	3425
	4851	42195	3407
	5255	42079	3400
	5659	41965	3408
	6064	41852	3425
	6468	41739	3425
	6872	41624	3724
	7276	41514	3691
	7681	41406	3450
	8085	41294	3451
	8489	41188	3471
	8893	41083	3475
	9298	40978	3475
	9702	40879	3489
	10106	40791	3534
	10510	40710	3615
	10915	40615	3660
	11319	40492	3662
	11723	40345	3626
	12127	40186	3568
	12532	40040	3528
	12936	39925	3525
	13340	39828	3525
	13744	39746	3534
	14148	39670	3540
	14553	39589	3500
	14957	39500	3459
	15361	39412	3419
	15765	39323	3389
	16170	39231	3357
	16574	39135	3299
	16978	39046	3279
	17382	38950	3242
	17787	38863	3201
	18191	38785	3182
	18595	38713	3200
	18999	38648	3200
	19404	38583	3200
	19808	38524	3200
	20212	38467	3200
	20616	38412	3207
	21021	38364	3247
	21425	38315	3269
	21829	38267	3275
	22233	38222	3293
	22638	38181	3325
	23042	38141	3325
	23446	38108	3384
	23850	38070	3400
	24255	38034	3420
	24659	38001	3455
	25063	37969	3476
	25467	37937	3496
	25872	37911	3548
	26276	37886	3586
	26680	37862	3607
	27084	37839	3628
	27488	37822	3669
	27893	37806	3692
	28297	37790	3725
	28701	37774	3773
	29105	37757	3828
	29510	37732	3848
	29914	37708	3886
	30318	37679	3913
	30722	37646	3942
	31127	37614	3987
	31531	37582	4047
	31935	37541	4109
	32339	37494	4170
	32744	37441	4241
	33148	37385	4322
	33552	37328	4403
	33956	37272	4504
	34361	37209	4621
	34765	37131	4731
	35169	37052	4852
	35573	36998	5017
	35978	36974	5219
	36382	36949	5506
	36786	36920	5846
	37190	36879	6255
	37595	36802	6746
	37999	36591	7271
	38403	36142	7978
	38807	35531	9201
	39212	34684	11396
	39616	33497	13398
	40020	30410	6125
	>;
};
