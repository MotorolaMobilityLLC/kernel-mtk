
&bat_gm30
{
	battery1_name ="KG40-SB18C77667-4000mah";

	battery1_profile_t0_num = <100>;
	battery1_profile_t0 =
	<
	0	43670	980
	401	43510	976
	802	43367	975
	1204	43231	975
	1605	43099	975
	2006	42978	975
	2407	42858	995
	2808	42737	1000
	3210	42617	1000
	3611	42497	1000
	4012	42376	999
	4413	42256	979
	4815	42142	991
	5216	42025	1000
	5617	41907	1000
	6018	41795	1000
	6419	41683	1000
	6821	41570	1000
	7222	41458	1011
	7623	41346	1019
	8024	41233	1000
	8425	41121	1000
	8827	41022	1016
	9228	40920	1037
	9629	40814	1050
	10030	40710	1048
	10432	40605	1028
	10833	40508	1042
	11234	40411	1050
	11635	40315	1057
	12036	40219	1075
	12438	40123	1075
	12839	40033	1075
	13240	39950	1088
	13641	39867	1100
	14042	39781	1105
	14444	39708	1145
	14845	39622	1150
	15246	39539	1150
	15647	39462	1166
	16048	39387	1203
	16450	39299	1223
	16851	39182	1171
	17252	39051	1098
	17653	38928	1042
	18055	38827	1022
	18456	38747	1002
	18857	38674	1000
	19258	38607	1000
	19659	38546	992
	20061	38492	979
	20462	38443	999
	20863	38388	1000
	21264	38337	1000
	21665	38289	991
	22067	38242	979
	22468	38202	999
	22869	38162	1000
	23270	38122	1000
	23672	38085	1009
	24073	38052	1025
	24474	38012	1025
	24875	37979	1044
	25276	37947	1050
	25678	37919	1059
	26079	37893	1075
	26480	37861	1075
	26881	37837	1095
	27282	37806	1100
	27684	37766	1090
	28085	37709	1059
	28486	37629	1000
	28887	37557	980
	29288	37503	990
	29690	37459	1010
	30091	37417	1019
	30492	37369	1000
	30893	37329	1000
	31295	37295	1016
	31696	37263	1036
	32097	37228	1050
	32498	37188	1050
	32899	37140	1050
	33301	37079	1034
	33702	37019	1036
	34103	36960	1050
	34504	36896	1048
	34905	36823	1007
	35307	36784	1000
	35708	36765	1011
	36109	36757	1051
	36510	36748	1128
	36912	36715	1168
	37313	36650	1208
	37714	36442	1178
	38115	36081	1132
	38516	35590	1157
	38918	34924	1238
	39319	33912	1369
	39720	33480	1425
	>;
	battery1_profile_t1_num = <100>;
	battery1_profile_t1 =
	<
	0	43580	1150
	401	43436	1150
	802	43303	1165
	1204	43179	1175
	1605	43056	1175
	2006	42928	1175
	2407	42808	1175
	2808	42687	1175
	3210	42571	1185
	3611	42457	1194
	4012	42336	1175
	4413	42216	1175
	4815	42102	1191
	5216	41990	1200
	5617	41875	1200
	6018	41755	1200
	6419	41643	1200
	6821	41530	1200
	7222	41422	1211
	7623	41316	1225
	8024	41204	1226
	8425	41099	1246
	8827	40995	1266
	9228	40890	1275
	9629	40789	1289
	10030	40700	1325
	10432	40604	1325
	10833	40501	1325
	11234	40392	1325
	11635	40282	1332
	12036	40179	1352
	12438	40083	1372
	12839	39986	1375
	13240	39900	1400
	13641	39817	1425
	14042	39733	1430
	14444	39676	1470
	14845	39599	1475
	15246	39519	1488
	15647	39435	1500
	16048	39345	1494
	16450	39240	1454
	16851	39122	1378
	17252	39001	1298
	17653	38891	1234
	18055	38797	1197
	18456	38717	1177
	18857	38651	1175
	19258	38592	1175
	19659	38533	1167
	20061	38472	1150
	20462	38423	1150
	20863	38375	1169
	21264	38327	1161
	21665	38282	1159
	22067	38242	1175
	22468	38202	1175
	22869	38162	1175
	23270	38128	1203
	23672	38092	1216
	24073	38053	1200
	24474	38021	1200
	24875	37997	1239
	25276	37967	1250
	25678	37939	1259
	26079	37913	1275
	26480	37881	1275
	26881	37857	1275
	27282	37832	1275
	27684	37804	1275
	28085	37770	1270
	28486	37729	1250
	28887	37689	1230
	29288	37649	1225
	29690	37609	1215
	30091	37569	1200
	30492	37529	1199
	30893	37489	1179
	31295	37455	1191
	31696	37423	1200
	32097	37388	1200
	32498	37347	1200
	32899	37291	1200
	33301	37235	1200
	33702	37179	1211
	34103	37120	1225
	34504	37055	1224
	34905	36975	1204
	35307	36934	1200
	35708	36911	1200
	36109	36897	1213
	36510	36888	1253
	36912	36864	1293
	37313	36813	1367
	37714	36622	1353
	38115	36268	1314
	38516	35770	1359
	38918	35104	1459
	39319	34078	1678
	39720	33640	1775
	>;
	battery1_profile_t2_num = <100>;
	battery1_profile_t2 =
	<
	0	43720	3580
	401	43568	3576
	802	43427	3560
	1204	43295	3530
	1605	43166	3495
	2006	43038	3475
	2407	42918	3455
	2808	42797	3450
	3210	42677	3440
	3611	42559	3425
	4012	42446	3425
	4413	42326	3425
	4815	42206	3409
	5216	42090	3400
	5617	41977	3406
	6018	41865	3425
	6419	41753	3425
	6821	41638	3683
	7222	41528	3737
	7623	41422	3450
	8024	41310	3450
	8425	41205	3468
	8827	41101	3475
	9228	40996	3475
	9629	40895	3482
	10030	40807	3522
	10432	40726	3599
	10833	40635	3652
	11234	40521	3666
	11635	40380	3639
	12036	40219	3579
	12438	40074	3537
	12839	39952	3525
	13240	39850	3525
	13641	39765	3529
	14042	39691	3550
	14444	39611	3511
	14845	39525	3471
	15246	39437	3430
	15647	39349	3395
	16048	39260	3375
	16450	39164	3315
	16851	39074	3285
	17252	38981	3255
	17653	38889	3215
	18055	38809	3175
	18456	38737	3195
	18857	38671	3200
	19258	38607	3200
	19659	38545	3200
	20061	38489	3200
	20462	38432	3200
	20863	38382	3231
	21264	38334	3261
	21665	38286	3275
	22067	38238	3277
	22468	38198	3317
	22869	38158	3325
	23270	38122	3358
	23672	38088	3400
	24073	38048	3402
	24474	38016	3442
	24875	37984	3466
	25276	37952	3486
	25678	37922	3519
	26079	37898	3576
	26480	37874	3597
	26881	37850	3617
	27282	37831	3648
	27684	37815	3682
	28085	37799	3703
	28486	37783	3744
	28887	37767	3801
	29288	37746	3837
	29690	37722	3864
	30091	37697	3902
	30492	37665	3922
	30893	37633	3959
	31295	37600	4012
	31696	37565	4072
	32097	37523	4134
	32498	37475	4194
	32899	37420	4272
	33301	37364	4352
	33702	37307	4440
	34103	37250	4544
	34504	37186	4664
	34905	37100	4766
	35307	37033	4907
	35708	36990	5084
	36109	36966	5302
	36510	36942	5603
	36912	36910	5959
	37313	36862	6402
	37714	36740	6901
	38115	36481	7460
	38516	36008	8182
	38918	35346	9603
	39319	34398	12238
	39720	33810	13975
	>;
	battery1_profile_t3_num = <100>;
	battery1_profile_t3 =
	<
	0	43750	8300
	401	43565	8300
	802	43405	8224
	1204	43261	8185
	1605	43124	8184
	2006	42988	8124
	2407	42860	8044
	2808	42737	7994
	3210	42617	7996
	3611	42497	8008
	4012	42376	7949
	4413	42256	7909
	4815	42142	7931
	5216	42030	7918
	5617	41915	7863
	6018	41795	7828
	6419	41683	7888
	6821	41568	8372
	7222	41458	8426
	7623	41352	7803
	8024	41240	7823
	8425	41128	7715
	8827	41026	7662
	9228	40930	7658
	9629	40835	7699
	10030	40747	7840
	10432	40636	7739
	10833	40507	7659
	11234	40357	7573
	11635	40190	7471
	12036	40029	7451
	12438	39892	7488
	12839	39766	7388
	13240	39657	7354
	13641	39563	7429
	14042	39482	7327
	14444	39409	7266
	14845	39331	7265
	15246	39255	7304
	15647	39182	7360
	16048	39110	7400
	16450	39030	7280
	16851	38956	7220
	17252	38880	7210
	17653	38801	7246
	18055	38729	7324
	18456	38665	7264
	18857	38601	7250
	19258	38541	7323
	19659	38482	7392
	20061	38419	7279
	20462	38371	7440
	20863	38322	7506
	21264	38274	7482
	21665	38226	7465
	22067	38178	7604
	22468	38138	7704
	22869	38098	7693
	23270	38062	7686
	23672	38030	7718
	24073	37998	7777
	24474	37966	7817
	24875	37940	7874
	25276	37916	7968
	25678	37892	8076
	26079	37869	8160
	26480	37853	8301
	26881	37837	8391
	27282	37821	8425
	27684	37805	8498
	28085	37788	8697
	28486	37764	8656
	28887	37747	8836
	29288	37726	9020
	29690	37702	9139
	30091	37677	9193
	30492	37645	9374
	30893	37613	9623
	31295	37580	9774
	31696	37545	9929
	32097	37503	10218
	32498	37455	10519
	32899	37407	10730
	33301	37354	10930
	33702	37297	11260
	34103	37239	11766
	34504	37166	12187
	34905	37102	12590
	35307	37043	13058
	35708	36997	13669
	36109	36963	14421
	36510	36923	15123
	36912	36883	15639
	37313	36815	16114
	37714	36690	16688
	38115	36462	17414
	38516	36045	18156
	38918	35416	18543
	39319	34546	16390
	39720	33230	13125
	>;
};
