

&charger
{

	battery_cv = <4440000>;

	jeita_temp_above_t4_cv_voltage = <4100000>;
	jeita_temp_t3_to_t4_cv_voltage = <4100000>;
	jeita_temp_t2_to_t3_cv_voltage = <4440000>;
	jeita_temp_t1_to_t2_cv_voltage = <4440000>;
	jeita_temp_t0_to_t1_cv_voltage = <4440000>;
	jeita_temp_below_t0_cv_voltage = <4040000>;

#ifdef CONFIG_CHARGE_STOP_DEGREE55
	temp_t4_threshold = <55>;
	temp_t4_thres_minus_x_degree = <52>;
#else
	temp_t4_threshold = <50>;
	temp_t4_thres_minus_x_degree = <47>;
#endif
	temp_t3_threshold = <45>;
	temp_t3_thres_minus_x_degree = <39>;
	temp_t2_threshold = <15>;
	temp_t2_thres_plus_x_degree = <18>;
	temp_t1_threshold = <15>;
	temp_t1_thres_plus_x_degree = <18>;
	temp_t0_threshold = <0>;
	temp_t0_thres_plus_x_degree = <2>;
	temp_neg_10_threshold = <0>;


	/* battery temperature protection */
	enable_min_charge_temperature;
	min_charge_temperature = <0>;
	min_charge_temperature_plus_x_degree = <2>;
#ifdef CONFIG_CHARGE_STOP_DEGREE55
	max_charge_temperature = <55>;
	max_charge_temperature_minus_x_degree = <52>;
#else
	max_charge_temperature = <50>;
	max_charge_temperature_minus_x_degree = <47>;
#endif


       ac_charger_current = <2050000>;

};

&bat_gm30
{
	TEMPERATURE_T0 = <(50)>;	/*	Battery temperature T0*/
	TEMPERATURE_T1 = <(25)>;	/*	Battery temperature T1*/
	TEMPERATURE_T2 = <(0)>;	/*	Battery temperature T2*/
	TEMPERATURE_T3 = <(-10)>;	/*	Battery temperature T3*/
	g_FG_PSEUDO100_T0 = <(98)>;	/*	Pseudo 100% percentage at T0.*/
	g_FG_PSEUDO100_T1 = <(98)>;	/*	Pseudo 100% percentage at T1.*/
	g_FG_PSEUDO100_T2 = <(95)>;	/*	Pseudo 100% percentage at T2.*/
	g_FG_PSEUDO100_T3 = <(90)>;	/*	Pseudo 100% percentage at T3.*/

};


&bat_gm30
{
	battery_total_number =<1>;
	battery0_name ="515976PU-3920mAh";

	battery0_profile_t0_num = <100>;
	battery0_profile_t0 =
	<
	0	43843	2218
	405	43677	2218
	810	43523	2208
	1215	43383	2215
	1619	43252	2228
	2024	43121	2214
	2429	42991	2202
	2834	42868	2210
	3239	42748	2216
	3644	42628	2222
	4048	42508	2231
	4453	42387	2219
	4858	42271	2239
	5263	42155	2240
	5668	42040	2238
	6073	41923	2243
	6478	41803	2216
	6882	41692	2240
	7287	41582	2248
	7692	41474	2253
	8097	41365	2257
	8502	41251	2233
	8907	41145	2259
	9312	41039	2254
	9716	40931	2241
	10121	40824	2240
	10526	40723	2263
	10931	40618	2278
	11336	40521	2290
	11741	40425	2302
	12145	40328	2301
	12550	40229	2281
	12955	40138	2305
	13360	40048	2320
	13765	39961	2341
	14170	39875	2355
	14575	39789	2355
	14979	39699	2355
	15384	39613	2380
	15789	39532	2405
	16194	39447	2418
	16599	39354	2418
	17004	39253	2417
	17408	39127	2354
	17813	39006	2310
	18218	38902	2294
	18623	38815	2291
	19028	38735	2280
	19433	38670	2278
	19838	38604	2257
	20242	38545	2255
	20647	38490	2267
	21052	38436	2278
	21457	38385	2280
	21862	38335	2280
	22267	38288	2271
	22672	38245	2269
	23076	38204	2278
	23481	38159	2266
	23886	38123	2286
	24291	38081	2285
	24696	38041	2279
	25101	38005	2278
	25505	37971	2280
	25910	37941	2305
	26315	37910	2319
	26720	37880	2332
	27125	37848	2341
	27530	37813	2343
	27935	37778	2353
	28339	37714	2314
	28744	37637	2279
	29149	37562	2258
	29554	37501	2249
	29959	37460	2261
	30364	37415	2273
	30768	37367	2278
	31173	37321	2278
	31578	37282	2282
	31983	37246	2292
	32388	37212	2306
	32793	37166	2310
	33198	37110	2297
	33602	37051	2281
	34007	36996	2293
	34412	36931	2295
	34817	36858	2276
	35222	36799	2257
	35627	36765	2259
	36032	36754	2295
	36436	36745	2334
	36841	36730	2403
	37246	36697	2464
	37651	36587	2455
	38056	36337	2363
	38461	35911	2399
	38865	35325	2448
	39270	34511	2541
	39675	33176	3099
	40080	31665	4015
	>;
	battery0_profile_t1_num = <100>;
	battery0_profile_t1 =
	<
	0	43849	1628
	405	43638	1628
	810	43462	1591
	1215	43308	1554
	1619	43164	1531
	2024	43023	1517
	2429	42893	1505
	2834	42771	1503
	3239	42648	1496
	3644	42526	1492
	4048	42411	1504
	4453	42291	1489
	4858	42174	1488
	5263	42059	1496
	5668	41944	1504
	6073	41830	1503
	6478	41720	1505
	6882	41609	1527
	7287	41499	1535
	7692	41389	1546
	8097	41279	1567
	8502	41174	1580
	8907	41064	1570
	9312	40958	1576
	9716	40858	1588
	10121	40767	1604
	10526	40692	1628
	10931	40627	1679
	11336	40515	1670
	11741	40368	1644
	12145	40209	1632
	12550	40067	1647
	12955	39967	1671
	13360	39887	1685
	13765	39829	1720
	14170	39782	1761
	14575	39730	1783
	14979	39654	1783
	15384	39579	1805
	15789	39497	1821
	16194	39412	1828
	16599	39326	1828
	17004	39230	1814
	17408	39112	1743
	17813	38995	1660
	18218	38885	1579
	18623	38784	1512
	19028	38698	1473
	19433	38627	1435
	19838	38565	1425
	20242	38508	1419
	20647	38454	1410
	21052	38404	1409
	21457	38349	1385
	21862	38301	1380
	22267	38259	1380
	22672	38219	1384
	23076	38179	1397
	23481	38144	1421
	23886	38109	1427
	24291	38074	1426
	24696	38038	1426
	25101	38005	1431
	25505	37980	1455
	25910	37946	1458
	26315	37918	1458
	26720	37893	1463
	27125	37868	1477
	27530	37843	1489
	27935	37812	1488
	28339	37785	1496
	28744	37754	1498
	29149	37714	1484
	29554	37674	1458
	29959	37634	1446
	30364	37594	1433
	30768	37551	1420
	31173	37508	1414
	31578	37474	1428
	31983	37443	1438
	32388	37409	1451
	32793	37366	1464
	33198	37313	1473
	33602	37253	1473
	34007	37192	1473
	34412	37132	1483
	34817	37060	1489
	35222	36987	1489
	35627	36933	1489
	36032	36918	1504
	36436	36908	1527
	36841	36891	1559
	37246	36862	1596
	37651	36796	1625
	38056	36616	1613
	38461	36179	1613
	38865	35592	1674
	39270	34765	1792
	39675	33369	3579
	40080	30803	10618
	>;
	battery0_profile_t2_num = <100>;
	battery0_profile_t2 =
	<
	0	43861	3750
	405	43660	3750
	810	43498	3827
	1215	43342	3822
	1619	43193	3760
	2024	43072	3778
	2429	42942	3703
	2834	42819	3648
	3239	42699	3583
	3644	42582	3526
	4048	42471	3499
	4453	42350	3448
	4858	42247	3443
	5263	42140	3425
	5668	42029	3389
	6073	41921	3348
	6478	41821	3348
	6882	41701	3300
	7287	41595	3285
	7692	41494	3273
	8097	41392	3255
	8502	41282	3255
	8907	41181	3231
	9312	41088	3225
	9716	41008	3251
	10121	40938	3308
	10526	40867	3383
	10931	40766	3434
	11336	40615	3359
	11741	40436	3242
	12145	40260	3143
	12550	40112	3094
	12955	39981	3043
	13360	39887	3039
	13765	39797	3006
	14170	39714	2986
	14575	39646	3008
	14979	39586	3008
	15384	39516	2983
	15789	39431	2922
	16194	39341	2871
	16599	39253	2847
	17004	39173	2822
	17408	39073	2720
	17813	38995	2698
	18218	38920	2684
	18623	38843	2660
	19028	38773	2635
	19433	38712	2635
	19838	38652	2635
	20242	38598	2635
	20647	38548	2645
	21052	38496	2664
	21457	38436	2640
	21862	38394	2636
	22267	38353	2651
	22672	38313	2666
	23076	38275	2677
	23481	38245	2728
	23886	38205	2728
	24291	38172	2729
	24696	38137	2729
	25101	38100	2728
	25505	38070	2728
	25910	38049	2754
	26315	38022	2760
	26720	38003	2774
	27125	37990	2792
	27530	37970	2795
	27935	37960	2870
	28339	37942	2905
	28744	37928	2944
	29149	37914	2985
	29554	37892	3011
	29959	37862	3035
	30364	37823	3061
	30768	37790	3120
	31173	37759	3184
	31578	37727	3239
	31983	37688	3314
	32388	37647	3414
	32793	37593	3516
	33198	37532	3603
	33602	37472	3683
	34007	37412	3785
	34412	37341	3910
	34817	37271	4055
	35222	37200	4219
	35627	37140	4395
	36032	37101	4579
	36436	37070	4854
	36841	37040	5152
	37246	36997	5514
	37651	36921	5924
	38056	36773	6345
	38461	36452	6723
	38865	35923	7259
	39270	35182	8094
	39675	34010	9691
	40080	32713	11628
	>;
	battery0_profile_t3_num = <100>;
	battery0_profile_t3 =
	<
	0	43787	10835
	405	43530	10835
	810	43316	10863
	1215	43126	10854
	1619	42953	10798
	2024	42799	10723
	2429	42658	10646
	2834	42517	10551
	3239	42383	10466
	3644	42252	10382
	4048	42123	10284
	4453	42003	10209
	4858	41887	10121
	5263	41771	10041
	5668	41657	9961
	6073	41547	9879
	6478	41437	9816
	6882	41322	9730
	7287	41210	9652
	7692	41104	9588
	8097	41006	9538
	8502	40916	9487
	8907	40831	9475
	9312	40745	9482
	9716	40641	9446
	10121	40512	9355
	10526	40364	9225
	10931	40184	9024
	11336	40016	8846
	11741	39862	8700
	12145	39726	8588
	12550	39608	8502
	12955	39507	8439
	13360	39415	8409
	13765	39332	8384
	14170	39255	8370
	14575	39185	8366
	14979	39116	8341
	15384	39035	8315
	15789	38955	8271
	16194	38877	8233
	16599	38802	8206
	17004	38726	8167
	17408	38656	8155
	17813	38590	8154
	18218	38522	8141
	18623	38455	8119
	19028	38395	8108
	19433	38339	8120
	19838	38280	8123
	20242	38226	8123
	20647	38176	8127
	21052	38126	8141
	21457	38081	8165
	21862	38041	8180
	22267	38000	8201
	22672	37962	8226
	23076	37928	8252
	23481	37897	8276
	23886	37872	8324
	24291	37851	8375
	24696	37834	8439
	25101	37818	8517
	25505	37803	8604
	25910	37783	8680
	26315	37771	8784
	26720	37755	8882
	27125	37737	8982
	27530	37722	9109
	27935	37701	9235
	28339	37685	9391
	28744	37667	9547
	29149	37646	9703
	29554	37621	9872
	29959	37596	10072
	30364	37570	10273
	30768	37542	10489
	31173	37509	10720
	31578	37473	10961
	31983	37433	11212
	32388	37388	11486
	32793	37335	11753
	33198	37283	12053
	33602	37230	12384
	34007	37170	12686
	34412	37109	13024
	34817	37049	13373
	35222	36989	13711
	35627	36931	14037
	36032	36876	14364
	36436	36841	14704
	36841	36802	15020
	37246	36753	15334
	37651	36681	15654
	38056	36559	15968
	38461	36303	16207
	38865	35834	16568
	39270	35161	17163
	39675	34113	18143
	40080	32973	19220
	>;
};
