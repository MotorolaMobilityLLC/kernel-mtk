&charger
{

	battery_cv = <4400000>;

	jeita_temp_above_t4_cv_voltage = <4200000>;
	jeita_temp_t3_to_t4_cv_voltage = <4200000>;
	jeita_temp_t2_to_t3_cv_voltage = <4400000>;
	jeita_temp_t1_to_t2_cv_voltage = <4400000>;
	jeita_temp_t0_to_t1_cv_voltage = <4400000>;
	jeita_temp_below_t0_cv_voltage = <4200000>;

#ifdef CONFIG_CHARGE_STOP_DEGREE55
	temp_t4_threshold = <55>;
	temp_t4_thres_minus_x_degree = <52>;
#else
	temp_t4_threshold = <50>;
	temp_t4_thres_minus_x_degree = <47>;
#endif
	temp_t3_threshold = <45>;
	temp_t3_thres_minus_x_degree = <39>;
	temp_t2_threshold = <15>;
	temp_t2_thres_plus_x_degree = <18>;
	temp_t1_threshold = <15>;
	temp_t1_thres_plus_x_degree = <18>;
	temp_t0_threshold = <0>;
	temp_t0_thres_plus_x_degree = <2>;
	temp_neg_10_threshold = <0>;

	/* battery temperature protection */
	enable_min_charge_temperature;
	min_charge_temperature = <0>;
	min_charge_temperature_plus_x_degree = <2>;
#ifdef CONFIG_CHARGE_STOP_DEGREE55
	max_charge_temperature = <55>;
	max_charge_temperature_minus_x_degree = <52>;
#else
	max_charge_temperature = <50>;
	max_charge_temperature_minus_x_degree = <47>;
#endif


       ac_charger_current = <1050000>;

};

&bat_gm30
{
	TEMPERATURE_T0 = <(50)>;	/*	Battery temperature T0*/
	TEMPERATURE_T1 = <(25)>;	/*	Battery temperature T1*/
	TEMPERATURE_T2 = <(0)>;	/*	Battery temperature T2*/
	TEMPERATURE_T3 = <(-10)>;	/*	Battery temperature T3*/
	g_FG_PSEUDO100_T0 = <(97)>;	/*	Pseudo 100% percentage at T0.*/
	g_FG_PSEUDO100_T1 = <(97)>;	/*	Pseudo 100% percentage at T1.*/
	g_FG_PSEUDO100_T2 = <(95)>;	/*	Pseudo 100% percentage at T2.*/
	g_FG_PSEUDO100_T3 = <(90)>;	/*	Pseudo 100% percentage at T3.*/

};


&bat_gm30
{
	battery_total_number =<2>;
	battery0_name ="KS40-Sunwoda-2820mAh";
	battery1_name ="KS40-ATL-2820mAh";
	
	battery0_profile_t0_num = <100>;
	battery0_profile_t0 =
	<
	0	43370	1150
	307	43192	1150
	614	43032	1150
	920	42903	1150
	1227	42775	1139
	1534	42648	1127
	1841	42537	1142
	2147	42424	1165
	2454	42307	1195
	2761	42191	1187
	3068	42076	1178
	3374	41965	1194
	3681	41855	1200
	3988	41744	1200
	4295	41640	1215
	4602	41533	1220
	4908	41423	1205
	5215	41317	1222
	5522	41213	1251
	5829	41115	1266
	6135	41014	1275
	6442	40910	1275
	6749	40815	1325
	7056	40723	1383
	7362	40631	1429
	7669	40536	1458
	7976	40438	1474
	8283	40345	1503
	8589	40253	1543
	8896	40161	1604
	9203	40073	1645
	9510	39987	1675
	9817	39908	1691
	10123	39828	1712
	10430	39748	1743
	10737	39668	1774
	11044	39590	1802
	11350	39516	1818
	11657	39430	1801
	11964	39332	1755
	12271	39223	1669
	12577	39111	1565
	12884	38994	1427
	13191	38885	1337
	13498	38781	1275
	13805	38707	1229
	14111	38638	1206
	14418	38576	1221
	14725	38520	1225
	15032	38465	1225
	15338	38416	1225
	15645	38370	1240
	15952	38327	1270
	16259	38279	1262
	16565	38232	1253
	16872	38195	1269
	17179	38155	1284
	17486	38112	1299
	17793	38075	1315
	18099	38040	1330
	18406	38009	1345
	18713	37974	1350
	19020	37938	1350
	19326	37901	1350
	19633	37864	1350
	19940	37827	1350
	20247	37795	1362
	20553	37763	1375
	20860	37726	1375
	21167	37685	1375
	21474	37642	1375
	21781	37594	1375
	22087	37541	1360
	22394	37479	1314
	22701	37422	1321
	23008	37365	1348
	23314	37279	1318
	23621	37191	1313
	23928	37099	1344
	24235	36992	1313
	24541	36896	1272
	24848	36871	1257
	25155	36857	1275
	25462	36851	1321
	25768	36839	1367
	26075	36825	1430
	26382	36806	1537
	26689	36661	1575
	26996	36442	1576
	27302	35982	1653
	27609	35545	1789
	27916	35146	2019
	28223	34980	2273
	28529	34887	2539
	28836	34782	2846
	29143	34543	3084
	29450	34169	3253
	29756	33363	4354
	30063	32386	6773
	30370	30200	5900
	>;
	battery0_profile_t1_num = <100>;
	battery0_profile_t1 =
	<
	0	43450	1250
	307	43260	1250
	614	43029	1295
	920	42728	1418
	1227	42482	1666
	1534	42262	1942
	1841	42099	2099
	2147	41951	2199
	2454	41816	2245
	2761	41702	2291
	3068	41592	2329
	3374	41482	2344
	3681	41375	2379
	3988	41271	2425
	4295	41160	2425
	4602	41054	2436
	4908	40956	2467
	5215	40862	2498
	5522	40772	2530
	5829	40697	2577
	6135	40607	2608
	6442	40503	2623
	6749	40377	2652
	7056	40251	2683
	7362	40135	2713
	7669	40037	2734
	7976	39951	2750
	8283	39883	2795
	8589	39815	2831
	8896	39747	2846
	9203	39669	2850
	9510	39589	2848
	9817	39503	2833
	10123	39411	2802
	10430	39313	2756
	10737	39204	2670
	11044	39094	2581
	11350	38988	2503
	11657	38891	2445
	11964	38799	2399
	12271	38719	2353
	12577	38647	2331
	12884	38585	2346
	13191	38528	2350
	13498	38474	2352
	13805	38424	2368
	14111	38374	2383
	14418	38325	2398
	14725	38287	2441
	15032	38249	2479
	15338	38206	2494
	15645	38163	2500
	15952	38120	2500
	16259	38089	2547
	16565	38055	2581
	16872	38018	2597
	17179	37986	2612
	17486	37955	2632
	17793	37925	2678
	18099	37897	2708
	18406	37873	2723
	18713	37831	2725
	19020	37789	2721
	19326	37752	2705
	19633	37720	2720
	19940	37689	2750
	20247	37652	2766
	20553	37610	2775
	20860	37561	2775
	21167	37503	2775
	21474	37439	2777
	21781	37364	2793
	22087	37280	2792
	22394	37188	2776
	22701	37107	2775
	23008	37039	2771
	23314	37003	2755
	23621	36978	2800
	23928	36960	2878
	24235	36947	3001
	24541	36930	3162
	24848	36905	3381
	25155	36802	3609
	25462	36627	3787
	25768	36191	3710
	26075	35699	3642
	26382	35159	3581
	26689	34976	3854
	26996	34831	4255
	27302	34690	4899
	27609	34307	5613
	27916	33761	6521
	28223	32614	10315
	28529	30290	6100
	28836	30290	6100
	29143	30290	6100
	29450	30290	6100
	29756	30290	6100
	30063	30290	6100
	30370	30290	6100
	>;
	battery0_profile_t2_num = <100>;
	battery0_profile_t2 =
	<
	0	43430	1825
	307	43301	1825
	614	43177	1836
	920	43060	1867
	1227	42939	1886
	1534	42815	1903
	1841	42677	1935
	2147	42516	1958
	2454	42332	1973
	2761	42088	2151
	3068	41847	2409
	3374	41639	2838
	3681	41461	3201
	3988	41301	3523
	4295	41169	3665
	4602	41046	3768
	4908	40936	3814
	5215	40844	3860
	5522	40759	3910
	5829	40679	3987
	6135	40572	4025
	6442	40437	4025
	6749	40294	4066
	7056	40156	4104
	7362	40033	4120
	7669	39934	4155
	7976	39849	4201
	8283	39781	4231
	8589	39711	4250
	8896	39638	4250
	9203	39558	4238
	9510	39474	4218
	9817	39376	4172
	10123	39278	4125
	10430	39180	4079
	10737	39076	4020
	11044	38975	3967
	11350	38883	3936
	11657	38798	3915
	11964	38717	3901
	12271	38649	3916
	12577	38587	3931
	12884	38532	3947
	13191	38481	3986
	13498	38432	4030
	13805	38383	4060
	14111	38334	4091
	14418	38285	4122
	14725	38247	4152
	15032	38208	4187
	15338	38165	4234
	15645	38121	4271
	15952	38079	4301
	16259	38042	4332
	16565	38005	4369
	16872	37968	4415
	17179	37936	4461
	17486	37903	4502
	17793	37860	4518
	18099	37823	4550
	18406	37792	4596
	18713	37750	4614
	19020	37707	4643
	19326	37665	4704
	19633	37613	4745
	19940	37558	4777
	20247	37502	4823
	20553	37443	4877
	20860	37382	4938
	21167	37306	4950
	21474	37229	4958
	21781	37168	5004
	22087	37117	5067
	22394	37074	5144
	22701	37041	5279
	23008	37012	5448
	23314	36988	5678
	23621	36959	5982
	23928	36924	6319
	24235	36826	6641
	24541	36646	6878
	24848	36358	7000
	25155	35900	6950
	25462	35423	6903
	25768	35043	7041
	26075	34778	7582
	26382	34600	8426
	26689	34088	9601
	26996	33338	11090
	27302	31856	9758
	27609	30900	7375
	27916	30900	7375
	28223	30900	7375
	28529	30900	7375
	28836	30900	7375
	29143	30900	7375
	29450	30900	7375
	29756	30900	7375
	30063	30900	7375
	30370	30900	7375
	>;
	battery0_profile_t3_num = <100>;
	battery0_profile_t3 =
	<
	0	43350	3000
	307	43215	3000
	614	43085	3011
	920	42962	3042
	1227	42842	3062
	1534	42724	3075
	1841	42614	3075
	2147	42506	3091
	2454	42402	3121
	2761	42298	3166
	3068	42192	3204
	3374	42082	3219
	3681	41970	3245
	3988	41857	3275
	4295	41747	3291
	4602	41646	3349
	4908	41560	3471
	5215	41441	3606
	5522	41297	3758
	5829	41051	4004
	6135	40806	4482
	6442	40562	5186
	6749	40356	5780
	7056	40160	6311
	7362	39982	6710
	7669	39844	6930
	7976	39728	7051
	8283	39636	7097
	8589	39548	7162
	8896	39467	7255
	9203	39377	7287
	9510	39283	7295
	9817	39179	7264
	10123	39078	7250
	10430	38980	7250
	10737	38892	7264
	11044	38808	7279
	11350	38728	7295
	11657	38664	7340
	11964	38607	7401
	12271	38546	7432
	12577	38487	7482
	12884	38432	7559
	13191	38386	7635
	13498	38342	7710
	13805	38293	7771
	14111	38244	7849
	14418	38194	7943
	14725	38150	8021
	15032	38105	8098
	15338	38056	8175
	15645	38011	8262
	15952	37968	8353
	16259	37906	8430
	16565	37847	8513
	16872	37791	8607
	17179	37730	8700
	17486	37668	8789
	17793	37600	8866
	18099	37536	8968
	18406	37475	9090
	18713	37408	9185
	19020	37342	9305
	19326	37279	9493
	19633	37217	9710
	19940	37156	9941
	20247	37101	10186
	20553	37046	10458
	20860	36991	10765
	21167	36921	11084
	21474	36835	11405
	21781	36691	11718
	22087	36481	11939
	22394	36223	12092
	22701	35809	12115
	23008	35379	12218
	23314	34938	12509
	23621	34509	13413
	23928	34067	14495
	24235	33171	12991
	24541	31910	10050
	24848	31910	10050
	25155	31910	10050
	25462	31910	10050
	25768	31910	10050
	26075	31910	10050
	26382	31910	10050
	26689	31910	10050
	26996	31910	10050
	27302	31910	10050
	27609	31910	10050
	27916	31910	10050
	28223	31910	10050
	28529	31910	10050
	28836	31910	10050
	29143	31910	10050
	29450	31910	10050
	29756	31910	10050
	30063	31910	10050
	30370	31910	10050
	>;


	battery1_profile_t0_num = <100>;
	battery1_profile_t0 =
	<
	0	43650	1450
	303	43498	1450
	606	43357	1450
	909	43224	1447
	1212	43095	1440
	1516	42966	1440
	1819	42843	1445
	2122	42718	1447
	2425	42590	1441
	2728	42469	1448
	3031	42353	1450
	3334	42236	1453
	3637	42115	1462
	3940	41994	1477
	4244	41879	1474
	4547	41761	1474
	4850	41641	1480
	5153	41528	1480
	5456	41414	1480
	5759	41300	1484
	6062	41188	1493
	6365	41082	1508
	6668	40969	1510
	6972	40860	1514
	7275	40756	1520
	7578	40657	1520
	7881	40552	1534
	8184	40450	1549
	8487	40352	1558
	8790	40253	1550
	9093	40155	1557
	9396	40061	1570
	9699	39973	1582
	10003	39889	1590
	10306	39806	1605
	10609	39722	1620
	10912	39639	1638
	11215	39556	1661
	11518	39480	1684
	11821	39399	1701
	12124	39316	1716
	12427	39230	1727
	12731	39124	1697
	13034	39000	1626
	13337	38878	1553
	13640	38769	1498
	13943	38685	1483
	14246	38614	1468
	14549	38550	1460
	14852	38491	1460
	15155	38438	1460
	15459	38385	1466
	15762	38336	1466
	16065	38290	1463
	16368	38245	1478
	16671	38199	1480
	16974	38154	1484
	17277	38110	1492
	17580	38072	1500
	17883	38042	1507
	18187	38007	1515
	18490	37971	1522
	18793	37941	1530
	19096	37910	1537
	19399	37880	1550
	19702	37852	1560
	20005	37829	1560
	20308	37799	1575
	20611	37769	1585
	20915	37730	1573
	21218	37675	1527
	21521	37600	1474
	21824	37546	1466
	22127	37501	1470
	22430	37456	1471
	22733	37418	1478
	23036	37380	1474
	23339	37342	1474
	23642	37306	1481
	23946	37275	1489
	24249	37239	1496
	24552	37189	1496
	24855	37129	1489
	25158	37068	1481
	25461	37008	1493
	25764	36939	1500
	26067	36866	1491
	26370	36806	1454
	26674	36793	1471
	26977	36781	1498
	27280	36766	1532
	27583	36751	1578
	27886	36714	1645
	28189	36567	1627
	28492	36280	1594
	28795	35825	1640
	29098	35175	1722
	29402	34254	1918
	29705	33570	2080
	30008	33570	2080
	>;
	battery1_profile_t1_num = <100>;
	battery1_profile_t1 =
	<
	0	43800	1730
	303	43648	1730
	606	43507	1730
	909	43374	1725
	1212	43245	1711
	1516	43116	1726
	1819	42993	1735
	2122	42868	1737
	2425	42740	1730
	2728	42619	1730
	3031	42498	1742
	3334	42377	1750
	3637	42255	1752
	3940	42134	1767
	4244	42013	1764
	4547	41895	1760
	4850	41782	1761
	5153	41668	1769
	5456	41555	1783
	5759	41441	1798
	6062	41327	1812
	6365	41214	1819
	6668	41100	1833
	6972	40991	1840
	7275	40886	1845
	7578	40788	1868
	7881	40696	1898
	8184	40596	1928
	8487	40488	1950
	8790	40375	1950
	9093	40261	1972
	9396	40157	1980
	9699	40058	1987
	10003	39960	2010
	10306	39869	2018
	10609	39783	2025
	10912	39705	2041
	11215	39637	2070
	11518	39561	2078
	11821	39475	2080
	12124	39384	2068
	12427	39291	2035
	12731	39177	1966
	13034	39064	1892
	13337	38953	1817
	13640	38850	1745
	13943	38767	1708
	14246	38689	1682
	14549	38621	1670
	14852	38560	1670
	15155	38500	1670
	15459	38445	1664
	15762	38396	1660
	16065	38351	1662
	16368	38305	1669
	16671	38260	1677
	16974	38219	1684
	17277	38181	1692
	17580	38143	1699
	17883	38105	1700
	18187	38072	1705
	18490	38041	1710
	18793	38011	1710
	19096	37981	1717
	19399	37951	1715
	19702	37920	1712
	20005	37890	1720
	20308	37867	1728
	20611	37845	1735
	20915	37819	1737
	21218	37789	1729
	21521	37758	1714
	21824	37728	1694
	22127	37698	1674
	22430	37667	1659
	22733	37629	1652
	23036	37591	1644
	23339	37553	1640
	23642	37516	1641
	23946	37486	1648
	24249	37450	1656
	24552	37405	1660
	24855	37349	1659
	25158	37281	1651
	25461	37225	1663
	25764	37168	1674
	26067	37102	1677
	26370	37011	1662
	26674	36973	1667
	26977	36956	1687
	27280	36946	1721
	27583	36931	1766
	27886	36916	1819
	28189	36865	1876
	28492	36719	1907
	28795	36393	1862
	29098	35864	1940
	29402	35151	2086
	29705	34084	2469
	30008	32470	3280
	>;
	battery1_profile_t2_num = <100>;
	battery1_profile_t2 =
	<
	0	43900	4450
	303	43733	4450
	606	43587	4445
	909	43454	4432
	1212	43325	4408
	1516	43196	4363
	1819	43067	4312
	2122	42941	4271
	2425	42820	4248
	2728	42699	4225
	3031	42583	4203
	3334	42466	4180
	3637	42345	4158
	3940	42224	4143
	4244	42109	4128
	4547	41995	4120
	4850	41881	4119
	5153	41768	4111
	5456	41654	4110
	5759	41540	4110
	6062	41427	4110
	6365	41313	4110
	6668	41199	4103
	6972	41090	4096
	7275	40986	4090
	7578	40887	4090
	7881	40796	4139
	8184	40705	4206
	8487	40605	4262
	8790	40484	4270
	9093	40326	4197
	9396	40172	4140
	9699	40028	4098
	10003	39899	4060
	10306	39801	4045
	10609	39712	4019
	10912	39626	3978
	11215	39535	3916
	11518	39444	3840
	11821	39354	3792
	12124	39266	3761
	12427	39182	3737
	12731	39091	3699
	13034	39006	3667
	13337	38922	3640
	13640	38841	3618
	13943	38773	3603
	14246	38705	3600
	14549	38636	3596
	14852	38571	3591
	15155	38518	3599
	15459	38458	3606
	15762	38402	3622
	16065	38350	3640
	16368	38305	3640
	16671	38259	3660
	16974	38218	3674
	17277	38178	3686
	17580	38133	3709
	17883	38095	3731
	18187	38061	3754
	18490	38029	3772
	18793	37991	3780
	19096	37960	3802
	19399	37930	3825
	19702	37900	3843
	20005	37870	3851
	20308	37847	3881
	20611	37829	3901
	20915	37811	3913
	21218	37789	3923
	21521	37774	3968
	21824	37759	3997
	22127	37744	4026
	22430	37728	4064
	22733	37705	4102
	23036	37676	4140
	23339	37646	4181
	23642	37616	4229
	23946	37585	4289
	24249	37543	4356
	24552	37497	4428
	24855	37450	4504
	25158	37397	4580
	25461	37338	4682
	25764	37277	4796
	26067	37211	4919
	26370	37128	5048
	26674	37065	5218
	26977	37018	5427
	27280	36982	5690
	27583	36952	6031
	27886	36921	6473
	28189	36882	7048
	28492	36806	7769
	28795	36662	8648
	29098	36279	9841
	29402	35731	11953
	29705	34973	15232
	30008	34000	19720
	>;
	battery1_profile_t3_num = <100>;
	battery1_profile_t3 =
	<
	0	43930	9640
	303	43725	9640
	606	43552	9635
	909	43401	9605
	1212	43264	9536
	1516	43128	9445
	1819	42992	9365
	2122	42861	9283
	2425	42740	9194
	2728	42619	9118
	3031	42498	9031
	3334	42376	8946
	3637	42255	8871
	3940	42134	8795
	4244	42013	8725
	4547	41895	8657
	4850	41781	8589
	5153	41668	8521
	5456	41554	8459
	5759	41436	8398
	6062	41317	8338
	6365	41203	8277
	6668	41089	8216
	6972	40980	8173
	7275	40876	8150
	7578	40777	8150
	7881	40672	8143
	8184	40556	8108
	8487	40424	8039
	8790	40265	7933
	9093	40098	7805
	9396	39942	7696
	9699	39798	7613
	10003	39669	7560
	10306	39570	7537
	10609	39488	7530
	10912	39412	7519
	11215	39336	7488
	11518	39260	7450
	11821	39190	7434
	12124	39122	7427
	12427	39054	7418
	12731	38985	7395
	13034	38911	7378
	13337	38839	7370
	13640	38771	7370
	13943	38703	7370
	14246	38641	7382
	14549	38580	7394
	14852	38519	7407
	15155	38459	7445
	15459	38405	7482
	15762	38352	7512
	16065	38300	7537
	16368	38255	7567
	16671	38209	7597
	16974	38164	7632
	17277	38118	7672
	17580	38073	7717
	17883	38034	7748
	18187	37997	7783
	18490	37961	7824
	18793	37931	7869
	19096	37900	7929
	19399	37875	7990
	19702	37852	8053
	20005	37830	8122
	20308	37815	8205
	20611	37794	8299
	20915	37771	8392
	21218	37749	8477
	21521	37734	8591
	21824	37713	8693
	22127	37687	8801
	22430	37658	8924
	22733	37635	9060
	23036	37606	9215
	23339	37576	9381
	23642	37545	9556
	23946	37507	9738
	24249	37469	9957
	24552	37427	10200
	24855	37382	10466
	25158	37336	10769
	25461	37278	11105
	25764	37221	11500
	26067	37168	11967
	26370	37115	12528
	26674	37069	13212
	26977	37028	14025
	27280	36988	14946
	27583	36942	15939
	27886	36883	16931
	28189	36803	17857
	28492	36686	18802
	28795	36512	19879
	29098	36173	21674
	29402	36060	22270
	29705	36060	22270
	30008	36060	22270
	>;

};
