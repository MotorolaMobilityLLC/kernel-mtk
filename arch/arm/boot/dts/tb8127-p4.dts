/*
 * Copyright (c) 2015 MediaTek Inc.
 * Author: Erin Lo <erin.lo@mediatek.com>
 *
 * This program is free software; you can redistribute it and/or modify
 * it under the terms of the GNU General Public License as published by
 * the Free Software Foundation; either version 2 of the License.
 *
 * This program is distributed in the hope that it will be useful,
 * but WITHOUT ANY WARRANTY; without even the implied warranty of
 * MERCHANTABILITY or FITNESS FOR A PARTICULAR PURPOSE.  See the
 * GNU General Public License for more details.
 */

/dts-v1/;
#include "mt8127.dtsi"

/ {
	model = "MediaTek tb8127 Development Board";
	compatible = "mediatek,tb8127-p4","mediatek,mt8127";

	chosen {
		bootargs = "earlyprintk";
	};

	memory {
		reg = <0 0x80000000 0 0x40000000>;
	};
};

&uart0 {
	status = "okay";
};

