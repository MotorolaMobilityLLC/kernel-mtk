&memory_ssmr_features {
		compatible = "mediatek,memory-ssmr-features";
		svp-region-based-size = <0 0x0c000000>;
		iris-recognition-size = <0 0>;
		2d_fr-size = <0 0>;
		tui-size = <0 0>;
		wfd-size  = <0 0>;
		prot-region-based-size = <0 0>;
		ta-elf-size = <0 0>;
		ta-stack-heap-size = <0 0>;
		sdsp-tee-sharedmem-size = <0 0>;
		sdsp-firmware-size = <0 0>;
};
