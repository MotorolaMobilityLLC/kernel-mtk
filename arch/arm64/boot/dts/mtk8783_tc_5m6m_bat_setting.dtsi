/*************************
 * Customized Battery Setting dtsi file
*************************/
&bat_comm {
	/* cust_charging.h */

	/* Charging Current Setting */
	usb_charger_current = <50000>;	/* Unit: 0.01 mA */
	ac_charger_input_current = <200000>; /* Unit: 0.01 mA */
	ac_charger_current = <200000>;	/* Unit: 0.01 mA */
	non_std_ac_charger_current = <50000>;	/* Unit: 0.01 mA */
	charging_host_charger_current = <50000>;	/* Unit: 0.01 mA */

	/* charger error check */
	bat_low_temp_protect_enable = <0>;
	v_charger_enable = <0>;	/* 1:on , 0:off */
	v_charger_max = <6500>;	/* unit: mV */
	v_charger_min = <4400>;

	/*  Tracking TIME */
	onehundred_percent_tracking_time = <10>;	/* Unit: second */
	npercent_tracking_time = <20>;	/* Unit: second */
	sync_to_real_tracking_time = <60>;	/* Unit: second */
	v_0percent_tracking = <3450>;	/* Unit: mV */

	/* High battery support */
	high_battery_voltage_support = <0>;
};

&bat_meter {
	/* cust_battery_meter.h */
	/* ADC resistor  */
	r_bat_sense = <4>;
	r_i_sense = <4>;
	r_charger_1 = <330>;
	r_charger_2 = <39>;
	temperature_t0 = <110>;
	temperature_t1 = <0>;
	temperature_t2 = <25>;
	temperature_t3 = <50>;
	temperature_t = <255>;	/* this should be fixed, never change the value */
	fg_meter_resistance = <0>;

	/* Qmax for 0mA */
	q_max_pos_50 = <3812>;
	q_max_pos_25 = <3812>;
	q_max_pos_0 = <3812>;
	q_max_neg_10 = <3812>;
	/* Qmax for 400mA, said high current */
	q_max_pos_50_h_current = <3737>;
	q_max_pos_25_h_current = <3737>;
	q_max_pos_0_h_current = <3737>;
	q_max_neg_10_h_current = <3737>;
	/* Discharge percentage, 1: D5, 0: D2 */
	oam_d5 = <1>;

	change_tracking_point = <1>;
	/* SW OCV tracking setting */
	cust_tracking_point = <0>;
	cust_r_sense = <68>;
	cust_hw_cc = <0>;
	aging_tuning_value = <103>;
	cust_r_fg_offset = <0>;
	ocv_board_compesate = <0>;
	r_fg_board_base = <1000>;
	r_fg_board_slope = <1000>;
	car_tune_value = <86>;

	/* HW Fuel gague  */
	current_detect_r_fg = <10>;	/* Unit: mA */
	minerroroffset = <1000>;
	fg_vbat_average_size = <18>;
	r_fg_value = <10>;	/* Unit: mOhm */

	/* FG 2.0 */
	difference_hwocv_rtc = <30>;
	difference_hwocv_swocv = <10>;
	difference_swocv_rtc = <10>;
	max_swocv = <3>;

	difference_voltage_update = <20>;
	aging1_load_soc = <70>;
	aging1_update_soc = <30>;
	batterypseudo100 = <95>;
	batterypseudo1 = <4>;

	q_max_by_sys = <1>; /*Qmax varient by system drop voltage */
	q_max_sys_voltage = <3300>;
	shutdown_gauge0 = <1>;
	shutdown_gauge1_xmins = <1>;
	shutdown_gauge1_mins = <60>;

	shutdown_system_voltage = <3400>;
	charge_tracking_time = <60>;
	discharge_tracking_time = <10>;

	recharge_tolerance = <10>;

	/* FG 1.0 */
	cust_poweron_delta_capacity_tolrance = <40>;
	cust_poweron_low_capacity_tolrance = <5>;
	cust_poweron_max_vbat_tolrance = <90>;
	cust_poweron_delta_vbat_tolrance = <30>;
	cust_poweron_delta_hw_sw_ocv_capacity_tolrance = <10>;

	/* Fixed battery temperature */
	fixed_tbat_25 = <0>;

	/* Battery remove detecton */
	vbat_remove_detection = <0>;

	/* Dynamic change wake up period of battery thread when suspend */
	vbat_normal_wakeup = <3600>;	/* Unit: mV */
	vbat_low_power_wakeup = <3500>;	/* Unit: mV */
	normal_wakeup_period = <5400>;	/* Unit: second */
	low_power_wakeup_period = <300>;	/* Unit: second */
	close_poweroff_wakeup_period = <30>;	/* Unit: second */

	rbat_pull_up_r = <16900>;
	rbat_pull_up_volt = <1800>;

	batt_temperature_table_num = <17>;
	batt_temperature_table = <
		(-20) 68237
		(-15) 53650
		(-10) 42506
		(-5) 33892
		0 27219
		5 22021
		10 17926
		15 14674
		20 12081
		25 10000
		30 8315
		35 6948
		40 5834
		45 4917
		50 4161
		55 3535
		60 3014
	>;

	battery_profile_t0_num = <100>;
	battery_profile_t0 = <
		0   4183
		1   4159
		3   4141
		4   4126
		6   4111
		7   4096
		9   4083
		11  4072
		12  4061
		14  4046
		15  4030
		17  4015
		18  4002
		19  3992
		21  3982
		22  3974
		24  3965
		26  3954
		27  3945
		29  3936
		30  3927
		32  3918
		33  3910
		35  3902
		36  3896
		37  3889
		39  3881
		40  3873
		43  3866
		44  3856
		45  3845
		47  3833
		48  3822
		50  3813
		51  3806
		53  3800
		54  3795
		55  3791
		57  3788
		59  3785
		61  3782
		62  3780
		64  3779
		65  3778
		65  3778
		68  3777
		68  3777
		71  3776
		71  3776
		73  3775
		76  3773
		77  3772
		79  3769
		80  3765
		82  3761
		83  3756
		84  3750
		86  3744
		87  3738
		89  3731
		90  3720
		91  3706
		94  3689
		95  3670
		97  3643
		98  3613
		100 3584
		101 3560
		102 3538
		104 3512
		105 3453
		107 3361
		107 3313
		107 3304
		107 3299
		107 3297
		107 3296
		109 3295
		109 3294
		109 3295
		109 3294
		109 3294
		109 3294
		109 3293
		109 3293
		109 3293
		109 3293
		109 3293
		109 3293
		109 3293
		109 3293
		109 3293
		109 3293
		109 3293
		109 3293
		109 3293
		109 3293
		109 3293
		109 3293
		109 3293
	>;

	battery_profile_t1_num = <100>;
	battery_profile_t1 = <
		0   4183
		1   4159
		3   4141
		4   4126
		6   4111
		7   4096
		9   4083
		11  4072
		12  4061
		14  4046
		15  4030
		17  4015
		18  4002
		19  3992
		21  3982
		22  3974
		24  3965
		26  3954
		27  3945
		29  3936
		30  3927
		32  3918
		33  3910
		35  3902
		36  3896
		37  3889
		39  3881
		40  3873
		43  3866
		44  3856
		45  3845
		47  3833
		48  3822
		50  3813
		51  3806
		53  3800
		54  3795
		55  3791
		57  3788
		59  3785
		61  3782
		62  3780
		64  3779
		65  3778
		65  3778
		68  3777
		68  3777
		71  3776
		71  3776
		73  3775
		76  3773
		77  3772
		79  3769
		80  3765
		82  3761
		83  3756
		84  3750
		86  3744
		87  3738
		89  3731
		90  3720
		91  3706
		94  3689
		95  3670
		97  3643
		98  3613
		100 3584
		101 3560
		102 3538
		104 3512
		105 3453
		107 3361
		107 3313
		107 3304
		107 3299
		107 3297
		107 3296
		109 3295
		109 3294
		109 3295
		109 3294
		109 3294
		109 3294
		109 3293
		109 3293
		109 3293
		109 3293
		109 3293
		109 3293
		109 3293
		109 3293
		109 3293
		109 3293
		109 3293
		109 3293
		109 3293
		109 3293
		109 3293
		109 3293
		109 3293
	>;

	battery_profile_t2_num = <100>;
	battery_profile_t2 = <
		0   4183
		1   4159
		3   4141
		4   4126
		6   4111
		7   4096
		9   4083
		11  4072
		12  4061
		14  4046
		15  4030
		17  4015
		18  4002
		19  3992
		21  3982
		22  3974
		24  3965
		26  3954
		27  3945
		29  3936
		30  3927
		32  3918
		33  3910
		35  3902
		36  3896
		37  3889
		39  3881
		40  3873
		43  3866
		44  3856
		45  3845
		47  3833
		48  3822
		50  3813
		51  3806
		53  3800
		54  3795
		55  3791
		57  3788
		59  3785
		61  3782
		62  3780
		64  3779
		65  3778
		65  3778
		68  3777
		68  3777
		71  3776
		71  3776
		73  3775
		76  3773
		77  3772
		79  3769
		80  3765
		82  3761
		83  3756
		84  3750
		86  3744
		87  3738
		89  3731
		90  3720
		91  3706
		94  3689
		95  3670
		97  3643
		98  3613
		100 3584
		101 3560
		102 3538
		104 3512
		105 3453
		107 3361
		107 3313
		107 3304
		107 3299
		107 3297
		107 3296
		109 3295
		109 3294
		109 3295
		109 3294
		109 3294
		109 3294
		109 3293
		109 3293
		109 3293
		109 3293
		109 3293
		109 3293
		109 3293
		109 3293
		109 3293
		109 3293
		109 3293
		109 3293
		109 3293
		109 3293
		109 3293
		109 3293
		109 3293
	>;

	battery_profile_t3_num = <100>;
	battery_profile_t3 = <
		0   4183
		1   4159
		3   4141
		4   4126
		6   4111
		7   4096
		9   4083
		11  4072
		12  4061
		14  4046
		15  4030
		17  4015
		18  4002
		19  3992
		21  3982
		22  3974
		24  3965
		26  3954
		27  3945
		29  3936
		30  3927
		32  3918
		33  3910
		35  3902
		36  3896
		37  3889
		39  3881
		40  3873
		43  3866
		44  3856
		45  3845
		47  3833
		48  3822
		50  3813
		51  3806
		53  3800
		54  3795
		55  3791
		57  3788
		59  3785
		61  3782
		62  3780
		64  3779
		65  3778
		65  3778
		68  3777
		68  3777
		71  3776
		71  3776
		73  3775
		76  3773
		77  3772
		79  3769
		80  3765
		82  3761
		83  3756
		84  3750
		86  3744
		87  3738
		89  3731
		90  3720
		91  3706
		94  3689
		95  3670
		97  3643
		98  3613
		100 3584
		101 3560
		102 3538
		104 3512
		105 3453
		107 3361
		107 3313
		107 3304
		107 3299
		107 3297
		107 3296
		109 3295
		109 3294
		109 3295
		109 3294
		109 3294
		109 3294
		109 3293
		109 3293
		109 3293
		109 3293
		109 3293
		109 3293
		109 3293
		109 3293
		109 3293
		109 3293
		109 3293
		109 3293
		109 3293
		109 3293
		109 3293
		109 3293
		109 3293
	>;

	r_profile_t0_num = <100>;
	r_profile_t0 = <
		103 4183
		103 4159
		105 4141
		107 4126
		107 4111
		107 4096
		107 4083
		110 4072
		110 4061
		110 4046
		110 4030
		110 4015
		112 4002
		113 3992
		113 3982
		115 3974
		115 3965
		115 3954
		117 3945
		118 3936
		120 3927
		120 3918
		123 3910
		125 3902
		132 3896
		138 3889
		143 3881
		143 3873
		147 3866
		143 3856
		138 3845
		132 3833
		125 3822
		120 3813
		118 3806
		117 3800
		115 3795
		117 3791
		117 3788
		118 3785
		117 3782
		117 3780
		118 3779
		118 3778
		122 3778
		122 3777
		123 3777
		123 3776
		125 3776
		127 3775
		125 3773
		127 3772
		125 3769
		125 3765
		125 3761
		125 3756
		125 3750
		127 3744
		128 3738
		132 3731
		135 3720
		138 3706
		143 3689
		155 3670
		160 3643
		160 3613
		155 3584
		157 3560
		160 3538
		168 3512
		170 3453
		187 3361
		188 3313
		175 3304
		165 3299
		165 3297
		160 3296
		160 3295
		157 3294
		160 3295
		160 3294
		158 3294
		160 3294
		160 3293
		158 3293
		158 3293
		158 3293
		158 3293
		158 3293
		158 3293
		158 3293
		158 3293
		158 3293
		158 3293
		158 3293
		158 3293
		158 3293
		158 3293
		158 3293
		158 3293
	>;

	r_profile_t1_num = <100>;
	r_profile_t1 = <
		103 4183
		103 4159
		105 4141
		107 4126
		107 4111
		107 4096
		107 4083
		110 4072
		110 4061
		110 4046
		110 4030
		110 4015
		112 4002
		113 3992
		113 3982
		115 3974
		115 3965
		115 3954
		117 3945
		118 3936
		120 3927
		120 3918
		123 3910
		125 3902
		132 3896
		138 3889
		143 3881
		143 3873
		147 3866
		143 3856
		138 3845
		132 3833
		125 3822
		120 3813
		118 3806
		117 3800
		115 3795
		117 3791
		117 3788
		118 3785
		117 3782
		117 3780
		118 3779
		118 3778
		122 3778
		122 3777
		123 3777
		123 3776
		125 3776
		127 3775
		125 3773
		127 3772
		125 3769
		125 3765
		125 3761
		125 3756
		125 3750
		127 3744
		128 3738
		132 3731
		135 3720
		138 3706
		143 3689
		155 3670
		160 3643
		160 3613
		155 3584
		157 3560
		160 3538
		168 3512
		170 3453
		187 3361
		188 3313
		175 3304
		165 3299
		165 3297
		160 3296
		160 3295
		157 3294
		160 3295
		160 3294
		158 3294
		160 3294
		160 3293
		158 3293
		158 3293
		158 3293
		158 3293
		158 3293
		158 3293
		158 3293
		158 3293
		158 3293
		158 3293
		158 3293
		158 3293
		158 3293
		158 3293
		158 3293
		158 3293
	>;

	r_profile_t2_num = <100>;
	r_profile_t2 = <
		103 4183
		103 4159
		105 4141
		107 4126
		107 4111
		107 4096
		107 4083
		110 4072
		110 4061
		110 4046
		110 4030
		110 4015
		112 4002
		113 3992
		113 3982
		115 3974
		115 3965
		115 3954
		117 3945
		118 3936
		120 3927
		120 3918
		123 3910
		125 3902
		132 3896
		138 3889
		143 3881
		143 3873
		147 3866
		143 3856
		138 3845
		132 3833
		125 3822
		120 3813
		118 3806
		117 3800
		115 3795
		117 3791
		117 3788
		118 3785
		117 3782
		117 3780
		118 3779
		118 3778
		122 3778
		122 3777
		123 3777
		123 3776
		125 3776
		127 3775
		125 3773
		127 3772
		125 3769
		125 3765
		125 3761
		125 3756
		125 3750
		127 3744
		128 3738
		132 3731
		135 3720
		138 3706
		143 3689
		155 3670
		160 3643
		160 3613
		155 3584
		157 3560
		160 3538
		168 3512
		170 3453
		187 3361
		188 3313
		175 3304
		165 3299
		165 3297
		160 3296
		160 3295
		157 3294
		160 3295
		160 3294
		158 3294
		160 3294
		160 3293
		158 3293
		158 3293
		158 3293
		158 3293
		158 3293
		158 3293
		158 3293
		158 3293
		158 3293
		158 3293
		158 3293
		158 3293
		158 3293
		158 3293
		158 3293
		158 3293
	>;

	r_profile_t3_num = <100>;
	r_profile_t3 = <
		103 4183
		103 4159
		105 4141
		107 4126
		107 4111
		107 4096
		107 4083
		110 4072
		110 4061
		110 4046
		110 4030
		110 4015
		112 4002
		113 3992
		113 3982
		115 3974
		115 3965
		115 3954
		117 3945
		118 3936
		120 3927
		120 3918
		123 3910
		125 3902
		132 3896
		138 3889
		143 3881
		143 3873
		147 3866
		143 3856
		138 3845
		132 3833
		125 3822
		120 3813
		118 3806
		117 3800
		115 3795
		117 3791
		117 3788
		118 3785
		117 3782
		117 3780
		118 3779
		118 3778
		122 3778
		122 3777
		123 3777
		123 3776
		125 3776
		127 3775
		125 3773
		127 3772
		125 3769
		125 3765
		125 3761
		125 3756
		125 3750
		127 3744
		128 3738
		132 3731
		135 3720
		138 3706
		143 3689
		155 3670
		160 3643
		160 3613
		155 3584
		157 3560
		160 3538
		168 3512
		170 3453
		187 3361
		188 3313
		175 3304
		165 3299
		165 3297
		160 3296
		160 3295
		157 3294
		160 3295
		160 3294
		158 3294
		160 3294
		160 3293
		158 3293
		158 3293
		158 3293
		158 3293
		158 3293
		158 3293
		158 3293
		158 3293
		158 3293
		158 3293
		158 3293
		158 3293
		158 3293
		158 3293
		158 3293
		158 3293
	>;
};
