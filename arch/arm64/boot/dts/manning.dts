/dts-v1/;

#include "mt6797.dtsi"

/ {
	memory@40000000 {
		device_type = "memory";
		reg = <0 0x40000000 0 0x1e605000>;
	};

	/* chosen */
	chosen {
		bootargs = "console=tty0 console=ttyMT0,921600n1 root=/dev/ram initrd=0x44000000,0x4B434E loglevel=8";
		/* fpga may has no lk, we need to specify display info here */
		/* fb buffer is reserved using this dts by memory node above */
		atag,videolfb-fb_base_h = <0x0>;
		atag,videolfb-fb_base_l = <0x5e605000>;
		atag,videolfb-islcmfound = <1>;
		/* because no lk, so lcm is not inited */
		atag,videolfb-islcm_inited = <0>;
		atag,videolfb-fps= <6000>;
		atag,videolfb-vramSize= <0x017bb000>;
		atag,videolfb-lcmname= "otm1906b_fhd_dsi_cmd_jdi_tps65132_mt6797";
	};


	soc {
		compatible = "simple-bus";
		#address-cells = <1>;
		#size-cells = <1>;
		ranges = <0 0 0 0xffffffff>;

		i2c0@11007000 {
			bq24261@6b {
				compatible = "bq24261";
				reg = <0x6b>;
			};

			mt6306@64 {
				compatible = "mediatek,mt6306";
				reg = <0x64>;
			};
		};
		mmc0_pins_default: mmc0@default {
			pins_cmd {
				drive-strength = /bits/ 8 <1>;
			};
			pins_dat {
				drive-strength = /bits/ 8 <1>;
			};
			pins_clk {
				drive-strength = /bits/ 8 <1>;
			};
			pins_rst {
				drive-strength = /bits/ 8 <1>;
			};
			pins_ds {
				drive-strength = /bits/ 8 <1>;
			};
		};

		mmc0_register_setting_default: mmc0@register_default {
			dat0rddly      = /bits/ 8 <0>;
			dat1rddly      = /bits/ 8 <0>;
			dat2rddly      = /bits/ 8 <0>;
			dat3rddly      = /bits/ 8 <0>;
			dat4rddly      = /bits/ 8 <0>;
			dat5rddly      = /bits/ 8 <0>;
			dat6rddly      = /bits/ 8 <0>;
			dat7rddly      = /bits/ 8 <0>;
			datwrddly      = /bits/ 8 <0>;
			cmdrrddly      = /bits/ 8 <0>;
			cmdrddly       = /bits/ 8 <0>;
			cmd_edge = /bits/ 8 <MSDC_SMPL_FALLING>;
			rdata_edge = /bits/ 8 <MSDC_SMPL_FALLING>;
			wdata_edge = /bits/ 8 <MSDC_SMPL_FALLING>;
		};

		mmc1_pins_default: mmc1@default {
			   pins_cmd {
				   drive-strength = /bits/ 8 <6>;
			   };
			   pins_dat {
				   drive-strength = /bits/ 8 <6>;
			   };
			   pins_clk {
				   drive-strength = /bits/ 8 <6>;
			   };
		};

		mmc1_pins_sdr104: mmc1@sdr104 {
			  pins_cmd {
				  drive-strength = /bits/ 8 <3>;
			  };
			  pins_dat {
				  drive-strength = /bits/ 8 <3>;
			  };
			  pins_clk {
				  drive-strength = /bits/ 8 <4>;
			  };
		};

		mmc1_pins_sdr50: mmc1@sdr50 {
			 pins_cmd {
				 drive-strength = /bits/ 8 <3>;
			 };
			 pins_dat {
				 drive-strength = /bits/ 8 <3>;
			 };
			 pins_clk {
				 drive-strength = /bits/ 8 <4>;
			 };
		};

		mmc1_pins_ddr50: mmc1@ddr50 {
			 pins_cmd {
				 drive-strength = /bits/ 8 <3>;
			 };
			 pins_dat {
				 drive-strength = /bits/ 8 <3>;
			 };
			 pins_clk {
				 drive-strength = /bits/ 8 <4>;
			 };
		 };

		mmc1_register_setting_default: mmc1@register_default {
				       dat0rddly      = /bits/ 8 <0>;
				       dat1rddly      = /bits/ 8 <0>;
				       dat2rddly      = /bits/ 8 <0>;
				       dat3rddly      = /bits/ 8 <0>;
				       datwrddly      = /bits/ 8 <0>;
				       cmdrrddly      = /bits/ 8 <0>;
				       cmdrddly       = /bits/ 8 <0>;
				       cmd_edge = /bits/ 8 <MSDC_SMPL_FALLING>;
				       rdata_edge = /bits/ 8 <MSDC_SMPL_FALLING>;
				       wdata_edge = /bits/ 8 <MSDC_SMPL_FALLING>;
		};

	};

	led0:led@0 {
		compatible = "mediatek,red";
		led_mode = <3>;
		data = <1>;
		pwm_config = <0 0 0 0 0>;
	};
	led1:led@1 {
		compatible = "mediatek,green";
		led_mode = <0>;
		data = <1>;
		pwm_config = <0 0 0 0 0>;
	};
	led2:led@2 {
		compatible = "mediatek,blue";
		led_mode = <0>;
		data = <1>;
		pwm_config = <0 0 0 0 0>;
	};
	led3:led@3 {
		compatible = "mediatek,jogball-backlight";
		led_mode = <0>;
		data = <1>;
		pwm_config = <0 0 0 0 0>;
	};
	led4:led@4 {
		compatible = "mediatek,keyboard-backlight";
		led_mode = <0>;
		data = <1>;
		pwm_config = <0 0 0 0 0>;
	};
	led5:led@5 {
		compatible = "mediatek,button-backlight";
		led_mode = <0>;
		data = <1>;
		pwm_config = <0 0 0 0 0>;
	};
	led6:led@6 {
		compatible = "mediatek,lcd-backlight";
		led_mode = <5>;
		data = <1>;
		pwm_config = <0 0 0 0 0>;
	};
	vibrator0:vibrator@0 {
		compatible = "mediatek,vibrator";
		vib_timer = <25>;
		vib_limit = <9>;
		vib_vol= <5>;
	};
/* sensor standardization */
	cust_accel@0 {
		compatible				= "mediatek,icm20645g";
		i2c_num					= <1>;
		i2c_addr				= <0x68 0 0 0>;
		direction				= <3>;
		power_id				= <0xffff>;
		power_vol				= <0>;
		firlen					= <0>;
		is_batch_supported			= <0>;
	};
	cust_accel@1 {
		compatible 				= "mediatek,icm206xx_accel";
		i2c_num					= <1>;
		i2c_addr 				= <0x68 0 0 0>;
		direction 				= <5>;
		power_id 				= <0xffff>;
		power_vol 				= <0>;
		firlen 					= <16>;
		is_batch_supported 			= <0>;
	};

	cust_alsps@0 {
		compatible				= "mediatek,cm36558";
		i2c_num					= <1>;
		i2c_addr				= <0x51 0 0 0>;
		polling_mode_ps			= <0>;
		polling_mode_als		= <1>;
		power_id				= <0xffff>;
		power_vol				= <0>;
		als_level = <0 328 861 1377 3125 7721 7767 12621 23062 28430 33274 47116 57694 57694 65535>;
		als_value = <0 133 304 502 1004 2005 3058 5005 8008 10010 12000 16000 20000 20000 20000 20000>;
		ps_threshold_high		= <26>;
		ps_threshold_low		= <21>;
		is_batch_supported_ps	= <0>;
		is_batch_supported_als	= <0>;
	};

	cust_alsps@1 {
		compatible				= "mediatek,ltr578-new";
		i2c_num					= <1>;
		i2c_addr				= <0x53 0 0 0>;
		polling_mode_ps				= <0>;
		polling_mode_als			= <1>;
		power_id				= <0xffff>;
		power_vol				= <0>;
		als_level = <0 8 15 30 70 180 300 500 800 1200 3000 5000 10000 57694 65535>;
		als_value = <0 8 15 30 70 180 300 500 800 1200 3000 5000 10000 20000 30000 50000>;
		ps_threshold_high		=  <170>;
		ps_threshold_low		=  <50>;
		is_batch_supported_ps	= <0>;
		is_batch_supported_als	= <0>;
	};

	cust_mag@0 {
		compatible				= "mediatek,akm09912";
		i2c_num					= <1>;
		i2c_addr				= <0x0C 0 0 0>;
		direction				= <7>;
		power_id				= <0xffff>;
		power_vol				= <0>;
		is_batch_supported		= <0>;
	};

	cust_gyro@0 {
		compatible				= "mediatek,icm20645gy";
		i2c_num					= <1>;
		i2c_addr				= <0x69 0 0 0>;
		direction				= <3>;
		power_id				= <0xffff>;
		power_vol				= <0>;
		firlen					= <0>;
		is_batch_supported		= <0>;
	};

	cust_gyro@1 {
		compatible			= "mediatek,icm206xx_gyro";
		i2c_num				= <1>;
		i2c_addr			= <0x69 0 0 0>;
		direction			= <5>;
		power_id			= <0xffff>;
		power_vol			= <0>;
		firlen				= <0>;
		is_batch_supported		= <0>;
	};

	cust_baro@0 {
		compatible				= "mediatek,bmp280";
		i2c_num					= <1>;
		i2c_addr				= <0x77 0 0 0>;
		direction				= <0>;
		power_id				= <0xffff>;
		power_vol				= <0>;
		firlen					= <0>;
		is_batch_supported		= <0>;
	};

	cust_hmdy@0 {
		compatible				= "mediatek,hts221";
		i2c_num					= <1>;
		i2c_addr				= <0x5f 0 0 0>;
		direction				= <0>;
		power_id				= <0xffff>;
		power_vol				= <0>;
		firlen					= <0>;
		is_batch_supported		= <0>;
	};

	cust_smartpa@0 {
		compatible				= "mediatek,smart_pa";
		pinctrl-names = "smartpa_rst_low", "smartpa_rst_high";
		pinctrl-0 = <&smartpa_rst_low>;
		pinctrl-1 = <&smartpa_rst_high>;
		status = "okay";
	};
};
/* sensor gpio standization */
&pio {
	alsps_intpin_cfg: alspspincfg {

		pins_cmd_dat {
			pins = <PINMUX_GPIO88__FUNC_EINT11>;
			slew-rate = <0>;
			bias-pull-up = <00>;
		};
	};

	alsps_intpin_default: alspsdefaultcfg {

	};

	gyro_intpin_cfg: gyropincfg {

		pins_cmd_dat {
			pins = <PINMUX_GPIO63__FUNC_GPIO63>;
			slew-rate = <0>;
			bias-pull-down = <00>;
		};
	};

	gyro_intpin_default: gyrodefaultcfg {

	};
	sar_intpin_cfg: sarpincfg {
		pins_cmd_dat {
			pins = <PINMUX_GPIO85__FUNC_EINT8>;
			slew-rate = <0>;
			bias-pull-up = <00>;
		};
	};

	sar_intpin_default: sardefaultcfg {

	};

	smartpa_rst_low: smartpa_rst_low {
		pins_cmd_dat {
			pins = <PINMUX_GPIO39__FUNC_GPIO39>;
			slew-rate = <1>;
			output-low;
		};
	};

	smartpa_rst_high: smartpa_rst_high {
		pins_cmd_dat {
			pins = <PINMUX_GPIO39__FUNC_GPIO39>;
			slew-rate = <1>;
			output-high;
		};
	};
};
&als {
	pinctrl-names = "pin_default", "pin_cfg";
	pinctrl-0 = <&alsps_intpin_default>;
	pinctrl-1 = <&alsps_intpin_cfg>;
	status = "okay";

};

&gyro {
	pinctrl-names = "pin_default", "pin_cfg";
	pinctrl-0 = <&gyro_intpin_default>;
	pinctrl-1 = <&gyro_intpin_cfg>;
	status = "okay";

};

&sar_sensor {
	pinctrl-names = "pin_default", "pin_cfg";
	pinctrl-0 = <&sar_intpin_default>;
	pinctrl-1 = <&sar_intpin_cfg>;
	status = "okay";

};
/* sensor end */
&apuart0 {
	pinctrl-names = "uart0_gpio_default",
			"uart0_rx_set",
			"uart0_rx_clear",
			"uart0_tx_set",
			"uart0_tx_clear";

	pinctrl-0 = <&uart0_gpio_def_cfg>;
	pinctrl-1 = <&uart0_rx_set_cfg>;
	pinctrl-2 = <&uart0_rx_clr_cfg>;
	pinctrl-3 = <&uart0_tx_set_cfg>;
	pinctrl-4 = <&uart0_tx_clr_cfg>;
	status = "okay";
};

&apuart1 {
	pinctrl-names = "uart1_gpio_default",
			"uart1_rx_set",
			"uart1_rx_clear",
			"uart1_tx_set",
			"uart1_tx_clear";

	pinctrl-0 = <&uart1_gpio_def_cfg>;
	pinctrl-1 = <&uart1_rx_set_cfg>;
	pinctrl-2 = <&uart1_rx_clr_cfg>;
	pinctrl-3 = <&uart1_tx_set_cfg>;
	pinctrl-4 = <&uart1_tx_clr_cfg>;
	status = "okay";
};

&pio {
	/* UART GPIO Settings - Start */
	/* UART0: rx set, rx clear, tx clear, tx clear*/
	uart0_gpio_def_cfg:uart0gpiodefault {
	};
	uart0_rx_set_cfg:uart0_rx_set@gpio97 {
		pins_cmd_dat {
			pins = <PINMUX_GPIO97__FUNC_URXD0>;
		};
	};
	uart0_rx_clr_cfg:uart0_rx_clear@gpio97  {
		pins_cmd_dat {
			pins = <PINMUX_GPIO97__FUNC_GPIO97>;
			slew-rate = <1>;
			output-high;
		};
	};
	uart0_tx_set_cfg:uart0_tx_set@gpio98  {
		pins_cmd_dat {
			pins = <PINMUX_GPIO98__FUNC_UTXD0>;
		};
	};
	uart0_tx_clr_cfg:uart0_tx_clear@gpio98  {
		pins_cmd_dat {
			pins = <PINMUX_GPIO98__FUNC_GPIO98>;
			slew-rate = <1>;
			output-high;
		};
	};
	/* UART1: rx set, rx clear, tx clear, tx clear*/
	uart1_gpio_def_cfg:uart1gpiodefault {
	};
	uart1_rx_set_cfg:uart1_rx_set@gpio232 {
		pins_cmd_dat {
			pins = <PINMUX_GPIO232__FUNC_URXD1>;
		};
	};
	uart1_rx_clr_cfg:uart1_rx_clear@gpio232 {
		pins_cmd_dat {
			pins = <PINMUX_GPIO232__FUNC_GPIO232>;
			slew-rate = <1>;
			output-high;
		};
	};
	uart1_tx_set_cfg:uart1_tx_set@gpio233 {
		pins_cmd_dat {
			pins = <PINMUX_GPIO233__FUNC_UTXD1>;
		};
	};
	uart1_tx_clr_cfg:uart1_tx_clear@gpio233 {
		pins_cmd_dat {
			pins = <PINMUX_GPIO233__FUNC_GPIO233>;
			slew-rate = <1>;
			output-high;
		};
	};
	/* UART GPIO Settings - End */
};


/* FINGERPRINT start */
&spi1 {
	#address-cells = <1>;
	#size-cells = <0>;

	fingerprint@0 {
		compatible = "goodix,goodix-fp";
		reg = <0>;
		spi-max-frequency = <8000000>;
		status = "okay";
	};
};

&goodix_fp {
	pinctrl-names = "fingerprint_irq", "miso_spi", "miso_pullhigh", "miso_pulllow", "reset_high", "reset_low";
	pinctrl-0 = <&fingerprint_irq>;
	pinctrl-1 = <&fingerprint_miso_spi>;
	pinctrl-2 = <&fingerprint_miso_pullhigh>;
	pinctrl-3 = <&fingerprint_miso_pulllow>;
	pinctrl-4 = <&fingerprint_reset_high>;
	pinctrl-5 = <&fingerprint_reset_low>;
	status = "okay";
};

&pio {
	fingerprint_irq: fingerprint_irq {
		pins_cmd_dat {
			pins = <PINMUX_GPIO86__FUNC_EINT9>;
			slew-rate = <0>;
			bias-disable;
		};
	};

	fingerprint_miso_spi: state_miso_spi {
		pins_cmd_dat {
			pins = <PINMUX_GPIO235__FUNC_SPI1_MI_B>;
		};
	};

	fingerprint_miso_pullhigh: state_miso_pullhigh {
		pins_cmd_dat {
			pins = <PINMUX_GPIO235__FUNC_GPIO235>;
			slew-rate = <1>;
			output-high;
		};
	};

	fingerprint_miso_pulllow: state_miso_pulllow {
		pins_cmd_dat {
			pins = <PINMUX_GPIO235__FUNC_GPIO235>;
			slew-rate = <1>;
			output-low;
		};
	};

	fingerprint_reset_high: state_reset_high {
		pins_cmd_dat {
			pins = <PINMUX_GPIO253__FUNC_GPIO253>;
			slew-rate = <1>;
			output-high;
		};
	};

	fingerprint_reset_low: state_reset_low {
		pins_cmd_dat {
			pins = <PINMUX_GPIO253__FUNC_GPIO253>;
			slew-rate = <1>;
			output-low;
		};
	};
};
/* FINGERPRINT end */

/* NFC GPIO standardization */
&pio {
	nfc_default: default {

	};

	nfc_ven_high: state_ven_high {
		pins_cmd_dat {
			pins = <PINMUX_GPIO60__FUNC_GPIO60>;
			slew-rate = <1>;
			output-high;
		};
	};

	nfc_ven_low: state_ven_low {
		pins_cmd_dat {
			pins = <PINMUX_GPIO60__FUNC_GPIO60>;
			slew-rate = <1>;
			output-low;
		};
	};

	nfc_rst_high: state_rst_high {
		pins_cmd_dat {
			pins = <PINMUX_GPIO59__FUNC_GPIO59>;
			slew-rate = <1>;
			output-high;
		};
	};

	nfc_rst_low: state_rst_low {
		pins_cmd_dat {
			pins = <PINMUX_GPIO59__FUNC_GPIO59>;
			slew-rate = <1>;
			output-low;
		};
	};

	nfc_eint_high: state_eint_high {
		pins_cmd_dat {
			pins = <PINMUX_GPIO57__FUNC_GPIO57>;
			slew-rate = <1>;
			output-high;
		};
	};

	nfc_eint_low: state_eint_low {
		pins_cmd_dat {
			pins = <PINMUX_GPIO57__FUNC_GPIO57>;
			slew-rate = <1>;
			output-low;
		};
	};

	nfc_irq_init: state_irq_init {
		pins_cmd_dat {
			pins = <PINMUX_GPIO58__FUNC_GPIO58>;
			slew-rate = <0>;
			bias-pull-down = <00>;
		};
	};

	nfc_osc_init: state_osc_init {
		pins_cmd_dat {
			pins = <PINMUX_GPIO100__FUNC_GPIO100>;
			slew-rate = <1>;
			bias-pull-down = <00>;
		};
	};

	spi_cs_low: state_cs_low {
		pins_cmd_dat {
			pins = <PINMUX_GPIO245__FUNC_GPIO245>;
			slew-rate = <1>;
			output-low;
			input-disable;
		};
	};

	spi_mo_low: state_mo_low {
		pins_cmd_dat {
			pins = <PINMUX_GPIO244__FUNC_GPIO244>;
			slew-rate = <1>;
			output-low;
			input-disable;
		};
	};

	spi_mi_low: state_mi_low {
		pins_cmd_dat {
			pins = <PINMUX_GPIO243__FUNC_GPIO243>;
			slew-rate = <1>;
			output-low;
			input-disable;
		};
	};

	spi_sck_low: state_sck_low {
		pins_cmd_dat {
			pins = <PINMUX_GPIO242__FUNC_GPIO242>;
			slew-rate = <1>;
			output-low;
			input-disable;
		};
	};
};

&nfc {
	pinctrl-names = "default", "ven_high", "ven_low", "rst_high", "rst_low",
	"eint_high", "eint_low", "irq_init", "osc_init", "cs_low", "mo_low",
	"mi_low", "sck_low";
	pinctrl-0 = <&nfc_default>;
	pinctrl-1 = <&nfc_ven_high>;
	pinctrl-2 = <&nfc_ven_low>;
	pinctrl-3 = <&nfc_rst_high>;
	pinctrl-4 = <&nfc_rst_low>;
	pinctrl-5 = <&nfc_eint_high>;
	pinctrl-6 = <&nfc_eint_low>;
	pinctrl-7 = <&nfc_irq_init>;
	pinctrl-8 = <&nfc_osc_init>;
	pinctrl-9 = <&spi_cs_low>;
	pinctrl-10 = <&spi_mo_low>;
	pinctrl-11 = <&spi_mi_low>;
	pinctrl-12 = <&spi_sck_low>;
	status = "okay";
};
/* NFC end */

&touch {
	tpd-resolution = <1080 1920>;
	use-tpd-button = <1>;
	tpd-key-num = <3>;
	tpd-key-local= <158 172 139 0>;
	tpd-key-dim-local = <160 2030 100 40 360 2030 100 40 570 2030 100 40 0 0 0 0>;
	tpd-max-touch-num = <5>;
	tpd-filter-enable = <1>;
	tpd-filter-pixel-density = <144>;
	tpd-filter-custom-prameters = <0 0 0 0 0 0 0 0 0 0 0 0>;
	tpd-filter-custom-speed = <0 0 0>;
	pinctrl-names = "default", "state_eint_as_int", "state_eint_output0", "state_eint_output1",
		"state_rst_output0", "state_rst_output1", "state_power_output0","state_power_output1";
	pinctrl-0 = <&ctp_pins_default>;
	pinctrl-1 = <&ctp_pins_eint_as_int>;
	pinctrl-2 = <&ctp_pins_eint_output0>;
	pinctrl-3 = <&ctp_pins_eint_output1>;
	pinctrl-4 = <&ctp_pins_rst_output0>;
	pinctrl-5 = <&ctp_pins_rst_output1>;
	pinctrl-6 = <&ctp_pins_power_output0>;
	pinctrl-7 = <&ctp_pins_power_output1>;
	status = "okay";
};
&pio {
	ctp_pins_default: eint0default {
	};
	ctp_pins_eint_as_int: eint@0 {
		pins_cmd_dat {
			pins = <PINMUX_GPIO68__FUNC_EINT7>;
			slew-rate = <0>;
			bias-disable;
		};
	};
	ctp_pins_eint_output0: eintoutput0 {
		pins_cmd_dat {
			pins = <PINMUX_GPIO68__FUNC_GPIO68>;
			slew-rate = <1>;
			output-low;
		};
	};
	ctp_pins_eint_output1: eintoutput1 {
		pins_cmd_dat {
			pins = <PINMUX_GPIO68__FUNC_GPIO68>;
			slew-rate = <1>;
			output-high;
		};
	};
	ctp_pins_rst_output0: rstoutput0 {
		pins_cmd_dat {
			pins = <PINMUX_GPIO242__FUNC_GPIO242>;
			slew-rate = <1>;
			output-low;
		};
	};
	ctp_pins_rst_output1: rstoutput1 {
		pins_cmd_dat {
			pins = <PINMUX_GPIO242__FUNC_GPIO242>;
			slew-rate = <1>;
			output-high;
		};
	};
	ctp_pins_power_output0: poweroutput0 {
		pins_cmd_dat {
			pins = <PINMUX_GPIO50__FUNC_GPIO50>;
			slew-rate = <1>;
			output-low;
		};
	};
	ctp_pins_power_output1: poweroutput1 {
		pins_cmd_dat {
			pins = <PINMUX_GPIO50__FUNC_GPIO50>;
			slew-rate = <1>;
			output-high;
		};
	};
};
/* TOUCH end */
&accdet {
		accdet-mic-vol = <7>;
		headset-mode-setting = <0x500 0x500 1 0x1F0 0x800 0x800 0x20>;
		accdet-plugout-debounce = <1>;
		/*1:ACC mode, 2:low cost without in bias, 6:low cost with in bias*/
		accdet-mic-mode = <1>;
		/*0--MD_MAX--UP_MAX--DW_MAX*/
		headset-three-key-threshold = <0 80 150 400>;
		/*0--MD_MAX--VOICE_MAX--UP_MAX--DW_MAX*/
		headset-four-key-threshold = <0 58 121 192 400>;
		/* ACCDET GPIO standardization ACC mode use */
		pinctrl-names = "default", "state_eint_as_int";
		pinctrl-0 = <&accdet_pins_default>;
		pinctrl-1 = <&accdet_pins_eint_as_int>;
		status = "okay";
};
&pio {
	accdet_pins_default: accdetdefault {
	};
	accdet_pins_eint_as_int: accdeteint@0 {
		pins_cmd_dat {
			pins = <PINMUX_GPIO92__FUNC_EINT15>;
			slew-rate = <0>;
			bias-disable;
		};
	};
};
/*ACCDET end*/
/* mmc start */
&mmc0 {
		clk_src = /bits/ 8 <MSDC0_CLKSRC_400MHZ>;
		bus-width = <8>;
		max-frequency = <200000000>;
		cap-mmc-highspeed;
		msdc-sys-suspend;
		mmc-ddr-1_8v;
		mmc-hs200-1_8v;
		mmc-hs400-1_8v;
		non-removable;
		pinctl = <&mmc0_pins_default>;
		register_setting = <&mmc0_register_setting_default>;
		host_function = /bits/ 8 <MSDC_EMMC>;
		bootable;
		status = "okay";
};

&mmc1 {
		clk_src = /bits/ 8 <MSDC1_CLKSRC_200MHZ>;
		bus-width = <4>;
		max-frequency = <200000000>;
		msdc-sys-suspend;
		cap-sd-highspeed;
		sd-uhs-sdr12;
		sd-uhs-sdr25;
		sd-uhs-sdr50;
		sd-uhs-sdr104;
		/* sd-uhs-ddr50; */
		pinctrl-names = "default","insert_cfg","power_output0","power_output1";
		pinctrl-0 = <&mmc1_pins_insert_default>;
		pinctrl-1 = <&mmc1_pins_insert_cfg>;
		pinctrl-2 = <&mmc1_pins_power_output0>;
		pinctrl-3 = <&mmc1_pins_power_output1>;

		pinctl = <&mmc1_pins_default>;
		pinctl_sdr104 = <&mmc1_pins_sdr104>;
		pinctl_sdr50 = <&mmc1_pins_sdr50>;
		pinctl_ddr50 = <&mmc1_pins_ddr50>;
		register_setting = <&mmc1_register_setting_default>;
		host_function = /bits/ 8 <MSDC_SD>;
		cd_level = /bits/ 8 <MSDC_CD_LOW>;
		cd-gpios = <&pio 87 0>;
		status = "okay";
};

&pio {
	mmc1_pins_insert_default: mmc1_ins_default {
	};
	mmc1_pins_insert_cfg: mmc1_ins_cfg {
		pins_insert {
			pins = <PINMUX_GPIO87__FUNC_EINT10>;
			input-schmitt-enable =<1>;
			slew-rate = <0>;
			bias-pull-up =<00>;
		};
	};
	mmc1_pins_power_output0: mmc1_power_output0 {
		pins_cmd_dat {
			pins = <PINMUX_GPIO40__FUNC_GPIO40>;
			slew-rate = <1>;
			output-low;
		};
	};
	mmc1_pins_power_output1: mmc1_power_output1 {
		pins_cmd_dat {
			pins = <PINMUX_GPIO40__FUNC_GPIO40>;
			slew-rate = <1>;
			output-high;
		};
	};
};
/* AUDIO GPIO standardization */
&audgpio {
	pinctrl-names = "aud_clk_mosi_off",
			"aud_clk_mosi_on",
			"aud_smartpa_mode0",
			"aud_smartpa_mode1",
			"aud_smartpa_mode3",
			"aud_tdm_mode0",
			"aud_tdm_mode1",
			"hpdepop-pullhigh",
			"hpdepop-pulllow",
			"aud_dat_miso_off",
			"aud_dat_miso_on",
			"aud_dat_mosi_off",
			"aud_dat_mosi_on",
			"vow_dat_miso_off",
			"vow_dat_miso_on",
			"vow_clk_miso_off",
			"vow_clk_miso_on",
			"anc_dat_mosi_off",
			"anc_dat_mosi_on",
			"hpdepop-pullhigh_e2",
			"hpdepop-pulllow_e2";
	pinctrl-0 = <&aud_clk_mosi_off>;
	pinctrl-1 = <&aud_clk_mosi_on>;
	pinctrl-2 = <&aud_pins_smartpa_mode0>;
	pinctrl-3 = <&aud_pins_smartpa_mode1>;
	pinctrl-4 = <&aud_pins_smartpa_mode3>;
	pinctrl-5 = <&aud_pins_tdm_mode0>;
	pinctrl-6 = <&aud_pins_tdm_mode1>;
	pinctrl-7 = <&aud_pins_hpdepop_high>;
	pinctrl-8 = <&aud_pins_hpdepop_low>;
	pinctrl-9 = <&aud_dat_miso_off>;
	pinctrl-10 = <&aud_dat_miso_on>;
	pinctrl-11 = <&aud_dat_mosi_off>;
	pinctrl-12 = <&aud_dat_mosi_on>;
	pinctrl-13 = <&vow_dat_miso_off>;
	pinctrl-14 = <&vow_dat_miso_on>;
	pinctrl-15 = <&vow_clk_miso_off>;
	pinctrl-16 = <&vow_clk_miso_on>;
	pinctrl-17 = <&anc_dat_mosi_off>;
	pinctrl-18 = <&anc_dat_mosi_on>;
	pinctrl-19 = <&aud_pins_hpdepop_high_e2>;
	pinctrl-20 = <&aud_pins_hpdepop_low_e2>;
	status = "okay";
};

&pio {
	aud_clk_mosi_off: aud_clk_mosi_off {
		pins_cmd0_dat {
			pins = <PINMUX_GPIO146__FUNC_GPIO146>;
		};
	};

	aud_clk_mosi_on: aud_clk_mosi_on {
		pins_cmd0_dat {
			pins = <PINMUX_GPIO146__FUNC_AUD_CLK_MOSI>;
		};
	};

	aud_pins_smartpa_mode0: aud_pins_smartpa_mode0 {
		pins_cmd0_dat {
			pins = <PINMUX_GPIO69__FUNC_GPIO69>;
		};
		pins_cmd1_dat {
			pins = <PINMUX_GPIO70__FUNC_GPIO70>;
		};
		pins_cmd2_dat {
			pins = <PINMUX_GPIO72__FUNC_GPIO72>;
		};
		pins_cmd3_dat {
			pins = <PINMUX_GPIO73__FUNC_GPIO73>;
		};
	};

	aud_pins_smartpa_mode1: aud_pins_smartpa_mode1 {
		pins_cmd0_dat {
			pins = <PINMUX_GPIO69__FUNC_I2S0_LRCK>;
		};
		pins_cmd1_dat {
			pins = <PINMUX_GPIO70__FUNC_I2S0_BCK>;
		};
		pins_cmd2_dat {
			pins = <PINMUX_GPIO72__FUNC_I2S0_DI>;
		};
		pins_cmd3_dat {
			pins = <PINMUX_GPIO73__FUNC_I2S3_DO>;
		};
	};

	aud_pins_smartpa_mode3: aud_pins_smartpa_mode3 {
		pins_cmd0_dat {
			pins = <PINMUX_GPIO69__FUNC_I2S1_LRCK>;
		};
		pins_cmd1_dat {
			pins = <PINMUX_GPIO70__FUNC_I2S1_BCK>;
		};
		pins_cmd2_dat {
			pins = <PINMUX_GPIO72__FUNC_I2S2_DI>;
		};
		pins_cmd3_dat {
			pins = <PINMUX_GPIO73__FUNC_I2S1_DO>;
		};
	};

	aud_pins_tdm_mode0: aud_pins_tdm_mode0 {
		pins_cmd0_dat {
			pins = <PINMUX_GPIO135__FUNC_GPIO135>;
		};
		pins_cmd1_dat {
			pins = <PINMUX_GPIO136__FUNC_GPIO136>;
		};
		pins_cmd2_dat {
			pins = <PINMUX_GPIO138__FUNC_GPIO138>;
		};
	};

	aud_pins_tdm_mode1: aud_pins_tdm_mode1 {
		pins_cmd0_dat {
			pins = <PINMUX_GPIO135__FUNC_TDM_LRCK>;
		};
		pins_cmd1_dat {
			pins = <PINMUX_GPIO136__FUNC_TDM_BCK>;
		};
		pins_cmd2_dat {
			pins = <PINMUX_GPIO138__FUNC_TDM_DATA0>;
		};
	};

	aud_pins_hpdepop_high: audhpdepophigh {
		pins_cmd_dat {
			pins = <PINMUX_GPIO111__FUNC_GPIO111>;
			slew-rate = <1>;
			output-high;
		};
	};

	aud_pins_hpdepop_low: audhpdepoplow {
		pins_cmd_dat {
			pins = <PINMUX_GPIO111__FUNC_GPIO111>;
			slew-rate = <1>;
			output-low;
		};
	};

	aud_pins_hpdepop_high_e2: audhpdepophigh_e2 {
		pins_cmd_dat {
			pins = <PINMUX_GPIO139__FUNC_GPIO139>;
			slew-rate = <1>;
			output-high;
		};
	};

	aud_pins_hpdepop_low_e2: audhpdepoplow_e2 {
		pins_cmd_dat {
			pins = <PINMUX_GPIO139__FUNC_GPIO139>;
			slew-rate = <1>;
			output-low;
		};
	};

	aud_dat_miso_off: aud_dat_miso_off {
		pins_cmd1_dat {
			pins = <PINMUX_GPIO147__FUNC_GPIO147>;
		};
	};
	aud_dat_miso_on: aud_dat_miso_on {
		pins_cmd1_dat {
			pins = <PINMUX_GPIO147__FUNC_AUD_DAT_MISO>;
		};
	};

	aud_dat_mosi_off: aud_dat_mosi_off {
		pins_cmd2_dat {
			pins = <PINMUX_GPIO148__FUNC_GPIO148>;
		};
	};
	aud_dat_mosi_on: aud_dat_mosi_on {
		pins_cmd2_dat {
			pins = <PINMUX_GPIO148__FUNC_AUD_DAT_MOSI>;
		};
	};

	vow_dat_miso_off: vow_dat_miso_off {
		pins_cmd1_dat {
			pins = <PINMUX_GPIO147__FUNC_GPIO147>;
		};
	};
	vow_dat_miso_on: vow_dat_miso_on {
		pins_cmd1_dat {
			pins = <PINMUX_GPIO147__FUNC_VOW_DAT_MISO>;
		};
	};

	vow_clk_miso_off: vow_clk_miso_off {
		pins_cmd3_dat {
			pins = <PINMUX_GPIO149__FUNC_GPIO149>;
		};
	};
	vow_clk_miso_on: vow_clk_miso_on {
		pins_cmd3_dat {
			pins = <PINMUX_GPIO149__FUNC_VOW_CLK_MISO>;
		};
	};

	anc_dat_mosi_off: anc_dat_mosi_off {
		pins_cmd4_dat {
			pins = <PINMUX_GPIO150__FUNC_GPIO150>;
		};
	};
	anc_dat_mosi_on: anc_dat_mosi_on {
		pins_cmd4_dat {
			pins = <PINMUX_GPIO150__FUNC_ANC_DAT_MOSI>;
		};
	};
};
/* AUDIO end */

/* DISPSYS GPIO start */
&mtkfb {
	pinctrl-names = "mode_te_gpio", "mode_te_te", "lcm_rst_out0_gpio",
			"lcm_rst_out1_gpio", "lcd_bias_enp0_gpio", "lcd_bias_enp1_gpio",
			"lcd_bias_enn0_gpio", "lcd_bias_enn1_gpio";
	pinctrl-0 = <&mtkfb_pins_mode_te_gpio>;
	pinctrl-1 = <&mtkfb_pins_mode_te_te>;
	pinctrl-2 = <&mtkfb_pins_lcm_reset0>;
	pinctrl-3 = <&mtkfb_pins_lcm_reset1>;
	pinctrl-4 = <&mtkfb_pins_lcd_bias_enp0>;
	pinctrl-5 = <&mtkfb_pins_lcd_bias_enp1>;
	pinctrl-6 = <&mtkfb_pins_lcd_bias_enn0>;
	pinctrl-7 = <&mtkfb_pins_lcd_bias_enn1>;
	status = "okay";
};

&pio {

	mtkfb_pins_mode_te_gpio: mode_te_gpio {
		pins_cmd_dat {
			pins = <PINMUX_GPIO179__FUNC_DSI_TE0>;
		};
	};

	mtkfb_pins_mode_te_te: mode_te_te {
		pins_cmd_dat {
			pins = <PINMUX_GPIO179__FUNC_DSI_TE0>;
		};
	};

	mtkfb_pins_lcm_reset0: lcm_rst_out0_gpio {
		pins_cmd_dat {
			pins = <PINMUX_GPIO180__FUNC_LCM_RST>;
			slew-rate = <1>;
			output-low;
		};
	};

	mtkfb_pins_lcm_reset1: lcm_rst_out1_gpio {
		pins_cmd_dat {
			pins = <PINMUX_GPIO180__FUNC_LCM_RST>;
			slew-rate = <1>;
			output-high;
		};
	};

	mtkfb_pins_lcd_bias_enp0: lcd_bias_enp0_gpio {
		pins_cmd_dat {
			pins = <PINMUX_GPIO245__FUNC_GPIO245>;
			slew-rate = <1>;
			output-low;
		};
	};

	mtkfb_pins_lcd_bias_enp1: lcd_bias_enp1_gpio {
		pins_cmd_dat {
			pins = <PINMUX_GPIO245__FUNC_GPIO245>;
			slew-rate = <1>;
			output-high;
		};
	};

	mtkfb_pins_lcd_bias_enn0: lcd_bias_enn0_gpio {
		pins_cmd_dat {
			pins = <PINMUX_GPIO244__FUNC_GPIO244>;
			slew-rate = <1>;
			output-low;
		};
	};

	mtkfb_pins_lcd_bias_enn1: lcd_bias_enn1_gpio {
		pins_cmd_dat {
			pins = <PINMUX_GPIO244__FUNC_GPIO244>;
			slew-rate = <1>;
			output-high;
		};
	};
};
/* DISPSYS GPIO end */
/* CAMERA GPIO standardization */
&pio {
	camera_pins_cam0_rst0: cam0@0 {
		pins_cmd_dat {
			pins = <PINMUX_GPIO32__FUNC_GPIO32>;
			slew-rate = <1>; /*direction 0:in, 1:out*/
			output-low;/*direction out used only. output_low or high*/
		};
	};
	camera_pins_cam0_rst1: cam0@1 {
		pins_cmd_dat {
			pins = <PINMUX_GPIO32__FUNC_GPIO32>;
			slew-rate = <1>;
			output-high;
		};
	};
	camera_pins_cam0_pnd0: cam0@2 {
		pins_cmd_dat {
			pins = <PINMUX_GPIO28__FUNC_GPIO28>;
			slew-rate = <1>;
			output-low;
		};
	};
	camera_pins_cam0_pnd1: cam0@3 {
		pins_cmd_dat {
			pins = <PINMUX_GPIO28__FUNC_GPIO28>;
			slew-rate = <1>;
			output-high;
		};
	};
	camera_pins_cam1_rst0: cam1@0 {
		pins_cmd_dat {
			pins = <PINMUX_GPIO33__FUNC_GPIO33>;
			slew-rate = <1>; /*direction 0:in, 1:out*/
			output-low;/*direction out used only. output_low or high*/
		};
	};
	camera_pins_cam1_rst1: cam1@1 {
		pins_cmd_dat {
			pins = <PINMUX_GPIO33__FUNC_GPIO33>;
			slew-rate = <1>;
			output-high;
		};
	};
	camera_pins_cam1_pnd0: cam1@2 {
		pins_cmd_dat {
			pins = <PINMUX_GPIO29__FUNC_GPIO29>;
			slew-rate = <1>;
			output-low;
		};
	};
	camera_pins_cam1_pnd1: cam1@3 {
		pins_cmd_dat {
			pins = <PINMUX_GPIO29__FUNC_GPIO29>;
			slew-rate = <1>;
			output-high;
		};
	};
	camera_pins_cam2_rst0: cam2@0 {
		pins_cmd_dat {
			pins = <PINMUX_GPIO35__FUNC_GPIO35>;
			slew-rate = <1>; /*direction 0:in, 1:out*/
			output-low;/*direction out used only. output_low or high*/
		};
	};
	camera_pins_cam2_rst1: cam2@1 {
		pins_cmd_dat {
			pins = <PINMUX_GPIO35__FUNC_GPIO35>;
			slew-rate = <1>;
			output-high;
		};
	};
	camera_pins_cam2_pnd0: cam2@2 {
		pins_cmd_dat {
			pins = <PINMUX_GPIO34__FUNC_GPIO34>;
			slew-rate = <1>;
			output-low;
		};
	};
	camera_pins_cam2_pnd1: cam2@3 {
		pins_cmd_dat {
			pins = <PINMUX_GPIO34__FUNC_GPIO34>;
			slew-rate = <1>;
			output-high;
		};
	};
	camera_pins_cam_ldo_vcama_0: cam0@vcama0 {
		pins_cmd_dat {
			pins = <PINMUX_GPIO243__FUNC_GPIO243>;
			slew-rate = <1>;
			output-low;
		};
	};
	camera_pins_cam_ldo_vcama_1: cam0@vcama1 {
		pins_cmd_dat {
			pins = <PINMUX_GPIO243__FUNC_GPIO243>;
			slew-rate = <1>;
			output-high;
		};
	};
	camera_pins_cam_sub_ldo_vcama_0: cam1@vcama0 {
		pins_cmd_dat {
			pins = <PINMUX_GPIO252__FUNC_GPIO252>;
			slew-rate = <1>;
			output-low;
		};
	};
	camera_pins_cam_sub_ldo_vcama_1: cam1@vcama1 {
		pins_cmd_dat {
			pins = <PINMUX_GPIO252__FUNC_GPIO252>;
			slew-rate = <1>;
			output-high;
		};
	};
	camera_pins_default: camdefault {
	};
};

&kd_camera_hw1 {
	pinctrl-names = "default",
			"cam0_rst0", "cam0_rst1", "cam0_pnd0", "cam0_pnd1",
			"cam1_rst0", "cam1_rst1", "cam1_pnd0", "cam1_pnd1",
			"cam2_rst0", "cam2_rst1", "cam2_pnd0", "cam2_pnd1",
			"cam_ldo_vcama_0", "cam_ldo_vcama_1", "cam_ldo_sub_vcama_0", "cam_ldo_sub_vcama_1";
	pinctrl-0 = <&camera_pins_default>;
	pinctrl-1 = <&camera_pins_cam0_rst0>;
	pinctrl-2 = <&camera_pins_cam0_rst1>;
	pinctrl-3 = <&camera_pins_cam0_pnd0>;
	pinctrl-4 = <&camera_pins_cam0_pnd1>;
	pinctrl-5 = <&camera_pins_cam1_rst0>;
	pinctrl-6 = <&camera_pins_cam1_rst1>;
	pinctrl-7 = <&camera_pins_cam1_pnd0>;
	pinctrl-8 = <&camera_pins_cam1_pnd1>;
	/* for main2 */
	pinctrl-9 = <&camera_pins_cam2_rst0>;
	pinctrl-10 = <&camera_pins_cam2_rst1>;
	pinctrl-11 = <&camera_pins_cam2_pnd0>;
	pinctrl-12 = <&camera_pins_cam2_pnd1>;
	/* for ldo control by gpio */
	pinctrl-13 = <&camera_pins_cam_ldo_vcama_0>;
	pinctrl-14 = <&camera_pins_cam_ldo_vcama_1>;
	pinctrl-15 = <&camera_pins_cam_sub_ldo_vcama_0>;
	pinctrl-16 = <&camera_pins_cam_sub_ldo_vcama_1>;
	status = "okay";
};
/* CAMERA GPIO end */

/* MHL GPIO define start */
&pio {

	dpi_d0def: mhl@39_0 {
		pins_cmd_dat {
			pins = <PINMUX_GPIO39__FUNC_GPIO39>;
			slew-rate = <0>;
			bias-pull-down = <11>;
		};
	};
	dpi_d0cfg: mhl@39_1 {
		pins_cmd_dat {
			pins = <PINMUX_GPIO39__FUNC_DPI_D0>;
		};
	};

	dpi_d1def: mhl@40_0 {
		pins_cmd_dat {
			pins = <PINMUX_GPIO40__FUNC_GPIO40>;
			slew-rate = <0>;
			bias-pull-down = <11>;
		};
	};
	dpi_d1cfg: mhl@40_1 {
		pins_cmd_dat {
			pins = <PINMUX_GPIO40__FUNC_DPI_D1>;
		};
	};

	dpi_d2def: mhl@41_0 {
		pins_cmd_dat {
			pins = <PINMUX_GPIO41__FUNC_GPIO41>;
			slew-rate = <0>;
			bias-pull-down = <11>;
		};
	};
	dpi_d2cfg: mhl@41_1 {
		pins_cmd_dat {
			pins = <PINMUX_GPIO41__FUNC_DPI_D2>;
		};
	};

	dpi_d3def: mhl@42_0 {
		pins_cmd_dat {
			pins = <PINMUX_GPIO42__FUNC_GPIO42>;
			slew-rate = <0>;
			bias-pull-down = <11>;
		};
	};
	dpi_d3cfg: mhl@42_1 {
		pins_cmd_dat {
			pins = <PINMUX_GPIO42__FUNC_DPI_D3>;
		};
	};

	dpi_d4def: mhl@43_0 {
		pins_cmd_dat {
			pins = <PINMUX_GPIO43__FUNC_GPIO43>;
			slew-rate = <0>;
			bias-pull-down = <11>;
		};
	};
	dpi_d4cfg: mhl@43_1 {
		pins_cmd_dat {
			pins = <PINMUX_GPIO43__FUNC_DPI_D4>;
		};
	};

	dpi_d5def: mhl@44_0 {
		pins_cmd_dat {
			pins = <PINMUX_GPIO44__FUNC_GPIO44>;
			slew-rate = <0>;
			bias-pull-down = <11>;
		};
	};
	dpi_d5cfg: mhl@44_1 {
		pins_cmd_dat {
			pins = <PINMUX_GPIO44__FUNC_DPI_D5>;
		};
	};

	dpi_d6def: mhl@45_0 {
		pins_cmd_dat {
			pins = <PINMUX_GPIO45__FUNC_GPIO45>;
			slew-rate = <0>;
			bias-pull-down = <11>;
		};
	};
	dpi_d6cfg: mhl@45_1 {
		pins_cmd_dat {
			pins = <PINMUX_GPIO45__FUNC_DPI_D6>;
		};
	};

	dpi_d7def: mhl@46_0 {
		pins_cmd_dat {
			pins = <PINMUX_GPIO46__FUNC_GPIO46>;
			slew-rate = <0>;
			bias-pull-down = <11>;
		};
	};
	dpi_d7cfg: mhl@46_1 {
		pins_cmd_dat {
			pins = <PINMUX_GPIO46__FUNC_DPI_D7>;
		};
	};

	dpi_d8def: mhl@47_0 {
		pins_cmd_dat {
			pins = <PINMUX_GPIO47__FUNC_GPIO47>;
			slew-rate = <0>;
			bias-pull-down = <11>;
		};
	};
	dpi_d8cfg: mhl@47_1 {
		pins_cmd_dat {
			pins = <PINMUX_GPIO47__FUNC_DPI_D8>;
		};
	};

	dpi_d9def: mhl@48_0 {
		pins_cmd_dat {
			pins = <PINMUX_GPIO48__FUNC_GPIO48>;
			slew-rate = <0>;
			bias-pull-down = <11>;
		};
	};
	dpi_d9cfg: mhl@48_1 {
		pins_cmd_dat {
			pins = <PINMUX_GPIO48__FUNC_DPI_D9>;
		};
	};

	dpi_d10def: mhl@49_0 {
		pins_cmd_dat {
			pins = <PINMUX_GPIO49__FUNC_GPIO49>;
			slew-rate = <0>;
			bias-pull-down = <11>;
		};
	};
	dpi_d10cfg: mhl@49_1 {
		pins_cmd_dat {
			pins = <PINMUX_GPIO49__FUNC_DPI_D10>;
		};
	};

	dpi_d11def: mhl@50_0 {
		pins_cmd_dat {
			pins = <PINMUX_GPIO50__FUNC_GPIO50>;
			slew-rate = <0>;
			bias-pull-down = <11>;
		};
	};
	dpi_d11cfg: mhl@50_1 {
		pins_cmd_dat {
			pins = <PINMUX_GPIO50__FUNC_DPI_D11>;
		};
	};
	dpi_dedef: mhl@51_0 {
		pins_cmd_dat {
			pins = <PINMUX_GPIO51__FUNC_GPIO51>;
			slew-rate = <0>;
			bias-pull-down = <11>;
		};
	};
	dpi_decfg: mhl@51_1 {
		pins_cmd_dat {
			pins = <PINMUX_GPIO51__FUNC_DPI_DE>;
		};
	};
	dpi_ckdef: mhl@52_0 {
		pins_cmd_dat {
			pins = <PINMUX_GPIO52__FUNC_GPIO52>;
			slew-rate = <0>;
			bias-pull-down = <11>;
		};
	};
	dpi_ckcfg: mhl@52_1 {
		pins_cmd_dat {
			pins = <PINMUX_GPIO52__FUNC_DPI_CK>;
		};
	};
	dpi_hsyncdef: mhl@53_0 {
		pins_cmd_dat {
			pins = <PINMUX_GPIO53__FUNC_GPIO53>;
			slew-rate = <0>;
			bias-pull-down = <11>;
		};
	};
	dpi_hsynccfg: mhl@53_1 {
		pins_cmd_dat {
			pins = <PINMUX_GPIO53__FUNC_DPI_HSYNC>;
		};
	};

	dpi_vsyncdef: mhl@54_0 {
		pins_cmd_dat {
			pins = <PINMUX_GPIO54__FUNC_GPIO54>;
			slew-rate = <0>;
			bias-pull-down = <11>;
		};
	};
	dpi_vsynccfg: mhl@54_1 {
		pins_cmd_dat {
			pins = <PINMUX_GPIO54__FUNC_DPI_VSYNC>;
		};
	};
	i2s_wsdef: mhl@135_0 {
		pins_cmd_dat {
			pins = <PINMUX_GPIO135__FUNC_GPIO135>;
			slew-rate = <0>;
			bias-pull-down = <11>;
		};
	};
	i2s_wscfg: mhl@135_1 {
		pins_cmd_dat {
			pins = <PINMUX_GPIO135__FUNC_TDM_LRCK>;
		};
	};

	i2s_ckdef: mhl@136_0 {
		pins_cmd_dat {
			pins = <PINMUX_GPIO136__FUNC_GPIO136>;
			slew-rate = <0>;
			bias-pull-down = <11>;
		};
	};
	i2s_ckcfg: mhl@136_1 {
		pins_cmd_dat {
			pins = <PINMUX_GPIO136__FUNC_TDM_BCK>;
		};
	};
	i2s_datdef: mhl@138_0 {
		pins_cmd_dat {
			pins = <PINMUX_GPIO138__FUNC_GPIO138>;
			slew-rate = <0>;
			bias-pull-down = <11>;
		};
	};
	i2s_datcfg: mhl@138_1 {
		pins_cmd_dat {
			pins = <PINMUX_GPIO138__FUNC_TDM_DATA0>;
		};
	};
	rst_lowcfg: mhl@139_0 {
		pins_cmd_dat {
			pins = <PINMUX_GPIO139__FUNC_GPIO139>;
			slew-rate = <1>;
			output-low;
		};
	};
	rst_highcfg: mhl@139_1 {
		pins_cmd_dat {
			pins = <PINMUX_GPIO139__FUNC_GPIO139>;
			slew-rate = <1>;
			output-high;
		};
	};
	eint_cfg: mhl@140_0 {
		pins_cmd_dat {
			pins = <PINMUX_GPIO140__FUNC_GPIO140>;
			slew-rate = <0>;
			bias-pull-up = <11>;
		};
	};

};

&mhl {
	pinctrl-names = "dpi_d0_def", "dpi_d0_cfg",
	"dpi_d1_def", "dpi_d1_cfg", "dpi_d2_def", "dpi_d2_cfg",
	"dpi_d3_def", "dpi_d3_cfg", "dpi_d4_def", "dpi_d4_cfg",
	"dpi_d5_def", "dpi_d5_cfg", "dpi_d6_def", "dpi_d6_cfg",
	"dpi_d7_def", "dpi_d7_cfg", "dpi_d8_def", "dpi_d8_cfg",
	"dpi_d9_def", "dpi_d9_cfg", "dpi_d10_def", "dpi_d10_cfg",
	"dpi_d11_def", "dpi_d11_cfg", "dpi_ck_def", "dpi_ck_cfg",
	"dpi_de_def", "dpi_de_cfg", "dpi_hsync_def", "dpi_hsync_cfg",
	"dpi_vsync_def", "dpi_vsync_cfg", "i2s_dat_def", "i2s_dat_cfg",
	"i2s_ws_def", "i2s_ws_cfg", "i2s_ck_def", "i2s_ck_cfg",
	"rst_low_cfg", "rst_high_cfg", "eint_input_cfg";
	pinctrl-0 = <&dpi_d0def>;
	pinctrl-1 = <&dpi_d0cfg>;
	pinctrl-2 = <&dpi_d1def>;
	pinctrl-3 = <&dpi_d1cfg>;
	pinctrl-4 = <&dpi_d2def>;
	pinctrl-5 = <&dpi_d2cfg>;
	pinctrl-6 = <&dpi_d3def>;
	pinctrl-7 = <&dpi_d3cfg>;
	pinctrl-8 = <&dpi_d4def>;
	pinctrl-9 = <&dpi_d4cfg>;
	pinctrl-10 = <&dpi_d5def>;
	pinctrl-11 = <&dpi_d5cfg>;
	pinctrl-12 = <&dpi_d6def>;
	pinctrl-13 = <&dpi_d6cfg>;
	pinctrl-14 = <&dpi_d7def>;
	pinctrl-15 = <&dpi_d7cfg>;
	pinctrl-16 = <&dpi_d8def>;
	pinctrl-17 = <&dpi_d8cfg>;
	pinctrl-18 = <&dpi_d9def>;
	pinctrl-19 = <&dpi_d9cfg>;
	pinctrl-20 = <&dpi_d10def>;
	pinctrl-21 = <&dpi_d10cfg>;
	pinctrl-22 = <&dpi_d11def>;
	pinctrl-23 = <&dpi_d11cfg>;
	pinctrl-24 = <&dpi_ckdef>;
	pinctrl-25 = <&dpi_ckcfg>;
	pinctrl-26 = <&dpi_dedef>;
	pinctrl-27 = <&dpi_decfg>;
	pinctrl-28 = <&dpi_hsyncdef>;
	pinctrl-29 = <&dpi_hsynccfg>;
	pinctrl-30 = <&dpi_vsyncdef>;
	pinctrl-31 = <&dpi_vsynccfg>;
	pinctrl-32 = <&i2s_datdef>;
	pinctrl-33 = <&i2s_datcfg>;
	pinctrl-34 = <&i2s_wsdef>;
	pinctrl-35 = <&i2s_wscfg>;
	pinctrl-36 = <&i2s_ckdef>;
	pinctrl-37 = <&i2s_ckcfg>;
	pinctrl-38 = <&rst_lowcfg>;
	pinctrl-39 = <&rst_highcfg>;
	pinctrl-40 = <&eint_cfg>;
	status = "okay";
};
/* MHL GPIO define end */

/* CONSYS GPIO standardization */
&pio {
	consys_pins_default: default {

	};

	gpslna_pins_init: gpslna@0 {

	    pins_cmd_dat {
			pins = <PINMUX_GPIO251__FUNC_GPIO251>;
			slew-rate = <0>;
			bias-disable;
			output-low;
		};
	};

	gpslna_pins_oh: gpslna@1 {

	    pins_cmd_dat {
			pins = <PINMUX_GPIO251__FUNC_GPIO251>;
			slew-rate = <1>;
			output-high;
		};
	};

	gpslna_pins_ol: gpslna@2 {

	    pins_cmd_dat {
			pins = <PINMUX_GPIO251__FUNC_GPIO251>;
			slew-rate = <1>;
			output-low;
		};
	};

};

&consys {
	pinctrl-names = "default", "gps_lna_state_init", "gps_lna_state_oh", "gps_lna_state_ol";
	pinctrl-0 = <&consys_pins_default>;
	pinctrl-1 = <&gpslna_pins_init>;
	pinctrl-2 = <&gpslna_pins_oh>;
	pinctrl-3 = <&gpslna_pins_ol>;
	status = "okay";

};
/* CONSYS end */

/* FLASHLIGHT GPIO standardization */
&pio {
	flashlight_pins_default: default {

	};

	flashlight_pins_hwen_high: hwen_high {

	    pins_cmd_dat {
			pins = <PINMUX_GPIO90__FUNC_GPIO90>;
			slew-rate = <1>;
			output-high;
		};
	};

	flashlight_pins_hwen_low: hwen_low {

	    pins_cmd_dat {
			pins = <PINMUX_GPIO90__FUNC_GPIO90>;
			slew-rate = <1>;
			output-low;
		};
	};

};

&flashlight {
	pinctrl-names = "default", "hwen_high", "hwen_low";
	pinctrl-0 = <&flashlight_pins_default>;
	pinctrl-1 = <&flashlight_pins_hwen_high>;
	pinctrl-2 = <&flashlight_pins_hwen_low>;
	status = "okay";

};
/* FLASHLIGHT GPIO end */

/* irtx GPIO standardization */
&irtx {
	pinctrl-names = "irtx_gpio_default",
			"irtx_gpio_led_set";
	pinctrl-0 = <&irtx_gpio_default>;
	pinctrl-1 = <&irtx_gpio_led_set>;
	status = "okay";
};

&pio {
	/* IRTX GPIO Settings -Start */
	/* default: GPIO0, output, high */
	irtx_gpio_default:irtx_gpio_led_def@gpio137 {
		pins_cmd_dat {
			pins = <PINMUX_GPIO137__FUNC_GPIO137>;
			slew-rate = <0>;
			bias-pull-down = <00>;
			input-schmitt-enable = <0>;
		};
	};
	irtx_gpio_led_set:irtx_gpio_led_set@gpio137 {
		pins_cmd_dat {
			pins = <PINMUX_GPIO137__FUNC_IRTX_OUT>;
		};
	};
	/* IRTX GPIO Settings -End */
};

/* USB TYPEC GPIO start */
&pio {
	usb_default: usb_default {
	};

	gpio_redriver_c1_init: gpio197_redriver_c1_init {
		pins_cmd_dat {
			pins = <PINMUX_GPIO197__FUNC_GPIO197>;
			slew-rate = <1>;
			output-high;
		};
	};

	gpio_redriver_c1_low: gpio197_redriver_c1_low {
		pins_cmd_dat {
			pins = <PINMUX_GPIO197__FUNC_GPIO197>;
			slew-rate = <1>;
			output-low;
		};
	};

	gpio_redriver_c1_hiz: gpio197_redriver_c1_highz {
		pins_cmd_dat {
			pins = <PINMUX_GPIO197__FUNC_GPIO197>;
			slew-rate= <0>;
			bias-disable;
		};
	};

	gpio_redriver_c1_high: gpio197_redriver_c1_high {
		pins_cmd_dat {
			pins = <PINMUX_GPIO197__FUNC_GPIO197>;
			slew-rate = <1>;
			output-high;
		};
	};

	gpio_redriver_c2_init: gpio196_redriver_c2_init {
		pins_cmd_dat {
			pins = <PINMUX_GPIO196__FUNC_GPIO196>;
			slew-rate = <1>;
			output-low;
		};
	};

	gpio_redriver_c2_low: gpio196_redriver_c2_low {
		pins_cmd_dat {
			pins = <PINMUX_GPIO196__FUNC_GPIO196>;
			slew-rate = <1>;
			output-low;
		};
	};

	gpio_redriver_c2_hiz: gpio196_redriver_c2_highz {
		pins_cmd_dat {
			pins = <PINMUX_GPIO196__FUNC_GPIO196>;
			slew-rate= <0>;
			bias-disable;
		};
	};

	gpio_redriver_c2_high: gpio196_redriver_c2_high {
		pins_cmd_dat {
			pins = <PINMUX_GPIO196__FUNC_GPIO196>;
			slew-rate = <1>;
			output-high;
		};
	};

	gpio_sii7033_rst_init: gpio251_sii7033_rst_init {
		pins_cmd_dat {
			pins = <PINMUX_GPIO251__FUNC_GPIO251>;
			slew-rate = <1>;
			output-high;
		};
	};

	gpio_sii7033_rst_low: gpio251_sii7033_rst_low {
		pins_cmd_dat {
			pins = <PINMUX_GPIO251__FUNC_GPIO251>;
			slew-rate = <1>;
			output-low;
		};
	};

	gpio_sii7033_rst_high: gpio251_sii7033_rst_high {
		pins_cmd_dat {
			pins = <PINMUX_GPIO251__FUNC_GPIO251>;
			slew-rate = <1>;
			output-high;
		};
	};
};

&usb_c_pinctrl {
	pinctrl-names = "usb_default",
		"redriver_c1_init",
		"redriver_c1_low",
		"redriver_c1_hiz",
		"redriver_c1_high",
		"redriver_c2_init",
		"redriver_c2_low",
		"redriver_c2_hiz",
		"redriver_c2_high",
		"sii7033_rst_init",
		"sii7033_rst_low",
		"sii7033_rst_high";

	pinctrl-0 = <&usb_default>;
	pinctrl-1 = <&gpio_redriver_c1_init>;
	pinctrl-2 = <&gpio_redriver_c1_low>;
	pinctrl-3 = <&gpio_redriver_c1_hiz>;
	pinctrl-4 = <&gpio_redriver_c1_high>;
	pinctrl-5 = <&gpio_redriver_c2_init>;
	pinctrl-6 = <&gpio_redriver_c2_low>;
	pinctrl-7 = <&gpio_redriver_c2_hiz>;
	pinctrl-8 = <&gpio_redriver_c2_high>;
	pinctrl-9 = <&gpio_sii7033_rst_init>;
	pinctrl-10 = <&gpio_sii7033_rst_low>;
	pinctrl-11 = <&gpio_sii7033_rst_high>;
	status = "okay";
};
/* USB TYPEC GPIO end */

/* USB XHCI GPIO start */
&pio {
	iddig_default: iddig_default {
	};

	gpio181_mode1_iddig: iddig_init {
		pins_cmd_dat {
			pins = <PINMUX_GPIO181__FUNC_IDDIG>;
			slew-rate = <0>;
			bias-pull-up = <00>;
		};
	};
};

&pio {
	drvvbus_default: drvvbus_default {
	};

	gpio94_mode1_drvvbus_low: drvvbus_low {
		pins_cmd_dat {
			pins = <PINMUX_GPIO94__FUNC_USB_DRVVBUS>;
			slew-rate = <1>;
			output-low;
		};
	};

	gpio94_mode1_drvvbus_high: drvvbus_high {
		pins_cmd_dat {
			pins = <PINMUX_GPIO94__FUNC_USB_DRVVBUS>;
			slew-rate = <1>;
			output-high;
		};
	};
};

&usb0 {
	pinctrl-names = "iddig_default", "iddig_init";
	pinctrl-0 = <&iddig_default>;
	pinctrl-1 = <&gpio181_mode1_iddig>;
	status = "okay";
};

&xhci0 {
	pinctrl-names = "drvvbus_default", "drvvbus_low", "drvvbus_high";
	pinctrl-0 = <&drvvbus_default>;
	pinctrl-1 = <&gpio94_mode1_drvvbus_low>;
	pinctrl-2 = <&gpio94_mode1_drvvbus_high>;
	status = "okay";
};

/* USB XHCI GPIO start */
