/*
 * Mediatek's MT6765 SoC device tree source
 *
 * Copyright (C) 2015 MediaTek Inc.
 *
 * This program is free software; you can redistribute it and/or modify
 * it under the terms of the GNU General Public License version 2 as
 * published by the Free Software Foundation.
 *
 * This program is distributed in the hope that it will be useful,
 * but WITHOUT ANY WARRANTY; without even the implied warranty of
 * MERCHANTABILITY or FITNESS FOR A PARTICULAR PURPOSE.
 * See http://www.gnu.org/licenses/gpl-2.0.html for more details.
 */

#include "k62v1_64_bsp.dts"

/* dynamic options configure start */
#include "radio_md_cfg_lwtg.dts"
/* dynamic options configure end */

#include <k62v1_64_bsp/cust.dtsi>
/*End of this file, DO NOT ADD ANYTHING HERE*/

