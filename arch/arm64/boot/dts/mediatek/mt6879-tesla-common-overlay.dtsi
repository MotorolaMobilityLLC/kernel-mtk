/* Copyright (c) 2020, The Linux Foundation. All rights reserved.
 *
 * This program is free software; you can redistribute it and/or modify
 * it under the terms of the GNU General Public License version 2 and
 * only version 2 as published by the Free Software Foundation.
 *
 * This program is distributed in the hope that it will be useful,
 * but WITHOUT ANY WARRANTY; without even the implied warranty of
 * MERCHANTABILITY or FITNESS FOR A PARTICULAR PURPOSE.  See the
 * GNU General Public License for more details.
 */

#include "mediatek/mt6879-moto-common-overlay.dtsi"
#include "mediatek/cust_mt6879_touch_1080x2400.dtsi"
#include "mediatek/cust_mt6879_camera_v4l2.dtsi"
#include "mediatek/tesla-display.dtsi"
