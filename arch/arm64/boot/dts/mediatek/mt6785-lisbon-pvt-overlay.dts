/* Copyright (c) 2019, Motorola Mobility Inc. All rights reserved.
 *
 * This program is free software; you can redistribute it and/or modify
 * it under the terms of the GNU General Public License version 2 and
 * only version 2 as published by the Free Software Foundation.
 *
 * This program is distributed in the hope that it will be useful,
 * but WITHOUT ANY WARRANTY; without even the implied warranty of
 * MERCHANTABILITY or FITNESS FOR A PARTICULAR PURPOSE.  See the
 * GNU General Public License for more details.
 */

/dts-v1/;
/plugin/;

#include "mediatek/mt6785-lisbon-common-overlay.dtsi"
/* Board match root node */
/ {
	fragment@model {
		target-path = "/";
		__overlay__ {
			mot,model = "lisbon";
			mot,board-id = <0x41 0xC000>;
		};
	};
};

&spi1 {
	#address-cells = <1>;
	#size-cells = <0>;
	spislv@2 {
		compatible = "mediatek,hifi4dsp-spi";
		spi-max-frequency = <1000000>;
		spi-pin-mode = <0>;
		/*tick-dly = <1>;*/
		ick-dly = <0>;
		reg = <0>;
		status = "okay";
	};
};

#include <lisbon_evt/cust.dtsi>
/*End of this file, DO NOT ADD ANYTHING HERE*/
