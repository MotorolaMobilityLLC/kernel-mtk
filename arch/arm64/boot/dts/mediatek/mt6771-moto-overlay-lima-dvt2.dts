/* Copyright (c) 2019, Motorola Mobility Inc. All rights reserved.
 *
 * This program is free software; you can redistribute it and/or modify
 * it under the terms of the GNU General Public License version 2 and
 * only version 2 as published by the Free Software Foundation.
 *
 * This program is distributed in the hope that it will be useful,
 * but WITHOUT ANY WARRANTY; without even the implied warranty of
 * MERCHANTABILITY or FITNESS FOR A PARTICULAR PURPOSE.  See the
 * GNU General Public License for more details.
 */

/dts-v1/;
/plugin/;

#include "mt6771-moto-overlay-lima.dtsi"

/* Board match root node */
/ {
	fragment@model {
		target-path = "/";
		__overlay__ {
			mot,model = "lima";
			mot,board-id = <0x41 0xB200>,<0x43 0xB200>;
		};
	};
};

/* Changes for lima EVT1 go here */
&msdc1 {
	cd_level = /bits/ 8 <MSDC_CD_HIGH>;
	cd-gpios = <&pio 26 0>;
};


&i2c3 {
	abov_sar@20 {
	   label = "AbovCapSense05";
	 };
};




#include <lima/cust_evt2.dtsi>
/*End of this file, DO NOT ADD ANYTHING HERE*/


