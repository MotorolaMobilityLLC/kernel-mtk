/*
 * Copyright (c) 2016-2018, Watchdata Limited
 *
 * This program is free software; you can redistribute it and/or modify
 * it under the terms of the GNU General Public License Version 2 as
 * published by the Free Software Foundation.
 *
 * This program is distributed in the hope that it will be useful,
 * but WITHOUT ANY WARRANTY; without even the implied warranty of
 * MERCHANTABILITY or FITNESS FOR A PARTICULAR PURPOSE. See the
 * GNU General Public License for more details.
 */

wdtee-reserved-shm-memory {
			compatible = "watchdata,wdtee-reserved-shm-memory";
			reg = <0 0x70000000 0 0x00200000>;
			no-map;
};
