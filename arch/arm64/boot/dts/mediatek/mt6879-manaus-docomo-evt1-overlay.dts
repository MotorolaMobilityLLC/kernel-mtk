/* Copyright (c) 2023, Motorola Mobility Inc. All rights reserved.
 *
 * This program is free software; you can redistribute it and/or modify
 * it under the terms of the GNU General Public License version 2 and
 * only version 2 as published by the Free Software Foundation.
 *
 * This program is distributed in the hope that it will be useful,
 * but WITHOUT ANY WARRANTY; without even the implied warranty of
 * MERCHANTABILITY or FITNESS FOR A PARTICULAR PURPOSE.  See the
 * GNU General Public License for more details.
 */

/dts-v1/;
/plugin/;

#include "mediatek/mt6879-manaus-docomo-common-overlay.dtsi"

/* Board match root node */
/ {
	fragment@model {
		target-path = "/";
		__overlay__ {
			mot,model = "manaus";
			mot,board-id = <(MANAUS_DOCOMO_RADIO << 8 | 0x4B) 0xA100>;
		};
	};
};

#include <manaus_docomo_evt1/cust.dtsi>
#include "mediatek/cust_mt6879_camera_v4l2_manaus.dtsi"
/*End of this file, DO NOT ADD ANYTHING HERE*/
