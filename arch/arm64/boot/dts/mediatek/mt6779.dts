/*
 * Mediatek's mt6779 SoC device tree source
 *
 * Copyright (C) 2018 MediaTek Inc.
 *
 * This program is free software; you can redistribute it and/or modify
 * it under the terms of the GNU General Public License version 2 as
 * published by the Free Software Foundation.
 *
 * This program is distributed in the hope that it will be useful,
 * but WITHOUT ANY WARRANTY; without even the implied warranty of
 * MERCHANTABILITY or FITNESS FOR A PARTICULAR PURPOSE.
 * See http://www.gnu.org/licenses/gpl-2.0.html for more details.
 */

/dts-v1/;
#include <dt-bindings/clock/mt6779-clk.h>
#include <dt-bindings/interrupt-controller/arm-gic.h>
#include <dt-bindings/interrupt-controller/irq.h>
#include <dt-bindings/mmc/mt6779-msdc.h>
#include <dt-bindings/pinctrl/mt6779-pinfunc.h>
#include <dt-bindings/gce/mt6779-gce.h>
#include <dt-bindings/iio/mt635x-auxadc.h>
#include <generated/autoconf.h>

/ {
	model = "mt6779";
	compatible = "mediatek,mt6779";
	interrupt-parent = <&sysirq>;
	#address-cells = <2>;
	#size-cells = <2>;

	/* chosen */
	chosen: chosen {
		bootargs = "console=tty0 console=ttyS0,921600n1 root=/dev/ram";
	};

	cpus {
		#address-cells = <1>;
		#size-cells = <0>;

		cpu0: cpu@000 {
			device_type = "cpu";
			compatible = "arm,cortex-a55";
			reg = <0x0000>;
			enable-method = "psci";
			clock-frequency = <1701000000>;
		};

/*
 *		cpu1: cpu@001 {
 *			device_type = "cpu";
 *			compatible = "arm,cortex-a55";
 *			reg = <0x0100>;
 *			enable-method = "disabled";
 *			clock-frequency = <1701000000>;
 *		};
 *
 *		cpu2: cpu@002 {
 *			device_type = "cpu";
 *			compatible = "arm,cortex-a55";
 *			reg = <0x0200>;
 *			enable-method = "disabled";
 *			clock-frequency = <1701000000>;
 *		};
 *
 *		cpu3: cpu@003 {
 *			device_type = "cpu";
 *			compatible = "arm,cortex-a55";
 *			reg = <0x0300>;
 *			enable-method = "disabled";
 *			clock-frequency = <1701000000>;
 *		};
 *
 *		cpu4: cpu@100 {
 *			device_type = "cpu";
 *			compatible = "arm,cortex-a55";
 *			reg = <0x0400>;
 *			enable-method = "disabled";
 *			clock-frequency = <1701000000>;
 *		};
 *
 *		cpu5: cpu@101 {
 *			device_type = "cpu";
 *			compatible = "arm,cortex-a55";
 *			reg = <0x0500>;
 *			enable-method = "disabled";
 *			clock-frequency = <1701000000>;
 *		};
 *
 *		cpu6: cpu@102 {
 *			device_type = "cpu";
 *			compatible = "arm,cortex-a75";
 *			reg = <0x0600>;
 *			enable-method = "psci";
 *			clock-frequency = <2171000000>;
 *		};
 *
 *		cpu7: cpu@103 {
 *			device_type = "cpu";
 *			compatible = "arm,cortex-a75";
 *			reg = <0x0700>;
 *			enable-method = "disabled";
 *			clock-frequency = <2171000000>;
 *		};
 */
		/include/ "mt2712-sched-energy.dtsi"

		virtual-cpu-map {
			cluster0 {
				core0 {
					cpu = <&cpu0>;
				};
/*
 *				core1 {
 *					cpu = <&cpu1>;
 *				};
 *				core2 {
 *					cpu = <&cpu2>;
 *				};
 *				core3 {
 *					cpu = <&cpu3>;
 *				};
 *				core4 {
 *					cpu = <&cpu4>;
 *				};
 *				core5 {
 *					cpu = <&cpu5>;
 *				};
 */
			};
/*
 *			cluster1 {
 *				core0 {
 *					cpu = <&cpu6>;
 *				};
 *				core1 {
 *					cpu = <&cpu7>;
 *				};
 *			};
 */

		};
	};

	memory {
		device_type = "memory";
		reg = <0 0x40000000 0 0x1e605000>;
	};

	psci {
		compatible      = "arm,psci-1.0";
		method          = "smc";
	};

	reserved_memory: reserved-memory {
		#address-cells = <2>;
		#size-cells = <2>;
		ranges;

		ion_carveout_heap {
			compatible = "mediatek,ion_carveout_heap";
			no-map;
			size = <0 0x400000>;
			alignment = <0 0x1000>;
			alloc-ranges = <0 0x40000000 0 0x40000000>;
		};
		reserve-memory-sspm_share {
			compatible = "mediatek,reserve-memory-sspm_share";
			no-map;
			status = "okay";
#ifdef CONFIG_MTK_GMO_RAM_OPTIMIZE
			size = <0 0x110000>; /* 1M + 64K */
#else
			size = <0 0x510000>; /* 5M + 64K */
#endif
			alignment = <0 0x10000>;
			alloc-ranges = <0 0x40000000 0 0x60000000>;
		};

		reserve-memory-scp_share {
			compatible = "mediatek,reserve-memory-scp_share";
			no-map;
			size = <0 0x00d00000>;
			alignment = <0 0x1000000>;
			alloc-ranges = <0 0x40000000 0 0x50000000>;
		};

#ifdef CONFIG_MICROTRUST_TEE_SUPPORT
		soter-shared-mem {
			compatible = "microtrust,shared_mem";
			no-map;
			size = <0 0x200000>;
			alloc-ranges = <0 0x40000000 0 0x50000000>;
		};
#endif

	};
	/* ATF logger SW IRQ number 111 = 32 + 79 */
	atf_logger {
		compatible = "mediatek,atf_logger";
		interrupts = <GIC_SPI 79 IRQ_TYPE_EDGE_RISING>;
	};

	/* Trustonic Mobicore SW IRQ number 121 = 32 + 89 */
	mobicore {
		compatible = "trustonic,mobicore";
		interrupts = <GIC_SPI 89 IRQ_TYPE_EDGE_RISING>;
	};

	/* Microtrust SW IRQ number 91(123) ~ 95(127) 331(363) */
	utos {
		compatible = "microtrust,utos";
		interrupts = <GIC_SPI 91 IRQ_TYPE_EDGE_RISING>,
			<GIC_SPI 92 IRQ_TYPE_EDGE_RISING>;
	};
	utos_tester {
		compatible = "microtrust,tester-v1";
	};

	mcdi@0011b000 {
		compatible = "mediatek,mt6779-mcdi";
		/* mediatek,enabled; */
		reg = <0 0x0011b000 0 0x800>,
		      <0 0x0c53a000 0 0x1000>;
	};

	msdc0:msdc@11230000 {
		compatible = "mediatek,msdc";
		reg = <0x0 0x11230000 0x0 0x10000>;
		interrupts = <GIC_SPI 101 IRQ_TYPE_LEVEL_LOW>;
	};

	msdc1:msdc@11240000 {
		compatible = "mediatek,msdc";
		reg = <0x0 0x11240000 0x0 0x10000>;
		interrupts = <GIC_SPI 102 IRQ_TYPE_LEVEL_LOW>;
	};

	msdc0_top@11f50000 {
		compatible = "mediatek,msdc0_top";
		reg = <0 0x11f50000 0 0x1000>;
	};

	msdc1_top@11e10000 {
		compatible = "mediatek,msdc1_top";
		reg = <0 0x11e10000 0 0x1000>;
	};

	ufshci:ufshci@11270000 {
		compatible = "mediatek,ufshci";
		reg = <0 0x11270000 0 0x2300>;
		interrupts = <GIC_SPI 104 IRQ_TYPE_LEVEL_LOW>;

		clocks =
			<&infracfg_ao INFRACFG_AO_UFS_CG>,
			<&infracfg_ao INFRACFG_AO_UNIPRO_SCK_CG>,
			<&infracfg_ao INFRACFG_AO_UFS_MP_SAP_BCLK_CG>;
		clock-names =
			"ufs0-clock",
			"ufs0-unipro-clk",
			"ufs0-mp-clk";
		freq-table-hz =
			<0 0>,
			<0 0>,
			<0 0>;

		/* Regulators */
		/* In MT67xx, only VCC is available to be controlled by UFS */
		/* driver */
		/* VCCQ:  Provided by external LDO. SW control is not */
		/* necessary */
		/* VCCQ2: Not supported by current UFS devices */
		vcc-supply = <&mt_pmic_vemc_ldo_reg>;
		vcc-fixed-regulator;

		/* Number of lanes available per direction - either 1 or 2 */
		lanes-per-direction = <1>;

		/* Auto-Hibern8 Timer. Unit: ms	(0 means disabled) */
		mediatek,auto-hibern8-timer = <10>;

		/* System Suspend Level */
		mediatek,spm-level = <3>;

		/* Runtime Suspend Configuration */
		/* 1. Runtime PM on/off (on: 1, off: 0) */
		mediatek,rpm-enable = <1>;

		/* 2. Auto Suspend Delay. Unit: ms */
		mediatek,rpm-autosuspend-delay = <2000>;

		/* 3. Runtime Suspend Level */
		mediatek,rpm-level = <3>;
	};

	ufs_mphy@11fa0000 {
		compatible = "mediatek,ufs_mphy";
		reg = <0 0x11fa0000 0 0xc000>;
	};

	gic: interrupt-controller {
		compatible = "arm,gic-v3";
		#interrupt-cells = <3>;
		#address-cells = <2>;
		#size-cells = <2>;
		#redistributor-regions = <1>;
		interrupt-parent = <&gic>;
		interrupt-controller;
		reg = <0 0x0c000000 0 0x40000>, // distributor
		      <0 0x0c040000 0 0x200000>; // redistributor
		interrupts = <GIC_PPI 9 IRQ_TYPE_LEVEL_HIGH>;
	};

	sysirq: intpol-controller@0 {
		compatible = "mediatek,mt6577-sysirq";
		interrupt-controller;
		#interrupt-cells = <3>;
		interrupt-parent = <&gic>;
		reg = <0 0x0c53a650 0 0x50>;
	};

	timer: timer {
		compatible = "arm,armv8-timer";
		interrupt-parent = <&gic>;
		interrupts = <GIC_PPI 13 IRQ_TYPE_LEVEL_LOW>,
				<GIC_PPI 14 IRQ_TYPE_LEVEL_LOW>,
				<GIC_PPI 11 IRQ_TYPE_LEVEL_LOW>,
				<GIC_PPI 10 IRQ_TYPE_LEVEL_LOW>;
		clock-frequency = <13000000>;
	};

	clocks {
		clk_null: clk_null {
			compatible = "fixed-clock";
			#clock-cells = <0>;
			clock-frequency = <0>;
		};

		clk26m: clk26m {
			compatible = "fixed-clock";
			#clock-cells = <0>;
			clock-frequency = <26000000>;
		};

		clk32k: clk32k {
			compatible = "fixed-clock";
			#clock-cells = <0>;
			clock-frequency = <32000>;
		};
	};

	topckgen: topckgen@10000000 {
		compatible = "mediatek,topckgen", "syscon";
		reg = <0 0x10000000 0 0x1000>;
		#clock-cells = <1>;
	};

	infracfg_ao: infracfg_ao@10001000 {
		compatible = "mediatek,infracfg_ao", "syscon";
		reg = <0 0x10001000 0 0x1000>;
		#clock-cells = <1>;
	};

	scpsys: scpsys@10001000 {
		compatible = "mediatek,scpsys";
		reg = <0 0x10001000 0 0x1000>,
				<0 0x10006000 0 0x1000>,
				<0 0x1020e000 0 0x1000>,
				<0 0x10000000 0 0x1000>,
				<0 0x14019000 0 0x1000>;
		#clock-cells = <1>;
	};

	scp@10500000 {
		compatible = "mediatek,scp";
		status = "okay";
		reg = <0 0x10500000 0 0x80000>,
				<0 0x105c0000 0 0x3000>,
				<0 0x105c4000 0 0x1000>,
				<0 0x105d4000 0 0x6000>;
		interrupts = <GIC_SPI 201 IRQ_TYPE_LEVEL_HIGH>;
		core_1 = "enable";
		scp_sramSize = <0x00080000>;
	};

	apdma: dma-controller@11000880 {
		compatible = "mediatek,mt6577-uart-dma";
		reg = <0 0x11000880 0 0x80>,
		      <0 0x11000900 0 0x80>,
		      <0 0x11000980 0 0x80>,
		      <0 0x11000A00 0 0x80>;
		interrupts = <GIC_SPI 134 IRQ_TYPE_LEVEL_LOW>,
			     <GIC_SPI 135 IRQ_TYPE_LEVEL_LOW>,
			     <GIC_SPI 136 IRQ_TYPE_LEVEL_LOW>,
			     <GIC_SPI 137 IRQ_TYPE_LEVEL_LOW>;
		clocks = <&infracfg_ao INFRACFG_AO_AP_DMA_CG>;
		clock-names = "apdma";
		#dma-cells = <1>;
	};

	apuart0: serial@11002000 {
		compatible = "mediatek,mt6577-uart";
		reg = <0 0x11002000 0 0x1000>;
		interrupts = <GIC_SPI 115 IRQ_TYPE_LEVEL_LOW>;
		clocks = <&clk26m>, <&infracfg_ao INFRACFG_AO_UART0_CG>;
		clock-names = "baud", "bus";
		dmas = <&apdma 0
				&apdma 1>;
		dma-names = "tx", "rx";
	};

	apuart1: serial@11003000 {
		compatible = "mediatek,mt6577-uart";
		reg = <0 0x11003000 0 0x1000>;
		interrupts = <GIC_SPI 116 IRQ_TYPE_LEVEL_LOW>;
		clocks =  <&clk26m>, <&infracfg_ao INFRACFG_AO_UART1_CG>;
		clock-names = "baud", "bus";
		dmas = <&apdma 2
				&apdma 3>;
		dma-names = "tx", "rx";
	};

	pwm: pwm@11006000 {
		compatible = "mediatek,pwm";
		reg = <0 0x11006000 0 0x1000>;
		interrupts = <GIC_SPI 99 IRQ_TYPE_LEVEL_LOW>;
		clocks = <&infracfg_ao INFRACFG_AO_PWM1_CG>,
			<&infracfg_ao INFRACFG_AO_PWM2_CG>,
			<&infracfg_ao INFRACFG_AO_PWM3_CG>,
			<&infracfg_ao INFRACFG_AO_PWM4_CG>,
			<&infracfg_ao INFRACFG_AO_PWM_HCLK_CG>,
			<&infracfg_ao INFRACFG_AO_PWM_CG>;
		clock-names = "PWM1-main",
			"PWM2-main",
			"PWM3-main",
			"PWM4-main",
			"PWM-HCLK-main",
			"PWM-main";
	};

	eem_fsm@1100b000 {
		compatible = "mediatek,eem_fsm";
		reg = <0 0x1100b000 0 0x1000>;
		interrupts = <GIC_SPI 150 IRQ_TYPE_LEVEL_LOW>;
	};

	disp_pwm0@1100e000 {
		compatible = "mediatek,disp_pwm0";
		reg = <0 0x1100e000 0 0x1000>;
		interrupts = <GIC_SPI 151 IRQ_TYPE_LEVEL_LOW>;
	};

	adsp: adsp@10600000 {
		compatible = "mediatek,audio_dsp";
		reg = <0 0x10600000 0 0x10000>, /*ctrl reg*/
			<0 0x10630000 0 0x9000>,	/* ITCM */
			<0 0x10610000 0 0x8000>;	/* DTCM */
		interrupts = <GIC_SPI 182 IRQ_TYPE_LEVEL_LOW>,
			     <GIC_SPI 183 IRQ_TYPE_LEVEL_LOW>;
		clocks = <&infracfg_ao INFRACFG_AO_FADSP_CG>,
				<&topckgen TOP_MUX_ADSP>,
				<&clk26m>,
				<&topckgen TOP_MMPLL_D4>,
				<&topckgen TOP_ADSPPLL_D4>,
				<&topckgen TOP_ADSPPLL_D6>;
		clock-names = "clk_adsp_infra",
				"clk_top_adsp_sel",
				"clk_adsp_clk26m",
				"clk_top_mmpll_d4",
				"clk_top_adsppll_d4",
				"clk_top_adsppll_d6";
	};

	sspm@10440000 {
		compatible = "mediatek,sspm";
		reg = <0 0x10440000 0 0x10000>,
			<0 0x10450000 0 0x100>,
			<0 0x10451000 0 0x8>,
			<0 0x10460000 0 0x100>,
			<0 0x10461000 0 0x8>,
			<0 0x10470000 0 0x100>,
			<0 0x10471000 0 0x8>,
			<0 0x10480000 0 0x100>,
			<0 0x10481000 0 0x8>,
			<0 0x10490000 0 0x100>,
			<0 0x10491000 0 0x8>;

		reg-names = "cfgreg",
			"mbox0_base",
			"mbox0_ctrl",
			"mbox1_base",
			"mbox1_ctrl",
			"mbox2_base",
			"mbox2_ctrl",
			"mbox3_base",
			"mbox3_ctrl",
			"mbox4_base",
			"mbox4_ctrl";

		interrupts = <GIC_SPI 232 IRQ_TYPE_LEVEL_HIGH>,
			<GIC_SPI 235 IRQ_TYPE_LEVEL_HIGH>,
			<GIC_SPI 236 IRQ_TYPE_LEVEL_HIGH>,
			<GIC_SPI 237 IRQ_TYPE_LEVEL_HIGH>,
			<GIC_SPI 238 IRQ_TYPE_LEVEL_HIGH>,
			<GIC_SPI 239 IRQ_TYPE_LEVEL_HIGH>;

		interrupt-names = "ipc",
			"mbox0",
			"mbox1",
			"mbox2",
			"mbox3",
			"mbox4";
	};

	infracfg_ao_mem@10002000 {
		compatible = "mediatek,infracfg_ao_mem";
		reg = <0 0x10002000 0 0x1000>;
	};

	pericfg@10003000 {
		compatible = "mediatek,pericfg";
		reg = <0 0x10003000 0 0x1000>;
	};

	gpio_usage_mapping:gpio {
		compatible = "mediatek,gpio_usage_mapping";
	};

	gpio: gpio@10005000 {
		compatible = "mediatek,gpio", "syscon";
		reg = <0 0x10005000 0 0x1000>;
	};

	iocfg_rm: iocfg_rm@11c20000 {
		compatible = "mediatek,iocfg_rm", "syscon";
		reg = <0 0x11c20000 0 0x1000>;
	};

	iocfg_br: iocfg_br@11d10000 {
		compatible = "mediatek,iocfg_br", "syscon";
		reg = <0 0x11d10000 0 0x1000>;
	};

	iocfg_lm: iocfg_lm@11e20000 {
		compatible = "mediatek,iocfg_lm", "syscon";
		reg = <0 0x11e20000 0 0x1000>;
	};

	iocfg_lb: iocfg_lb@11e70000 {
		compatible = "mediatek,iocfg_lb", "syscon";
		reg = <0 0x11e70000 0 0x1000>;
	};

	iocfg_rt: iocfg_rt@11ea0000 {
		compatible = "mediatek,iocfg_rt", "syscon";
		reg = <0 0x11ea0000 0 0x1000>;
	};

	iocfg_lt: iocfg_lt@11f20000 {
		compatible = "mediatek,iocfg_lt", "syscon";
		reg = <0 0x11f20000 0 0x1000>;
	};

	iocfg_tl: iocfg_tl@11f30000 {
		compatible = "mediatek,iocfg_tl", "syscon";
		reg = <0 0x11f30000 0 0x1000>;
	};

	pio: pinctrl@1000b000 {
		compatible = "mediatek,pinctrl";
		reg = <0 0x1000b000 0 0x1000>;
		mediatek,pctl-regmap = <&gpio>,
				       <&iocfg_rm>,
				       <&iocfg_br>,
				       <&iocfg_lm>,
				       <&iocfg_lb>,
				       <&iocfg_rt>,
				       <&iocfg_lt>,
				       <&iocfg_tl>;
		pins-are-numbered;
		gpio-controller;
		#gpio-cells = <2>;
		interrupt-controller;
		#interrupt-cells = <4>;
		interrupts = <GIC_SPI 201 IRQ_TYPE_LEVEL_HIGH>;
	};

	sleep@10006000 {
		compatible = "mediatek,sleep";
		reg = <0 0x10006000 0 0x1000>;
		interrupts = <GIC_SPI 213 IRQ_TYPE_LEVEL_LOW>;
	};

	toprgu@10007000 {
		compatible = "mediatek,toprgu";
		reg = <0 0x10007000 0 0x1000>;
		interrupts = <GIC_SPI 72 IRQ_TYPE_LEVEL_LOW>;
	};

	apxgpt@10008000 {
		compatible = "mediatek,apxgpt";
		reg = <0 0x10008000 0 0x1000>;
		interrupts = <GIC_SPI 203 IRQ_TYPE_LEVEL_LOW>;
	};

	sej@1000a000 {
		compatible = "mediatek,sej";
		reg = <0 0x1000a000 0 0x1000>;
		interrupts = <GIC_SPI 221 IRQ_TYPE_LEVEL_LOW>;
	};

	apirq@1000b000 {
		compatible = "mediatek,apirq";
		reg = <0 0x1000b000 0 0x1000>;
		interrupts = <GIC_SPI 204 IRQ_TYPE_LEVEL_HIGH>;
	};

	apmixed: apmixed@1000c000 {
		compatible = "mediatek,apmixed", "syscon";
		reg = <0 0x1000c000 0 0xe00>;
		#clock-cells = <1>;
	};

	audio: audio@11210000 {
		compatible = "mediatek,audio", "syscon";
		reg = <0 0x11210000 0 0x1000>;
		#clock-cells = <1>;
	};

	mfg_lorne@13000000 {
		compatible = "mediatek,lorne";
		reg = <0 0x13000000 0 0x80000>;
		interrupts = <GIC_SPI 304 IRQ_TYPE_LEVEL_LOW>;
		interrupt-names = "RGX";
		clock-frequency = <100000000>;
	};

	mfgcfg: mfgcfg@13fbf000 {
		compatible = "mediatek,mfgcfg", "syscon";
		reg = <0 0x13fbf000 0 0x1000>;
		#clock-cells = <1>;
	};
	gpufreq {
		compatible = "mediatek,mt6779-gpufreq";
		clocks =
			<&topckgen TOP_MUX_MFG>,
			<&topckgen TOP_MFGPLL_CK>,
			<&topckgen TOP_UNIVPLL_D3>,
			<&scpsys SCP_SYS_MFG0>,
			<&scpsys SCP_SYS_MFG1>,
			<&scpsys SCP_SYS_MFG2>,
			<&scpsys SCP_SYS_MFG3>;
		clock-names =
			"clk_mux",
			"clk_main_parent",
			"clk_sub_parent",
			"mtcmos_mfg_async",
			"mtcmos_mfg",
			"mtcmos_mfg_core0",
			"mtcmos_mfg_core1";
	};

	fhctl@1000ce00 {
		compatible = "mediatek,fhctl";
		reg = <0 0x1000ce00 0 0x200>;
	};

	pwrap: pwrap@1000d000 {
		compatible = "mediatek,pwrap";
		reg = <0 0x1000d000 0 0x1000>;
		interrupts = <GIC_SPI 212 IRQ_TYPE_LEVEL_HIGH>;

		main_pmic: mt-pmic {
			compatible = "mediatek,mt_pmic";
			interrupt-controller;
		};
	};

	sleep_reg_md@1000f000 {
		compatible = "mediatek,sleep_reg_md";
		reg = <0 0x1000f000 0 0x1000>;
	};

	keypad: kp@10010000 {
		compatible = "mediatek,kp";
		reg = <0 0x10010000 0 0x1000>;
		interrupts = <GIC_SPI 75 IRQ_TYPE_EDGE_FALLING>;
	};

	mrdump_ext_rst: mrdump_ext_rst {
		/*compatible = "mediatek, mrdump_ext_rst-eint";*/
		source = "EINT";
		mode = "IRQ";
		status = "okay";
	};

	touch: touch {
		compatible = "mediatek,touch";
	};

	topmisc@10011000 {
		compatible = "mediatek,topmisc";
		reg = <0 0x10011000 0 0x1000>;
	};

	dvfsrc@10012000 {
		compatible = "mediatek,dvfsrc";
		reg = <0 0x10012000 0 0x1000>,
			<0 0x0011bb80 0 0x80>;
	};

	mbist_ao@10013000 {
		compatible = "mediatek,mbist_ao";
		reg = <0 0x10013000 0 0x1000>;
	};

	apcldmain_ao@10014000 {
		compatible = "mediatek,apcldmain_ao";
		reg = <0 0x10014000 0 0x400>;
	};

	apcldmaout_ao@10014400 {
		compatible = "mediatek,apcldmaout_ao";
		reg = <0 0x10014400 0 0x400>;
	};

	apcldmamisc_ao@10014800 {
		compatible = "mediatek,apcldmamisc_ao";
		reg = <0 0x10014800 0 0x400>;
	};

	apcldmamisc_ao@10014c00 {
		compatible = "mediatek,apcldmamisc_ao";
		reg = <0 0x10014c00 0 0x400>;
	};

	devapc_mpu_ao@10015000 {
		compatible = "mediatek,devapc_mpu_ao";
		reg = <0 0x10015000 0 0x1000>;
	};

	mdcldmaout_ao@10015400 {
		compatible = "mediatek,mdcldmaout_ao";
		reg = <0 0x10015400 0 0x400>;
	};

	mdcldmamisc_ao@10015800 {
		compatible = "mediatek,mdcldmamisc_ao";
		reg = <0 0x10015800 0 0x400>;
	};

	aes_top0@10016000 {
		compatible = "mediatek,aes_top0";
		reg = <0 0x10016000 0 0x1000>;
	};

	sys_timer@10017000 {
		compatible = "mediatek,sys_timer";
		reg = <0 0x10017000 0 0x1000>;
		reg-names =
			"sys_timer_base";
		interrupts = <GIC_SPI 224 IRQ_TYPE_LEVEL_HIGH>;
		clocks =
			<&topckgen TOP_CLK13M>;
	};

	modem_temp_share@10018000 {
		compatible = "mediatek,modem_temp_share";
		reg = <0 0x10018000 0 0x1000>;
	};

	security_ao@1001a000 {
		compatible = "mediatek,security_ao";
		reg = <0 0x1001a000 0 0x1000>;
	};

	topckgen_ao@1001b000 {
		compatible = "mediatek,topckgen_ao";
		reg = <0 0x1001b000 0 0x1000>;
	};

	sleep_sram@1001e000 {
		compatible = "mediatek,sleep_sram";
		reg = <0 0x1001e000 0 0x1000>;
	};

	sleep_sram@1001f000 {
		compatible = "mediatek,sleep_sram";
		reg = <0 0x1001f000 0 0x1000>;
	};

	sleep_sram@10020000 {
		compatible = "mediatek,sleep_sram";
		reg = <0 0x10020000 0 0x1000>;
	};

	sleep_sram@10021000 {
		compatible = "mediatek,sleep_sram";
		reg = <0 0x10021000 0 0x1000>;
	};

	sys_cirq@10204000 {
		compatible = "mediatek,sys_cirq";
		reg = <0 0x10204000 0 0x1000>;
		interrupts = <GIC_SPI 335 IRQ_TYPE_LEVEL_LOW>;
	};

	mcucfg@10200000 {
		compatible = "mediatek,mcucfg";
		reg = <0 0x10200000 0 0x1000>;
		interrupts = <GIC_SPI 0 IRQ_TYPE_LEVEL_LOW>;
	};

	mcucfg@10201000 {
		compatible = "mediatek,mcucfg";
		reg = <0 0x10201000 0 0x1000>;
		interrupts = <GIC_SPI 1 IRQ_TYPE_LEVEL_LOW>;
	};

	mcucfg@10202000 {
		compatible = "mediatek,mcucfg";
		reg = <0 0x10202000 0 0x1000>;
		interrupts = <GIC_SPI 2 IRQ_TYPE_LEVEL_LOW>;
	};

	mcucfg@10203000 {
		compatible = "mediatek,mcucfg";
		reg = <0 0x10203000 0 0x1000>;
		interrupts = <GIC_SPI 3 IRQ_TYPE_LEVEL_LOW>;
	};

	devapc@10207000 {
		compatible = "mediatek,devapc";
		reg = <0 0x10207000 0 0x1000>;
		interrupts = <GIC_SPI 168 IRQ_TYPE_LEVEL_LOW>;
		clocks = <&infracfg_ao INFRACFG_AO_DEVICE_APC_CG>;
		clock-names = "devapc-infra-clock";
	};

	bus_dbg@10208000 {
		compatible = "mediatek,bus_dbg-v2";
		reg = <0 0x10208000 0 0x1000>,
			<0 0x10001000 0 0x1000>;
		mediatek,bus_dbg_con_offset = <0x2fc>;
		interrupts = <GIC_SPI 167 IRQ_TYPE_LEVEL_LOW>;
	};

	ap_ccif0@10209000 {
		compatible = "mediatek,ap_ccif0";
		reg = <0 0x10209000 0 0x1000>;
		interrupts = <GIC_SPI 174 IRQ_TYPE_LEVEL_LOW>;
	};

	md_ccif0@1020a000 {
		compatible = "mediatek,md_ccif0";
		reg = <0 0x1020a000 0 0x1000>;
	};

	ap_ccif1@1020b000 {
		compatible = "mediatek,ap_ccif1";
		reg = <0 0x1020b000 0 0x1000>;
		interrupts = <GIC_SPI 176 IRQ_TYPE_LEVEL_LOW>;
	};

	md_ccif1@1020c000 {
		compatible = "mediatek,md_ccif1";
		reg = <0 0x1020c000 0 0x1000>;
	};

	infra_mbist@1020d000 {
		compatible = "mediatek,infra_mbist";
		reg = <0 0x1020d000 0 0x1000>;
	};

	infracfg@1020e000 {
		compatible = "mediatek,infracfg";
		reg = <0 0x1020e000 0 0x1000>;
	};

	trng@1020f000 {
		compatible = "mediatek,trng";
		reg = <0 0x1020f000 0 0x1000>;
		interrupts = <GIC_SPI 197 IRQ_TYPE_LEVEL_LOW>;
	};

	dxcc_sec@10210000 {
		compatible = "mediatek,dxcc_sec";
		reg = <0 0x10210000 0 0x1000>;
		interrupts = <GIC_SPI 198 IRQ_TYPE_LEVEL_HIGH>;
	};

	md2md_md1_ccif0@10211000 {
		compatible = "mediatek,md2md_md1_ccif0";
		reg = <0 0x10211000 0 0x1000>;
	};

	cq_dma@10212000 {
		compatible = "mediatek,cq_dma";
		reg = <0 0x10212000 0 0x1000>;
		interrupts = <GIC_SPI 139 IRQ_TYPE_LEVEL_LOW>;
	};

	md2md_md2_ccif0@10213000 {
		compatible = "mediatek,md2md_md2_ccif0";
		reg = <0 0x10213000 0 0x1000>;
	};

	sramrom@10214000 {
		compatible = "mediatek,sramrom";
		reg = <0 0x10214000 0 0x1000>;
	};

	mipi_tx0@11e50000 {
		compatible = "mediatek,mipi_tx0";
		reg = <0 0x11e50000 0 0x1000>;
	};

	mipi_tx1@10216000 {
		compatible = "mediatek,mipi_tx1";
		reg = <0 0x10216000 0 0x1000>;
	};

	mipi_rx_ana_csi0@10217000 {
		compatible = "mediatek,mipi_rx_ana_csi0";
		reg = <0 0x10217000 0 0x1000>;
	};

	mipi_rx_ana_csi1@10218000 {
		compatible = "mediatek,mipi_rx_ana_csi1";
		reg = <0 0x10218000 0 0x1000>;
	};

	emi@10219000 {
		compatible = "mediatek,emi";
		reg = <0 0x10219000 0 0x1000>;
		interrupts = <GIC_SPI 170 IRQ_TYPE_LEVEL_LOW>;
	};

	infra_device_mpu@1021a000 {
		compatible = "mediatek,infra_device_mpu";
		reg = <0 0x1021a000 0 0x1000>;
	};

	infra_device_mpu@1021b000 {
		compatible = "mediatek,infra_device_mpu";
		reg = <0 0x1021b000 0 0x1000>;
	};

	infracfg_mem@1021c000 {
		compatible = "mediatek,infracfg_mem";
		reg = <0 0x1021c000 0 0x1000>;
	};

	apcldmain@1021b000 {
		compatible = "mediatek,apcldmain";
		reg = <0 0x1021b000 0 0x400>;
	};

	apcldmaout@1021b400 {
		compatible = "mediatek,apcldmaout";
		reg = <0 0x1021b400 0 0x400>;
	};

	apcldmamisc@1021b800 {
		compatible = "mediatek,apcldmamisc";
		reg = <0 0x1021b800 0 0x400>;
	};

	apcldmamisc@1021bc00 {
		compatible = "mediatek,apcldmamisc";
		reg = <0 0x1021bc00 0 0x400>;
	};

	mdcldmain@1021c000 {
		compatible = "mediatek,mdcldmain";
		reg = <0 0x1021c000 0 0x400>;
	};

	mdcldmaout@1021c400 {
		compatible = "mediatek,mdcldmaout";
		reg = <0 0x1021c400 0 0x400>;
	};

	mdcldmamisc@1021c800 {
		compatible = "mediatek,mdcldmamisc";
		reg = <0 0x1021c800 0 0x400>;
	};

	mdcldmamisc@1021cc00 {
		compatible = "mediatek,mdcldmamisc";
		reg = <0 0x1021cc00 0 0x400>;
	};

	infra_md@1021d000 {
		compatible = "mediatek,infra_md";
		reg = <0 0x1021d000 0 0x1000>;
	};

	bpi_bsi_slv0@1021e000 {
		compatible = "mediatek,bpi_bsi_slv0";
		reg = <0 0x1021e000 0 0x1000>;
	};

	bpi_bsi_slv1@1021f000 {
		compatible = "mediatek,bpi_bsi_slv1";
		reg = <0 0x1021f000 0 0x1000>;
	};

	bpi_bsi_slv2@10225000 {
		compatible = "mediatek,bpi_bsi_slv2";
		reg = <0 0x10225000 0 0x1000>;
	};

	m4u@10220000 {
		cell-index = <0>;
		compatible = "mediatek,mm_m4u";
		reg = <0 0x10220000 0 0x1000>;
		interrupts = <GIC_SPI 187 IRQ_TYPE_LEVEL_LOW>;
	};

	emi_mpu@10226000 {
		compatible = "mediatek,emi_mpu";
		reg = <0 0x10226000 0 0x1000>;
	};

	dvfsp@10227000 {
		compatible = "mediatek,dvfsp";
		reg = <0 0x10227000 0 0x1000>;
	};

	dvfsp@0011bc00 {
		compatible = "mediatek,mt6779-dvfsp";
		reg = <0 0x0011bc00 0 0x1400>,
		      <0 0x0011bc00 0 0x1400>;
	};

	mt_cpufreq: mt_cpufreq {
		compatible = "mediatek,mt-cpufreq";
	};

	gce_mbox: gce_mbox@10228000 {
		compatible = "mediatek,mailbox-gce";
		reg = <0 0x10228000 0 0x4000>;
		interrupts = <GIC_SPI 185 IRQ_TYPE_LEVEL_LOW>;
		#mbox-cells = <3>;
		#gce-event-cells = <1>;
		#gce-subsys-cells = <2>;
		max_prefetch_cnt = <4>;
		prefetch_size = <160 32 32 32>;
	};

	gce@10228000 {
		compatible = "mediatek,gce";
		reg = <0 0x10228000 0 0x4000>;
		interrupts = <GIC_SPI 185 IRQ_TYPE_LEVEL_LOW>,
			<GIC_SPI 186 IRQ_TYPE_LEVEL_LOW>;
		disp_mutex_reg = <0x14016000 0x1000>;
		g3d_config_base = <0x13000000 0 0xffff0000>;
		mmsys_config_base = <0x14000000 1 0xffff0000>;
		disp_dither_base = <0x14010000 2 0xffff0000>;
		mm_na_base = <0x14020000 3 0xffff0000>;
		imgsys_base = <0x15020000 4 0xffff0000>;
		vdec_gcon_base = <0x18800000 5 0xffff0000>;
		venc_gcon_base = <0x18810000 6 0xffff0000>;
		conn_peri_base = <0x18820000 7 0xffff0000>;
		topckgen_base = <0x18830000 8 0xffff0000>;
		kp_base = <0x18840000 9 0xffff0000>;
		scp_sram_base = <0x10000000 10 0xffff0000>;
		infra_na3_base = <0x10010000 11 0xffff0000>;
		infra_na4_base = <0x10020000 12 0xffff0000>;
		scp_base = <0x10030000 13 0xffff0000>;
		mcucfg_base = <0x10040000 14 0xffff0000>;
		gcpu_base = <0x10050000 15 0xffff0000>;
		usb0_base = <0x10200000 16 0xffff0000>;
		usb_sif_base = <0x10280000 17 0xffff0000>;
		audio_base = <0x17000000 18 0xffff0000>;
		vdec_base = <0x17010000 19 0xffff0000>;
		msdc2_base = <0x17020000 20 0xffff0000>;
		vdec1_base = <0x17030000 21 0xffff0000>;
		msdc3_base = <0x18000000 22 0xffff0000>;
		ap_dma_base = <0x18010000 23 0xffff0000>;
		gce_base = <0x18020000 24 0xffff0000>;
		vdec2_base = <0x18040000 25 0xffff0000>;
		vdec3_base = <0x18050000 26 0xffff0000>;
		camsys_base = <0x18080000 27 0xffff0000>;
		camsys1_base = <0x180a0000 28 0xffff0000>;
		camsys2_base = <0x180b0000 29 0xffff0000>;
		pwm_sw_base = <0x11000000 99 0xffff0000>;
		imgsys2_base = <0x15010000 99 0xffff0000>;
		ipesys_base = <0x1b000000 99 0xffff0000>;
		dpe_base = <0x1b100000 99 0xffff0000>;
		disp_rdma0_sof = <0>;
		disp_rdma1_sof = <1>;
		mdp_rdma0_sof = <2>;
		mdp_rdma1_sof = <3>;
		mdp_rsz0_sof = <4>;
		mdp_rsz1_sof = <5>;
		mdp_tdshp_sof = <6>;
		mdp_wrot0_sof = <7>;
		mdp_wrot1_sof = <8>;
		disp_ovl0_sof = <9>;
		disp_2l_ovl0_sof = <10>;
		disp_2l_ovl1_sof = <11>;
		disp_wdma0_sof = <12>;
		disp_color0_sof = <13>;
		disp_ccorr0_sof = <14>;
		disp_aal0_sof = <15>;
		disp_gamma0_sof = <16>;
		disp_dither0_sof = <17>;
		disp_pwm0_sof = <18>;
		disp_dsi0_sof = <19>;
		disp_dpi0_sof = <20>;
		disp_postmask0_sof = <21>;
		disp_rsz0_sof = <22>;
		mdp_aal_sof = <23>;
		mdp_ccorr_sof = <24>;
		disp_dbi0_sof = <25>;
		isp_relay_sof = <26>;
		ipu_relay_sof = <27>;
		disp_rdma0_frame_done = <28>;
		disp_rdma1_frame_done = <29>;
		mdp_rdma0_frame_done = <30>;
		mdp_rdma1_frame_done = <31>;
		mdp_rsz0_frame_done = <32>;
		mdp_rsz1_frame_done = <33>;
		mdp_tdshp_frame_done = <34>;
		mdp_wrot0_write_frame_done = <35>;
		mdp_wrot1_write_frame_done = <36>;
		disp_ovl0_frame_done = <37>;
		disp_2l_ovl0_frame_done = <38>;
		disp_2l_ovl1_frame_done = <39>;
		disp_wdma0_frame_done = <40>;
		disp_color0_frame_done = <41>;
		disp_ccorr0_frame_done = <42>;
		disp_aal0_frame_done = <43>;
		disp_gamma0_frame_done = <44>;
		disp_dither0_frame_done = <45>;
		disp_dsi0_frame_done = <46>;
		disp_dpi0_frame_done = <47>;
		disp_rsz0_frame_done = <49>;
		mdp_aal_frame_done = <50>;
		mdp_ccorr_frame_done = <51>;
		disp_postmask0_frame_done = <52>;
		stream_done_0 = <130>;
		stream_done_1 = <131>;
		stream_done_2 = <132>;
		stream_done_3 = <133>;
		stream_done_4 = <134>;
		stream_done_5 = <135>;
		stream_done_6 = <136>;
		stream_done_7 = <137>;
		stream_done_8 = <138>;
		stream_done_9 = <139>;
		stream_done_10 = <140>;
		stream_done_11 = <141>;
		buf_underrun_event_0 = <142>;
		buf_underrun_event_1 = <143>;
		buf_underrun_event_2 = <144>;
		buf_underrun_event_3 = <145>;
		dsi0_te_event = <146>;
		dsi0_irq_event = <147>;
		dsi0_done_event = <148>;
		disp_postmask0_frame_rst_done_pulse = <150>;
		disp_wdma0_rst_done = <151>;
		mdp_wrot0_rst_done = <153>;
		mdp_rdma0_rst_done = <154>;
		disp_ovl0_frame_rst_done_pusle = <155>;
		disp_ovl0_2l_frame_rst_done_pusle = <156>;
		disp_ovl1_2l_frame_rst_done_pusle = <157>;
		dip_cq_thread0_frame_done = <257>;
		dip_cq_thread1_frame_done = <258>;
		dip_cq_thread2_frame_done = <259>;
		dip_cq_thread3_frame_done = <260>;
		dip_cq_thread4_frame_done = <261>;
		dip_cq_thread5_frame_done = <262>;
		dip_cq_thread6_frame_done = <263>;
		dip_cq_thread7_frame_done = <264>;
		dip_cq_thread8_frame_done = <265>;
		dip_cq_thread9_frame_done = <266>;
		dip_cq_thread10_frame_done = <267>;
		dip_cq_thread11_frame_done = <268>;
		dip_cq_thread12_frame_done = <269>;
		dip_cq_thread13_frame_done = <270>;
		dip_cq_thread14_frame_done = <271>;
		dip_cq_thread15_frame_done = <272>;
		dip_cq_thread16_frame_done = <273>;
		dip_cq_thread17_frame_done = <274>;
		dip_cq_thread18_frame_done = <275>;
		dip_dma_err_event = <276>;
		amd_frame_done = <277>;
		mfb_done = <278>;
		wpe_a_frame_done = <279>;
		venc_done = <289>;
		venc_cmdq_pause_done = <290>;
		jpgenc_done = <291>;
		venc_mb_done = <292>;
		venc_128byte_cnt_done = <293>;
		isp_frame_done_a = <321>;
		isp_frame_done_b = <322>;
		isp_frame_done_c = <323>;
		camsv_0_pass1_done = <324>;
		camsv_0_2_pass1_done = <325>;
		camsv_1_pass1_done = <326>;
		camsv_2_pass1_done = <327>;
		camsv_3_pass1_done = <328>;
		tsf_done = <329>;
		seninf_0_fifo_full = <330>;
		seninf_1_fifo_full = <331>;
		seninf_2_fifo_full = <332>;
		seninf_3_fifo_full = <333>;
		seninf_4_fifo_full = <334>;
		seninf_5_fifo_full = <335>;
		seninf_6_fifo_full = <336>;
		seninf_7_fifo_full = <337>;
		tg_ovrun_a_int_dly = <338>;
		tg_ovrun_b_int_dly = <339>;
		tg_ovrun_c_int = <340>;
		tg_graberr_a_int_dly = <341>;
		tg_graberr_b_int_dly = <342>;
		tg_graberr_c_int = <343>;
		cq_vr_snap_a_int_dly = <344>;
		cq_vr_snap_b_int_dly = <345>;
		cq_vr_snap_c_int = <346>;
		dma_r1_error_a_int_dly = <347>;
		dma_r1_error_b_int_dly = <348>;
		dma_r1_error_c_int = <349>;
		apu_gce_core0_event_0 = <353>;
		apu_gce_core0_event_1 = <354>;
		apu_gce_core0_event_2 = <355>;
		apu_gce_core0_event_3 = <356>;
		apu_gce_core1_event_0 = <385>;
		apu_gce_core1_event_1 = <386>;
		apu_gce_core1_event_2 = <387>;
		apu_gce_core1_event_3 = <388>;
		vdec_event_0 = <416>;
		vdec_event_1 = <417>;
		vdec_event_2 = <418>;
		vdec_event_3 = <419>;
		vdec_event_4 = <420>;
		vdec_event_5 = <421>;
		vdec_event_6 = <422>;
		vdec_event_7 = <423>;
		vdec_event_8 = <424>;
		vdec_event_9 = <425>;
		vdec_event_10 = <426>;
		vdec_event_11 = <427>;
		vdec_event_12 = <428>;
		vdec_event_13 = <429>;
		vdec_event_14 = <430>;
		vdec_event_15 = <431>;
		fdvt_done = <449>;
		fe_done = <450>;
		rsc_frame_done = <451>;
		dvs_done_async_shot = <452>;
		dvp_done_async_shot = <453>;
		dsi0_te_from_infra = <898>;
		sram_size_cpr_64 = <656>;
		mmsys_config = <&mmsys_config>;
		mm_mutex = <&mm_mutex>;
		mdp_rdma0 = <&mdp_rdma0>;
		mdp_rdma1 = <&mdp_rdma1>;
		mdp_rsz0 = <&mdp_rsz0>;
		mdp_rsz1 = <&mdp_rsz1>;
		mdp_wrot0 = <&mdp_wrot0>;
		mdp_wrot1 = <&mdp_wrot1>;
		mdp_tdshp0 = <&mdp_tdshp>;
		mdp_aal0 = <&mdp_aal>;
		mdp_hdr0 = <&mdp_hdr>;
		mdp_color0 = <&disp_color0>;
		smi_larb0 = <&smi_larb0>;
		msdc0 = <&msdc0>;
		uart = <&apuart0>;
		mediatek,mailbox-gce = <&gce_mbox>;
		thread_count = <24>;
		secure_thread = <8 11>;
		mboxes = <&gce_mbox 0 0 CMDQ_THR_PRIO_4>,
			<&gce_mbox 1 0 CMDQ_THR_PRIO_4>,
			<&gce_mbox 2 0 CMDQ_THR_PRIO_5>,
			<&gce_mbox 3 0 CMDQ_THR_PRIO_4>,
			<&gce_mbox 4 0 CMDQ_THR_PRIO_4>,
			<&gce_mbox 5 0 CMDQ_THR_PRIO_4>,
			<&gce_mbox 6 0 CMDQ_THR_PRIO_4>,
			<&gce_mbox 7 CMDQ_NO_TIMEOUT CMDQ_THR_PRIO_2>,
#if defined(CONFIG_MTK_SEC_VIDEO_PATH_SUPPORT) || \
	defined(CONFIG_MTK_CAM_SECURITY_SUPPORT)
			<&gce_mbox_svp 8 0 CMDQ_THR_PRIO_4>,
			<&gce_mbox_svp 9 0 CMDQ_THR_PRIO_4>,
			<&gce_mbox_svp 10 0 CMDQ_THR_PRIO_1>,
			<&gce_mbox_svp 11 0 CMDQ_THR_PRIO_1>,
#else
			<&gce_mbox 8 0 CMDQ_THR_PRIO_1>,
			<&gce_mbox 9 0 CMDQ_THR_PRIO_1>,
			<&gce_mbox 10 0 CMDQ_THR_PRIO_1>,
			<&gce_mbox 11 0 CMDQ_THR_PRIO_1>,
#endif
			<&gce_mbox 12 0 CMDQ_THR_PRIO_1>,
			<&gce_mbox 13 0 CMDQ_THR_PRIO_1>,
			<&gce_mbox 14 0 CMDQ_THR_PRIO_1>,
#if defined(CONFIG_MTK_SEC_VIDEO_PATH_SUPPORT) || \
	defined(CONFIG_MTK_CAM_SECURITY_SUPPORT)
			<&gce_mbox 15 CMDQ_NO_TIMEOUT CMDQ_THR_PRIO_1>,
#else
			<&gce_mbox 15 0 CMDQ_THR_PRIO_1>,
#endif
			<&gce_mbox 18 0 CMDQ_THR_PRIO_1>,
			<&gce_mbox 19 0 CMDQ_THR_PRIO_1>,
			<&gce_mbox 20 0 CMDQ_THR_PRIO_1>,
			<&gce_mbox 21 0 CMDQ_THR_PRIO_1>,
			<&gce_mbox 22 0 CMDQ_THR_PRIO_1>,
			<&gce_mbox 23 0 CMDQ_THR_PRIO_1>;
		gce-subsys = <&gce_mbox 0x14000000 SUBSYS_1400XXXX>,
			<&gce_mbox 14010000 SUBSYS_1401XXXX>,
			<&gce_mbox 14020000 SUBSYS_1402XXXX>;
		gce-cpr-range = <0 GCE_CPR_COUNT>;
	};

	infra_dpmaif@1022c000 {
		compatible = "mediatek,infra_dpmaif";
		reg = <0 0x1022c000 0 0x1000>;
	};

	infra_dpmaif@1022d000 {
		compatible = "mediatek,infra_dpmaif";
		reg = <0 0x1022d000 0 0x1000>;
	};

	infra_dpmaif@1022e000 {
		compatible = "mediatek,infra_dpmaif";
		reg = <0 0x1022e000 0 0x1000>;
	};

	infra_dpmaif@1022f000 {
		compatible = "mediatek,infra_dpmaif";
		reg = <0 0x1022f000 0 0x1000>;
	};

	dramc_ch0_top0@10230000 {
		compatible = "mediatek,dramc_ch0_top0";
		reg = <0 0x10230000 0 0x2000>;
	};

	dramc_ch0_top1@10232000 {
		compatible = "mediatek,dramc_ch0_top1";
		reg = <0 0x10232000 0 0x2000>;
	};

	dramc_ch0_top2@10234000 {
		compatible = "mediatek,dramc_ch0_top2";
		reg = <0 0x10234000 0 0x1000>;
	};

	dramc_ch0_top3@10235000 {
		compatible = "mediatek,dramc_ch0_top3";
		reg = <0 0x10235000 0 0x1000>;
	};

	dramc_ch0_rsv@10236000 {
		compatible = "mediatek,dramc_ch0_rsv";
		reg = <0 0x10236000 0 0x2000>;
	};

	dramc_ch0_rsv@10238000 {
		compatible = "mediatek,dramc_ch0_rsv";
		reg = <0 0x10238000 0 0x2000>;
	};

	dramc_ch0_rsv@1023a000 {
		compatible = "mediatek,dramc_ch0_rsv";
		reg = <0 0x1023a000 0 0x2000>;
	};

	ap_ccif2@1023c000 {
		compatible = "mediatek,ap_ccif2";
		reg = <0 0x1023c000 0 0x1000>;
		interrupts = <GIC_SPI 179 IRQ_TYPE_LEVEL_LOW>;
	};

	md_ccif2@1023d000 {
		compatible = "mediatek,md_ccif2";
		reg = <0 0x1023d000 0 0x1000>;
	};

	ap_ccif2@1023e000 {
		compatible = "mediatek,ap_ccif2";
		reg = <0 0x1023e000 0 0x1000>;
	};

	md_ccif2@1023f000 {
		compatible = "mediatek,md_ccif2";
		reg = <0 0x1023f000 0 0x1000>;
	};

	dramc_ch1_top0@10240000 {
		compatible = "mediatek,dramc_ch1_top0";
		reg = <0 0x10240000 0 0x2000>;
	};

	dramc_ch1_top1@10242000 {
		compatible = "mediatek,dramc_ch1_top1";
		reg = <0 0x10242000 0 0x2000>;
	};

	dramc_ch1_top2@10244000 {
		compatible = "mediatek,dramc_ch1_top2";
		reg = <0 0x10244000 0 0x1000>;
	};

	dramc_ch1_top3@10245000 {
		compatible = "mediatek,dramc_ch1_top3";
		reg = <0 0x10245000 0 0x1000>;
	};

	dramc_ch1_rsv@10246000 {
		compatible = "mediatek,dramc_ch1_rsv";
		reg = <0 0x10246000 0 0x2000>;
	};

	dramc_ch1_rsv@10248000 {
		compatible = "mediatek,dramc_ch1_rsv";
		reg = <0 0x10248000 0 0x2000>;
	};

	dramc_ch1_rsv@1024a000 {
		compatible = "mediatek,dramc_ch1_rsv";
		reg = <0 0x1024a000 0 0x2000>;
	};

	ap_ccif4@1024c000 {
		compatible = "mediatek,ap_ccif4";
		reg = <0 0x1024c000 0 0x1000>;
	};

	md_ccif4@1024d000 {
		compatible = "mediatek,md_ccif4";
		reg = <0 0x1024d000 0 0x1000>;
	};

	md_ccif4@1024e000 {
		compatible = "mediatek,md_ccif4";
		reg = <0 0x1024e000 0 0x1000>;
	};

	m4u@1024f000 {
		cell-index = <1>;
		compatible = "mediatek,vpu_m4u";
		reg = <0 0x1024f000 0 0x1000>;
		interrupts = <GIC_SPI 192 IRQ_TYPE_LEVEL_LOW>;
	};

	mm_vpu_m0_sub_common@10254000 {
		compatible = "mediatek,mm_vpu_m0_sub_common";
		reg = <0 0x10254000 0 0x1000>;
	};

	mm_vpu_m1_sub_common@10255000 {
		compatible = "mediatek,mm_vpu_m1_sub_common";
		reg = <0 0x10255000 0 0x1000>;
	};

	axi2acp_sub_common@10256000 {
		compatible = "mediatek,axi2acp_sub_common";
		reg = <0 0x10256000 0 0x1000>;
	};

	gic500@0c000000 {
		compatible = "mediatek,gic500";
		reg = <0 0x0c000000 0 0x400000>;
	};

	gic_cpu@0c400000 {
		compatible = "mediatek,gic_cpu";
		reg = <0 0x0c400000 0 0x40000>;
	};

	dfd@0c600000 {
		compatible = "mediatek,dfd";
		reg = <0 0x0c600000 0 0x100000>;
	};

	dbg_ao@0d000000 {
		compatible = "mediatek,dbg_ao";
		reg = <0 0x0d000000 0 0x10000>;
	};

	dbg_cti@0d020000 {
		compatible = "mediatek,dbg_cti";
		reg = <0 0x0d020000 0 0x10000>;
	};

	dbg_etr@0d030000 {
		compatible = "mediatek,dbg_etr";
		reg = <0 0x0d030000 0 0x10000>;
	};

	dbg_dem@0d0a0000 {
		compatible = "mediatek,dbg_dem";
		reg = <0 0x0d0a0000 0 0x10000>;
		interrupts = <GIC_SPI 166 IRQ_TYPE_LEVEL_LOW>;
	};

	dbg_mdsys1@0d0c0000 {
		compatible = "mediatek,dbg_mdsys1";
		reg = <0 0x0d0c0000 0 0x40000>;
	};

	usb0:usb3@11200000 {
		compatible = "mediatek,usb3";
		reg = <0 0x11200000 0 0x10000>,
				<0 0x11203e00 0 0x100>,
				<0 0x11e40000 0 0x10000>;
		reg-names = "ssusb_base",
				"ssusb_ippc",
				"ssusb_sif2";
		interrupts = <GIC_SPI 96 IRQ_TYPE_LEVEL_LOW>;
		interrupt-names = "musb-hdrc";
		debug_level = <6>;
		fgpa_i2c_physical_base = <0x11009000>;
	};

	usbphy0:usbphy {
		compatible = "usb-nop-xceiv";
	};

	usb3_phy {
		compatible = "mediatek,usb3_phy";
		reg = <0 0x11E40000 0 0x10000>;
		reg-names = "sif_base";
		clocks = <&infracfg_ao INFRACFG_AO_USB_CG>,
			   <&infracfg_ao INFRACFG_AO_SSUSB_XHCI_CG>;
		clock-names = "ssusb_clk", "sys_ck";
		#phy-cells = <1>;
	};

	afe: mt6779-afe-pcm@11210000  {
		compatible = "mediatek,mt6779-sound";
		reg = <0 0x11210000 0 0x1000>;
		interrupts = <GIC_SPI 184 IRQ_TYPE_LEVEL_LOW>;
		clocks = <&audio AUDIO_AFE>,
			<&audio AUDIO_DAC>,
			<&audio AUDIO_DAC_PREDIS>,
			<&audio AUDIO_ADC>,
			<&audio AUDIO_PDN_ADDA6_ADC>,
			<&audio AUDIO_22M>,
			<&audio AUDIO_24M>,
			<&audio AUDIO_APLL_TUNER>,
			<&audio AUDIO_APLL2_TUNER>,
			<&audio AUDIO_TDM>,
			<&audio AUDIO_TML>,
			<&audio AUDIO_NLE>,
			<&audio AUDIO_DAC_HIRES>,
			<&audio AUDIO_ADC_HIRES>,
			<&audio AUDIO_ADC_HIRES_TML>,
			<&audio AUDIO_ADDA6_ADC_HIRES>,
			<&audio AUDIO_3RD_DAC>,
			<&audio AUDIO_3RD_DAC_PREDIS>,
			<&audio AUDIO_3RD_DAC_TML>,
			<&audio AUDIO_3RD_DAC_HIRES>,
			<&scpsys SCP_SYS_AUDIO>,
			<&infracfg_ao INFRACFG_AO_AUDIO_CG>,
			<&infracfg_ao INFRACFG_AO_AUDIO_26M_BCLK_CK>,
			<&topckgen TOP_MUX_AUDIO>,
			<&topckgen TOP_MUX_AUD_INTBUS>,
			<&topckgen TOP_MAINPLL_D2_D4>,
			<&topckgen TOP_MUX_AUD_1>,
			<&topckgen TOP_APLL1_CK>,
			<&topckgen TOP_MUX_AUD_2>,
			<&topckgen TOP_APLL2_CK>,
			<&topckgen TOP_MUX_AUD_ENG1>,
			<&topckgen TOP_APLL1_D8>,
			<&topckgen TOP_MUX_AUD_ENG2>,
			<&topckgen TOP_APLL2_D8>,
			<&topckgen TOP_I2S0_M_SEL>,
			<&topckgen TOP_I2S1_M_SEL>,
			<&topckgen TOP_I2S2_M_SEL>,
			<&topckgen TOP_I2S3_M_SEL>,
			<&topckgen TOP_I2S4_M_SEL>,
			<&topckgen TOP_I2S5_M_SEL>,
			<&topckgen TOP_APLL12_DIV0>,
			<&topckgen TOP_APLL12_DIV1>,
			<&topckgen TOP_APLL12_DIV2>,
			<&topckgen TOP_APLL12_DIV3>,
			<&topckgen TOP_APLL12_DIV4>,
			<&topckgen TOP_APLL12_DIVB>,
			<&topckgen TOP_APLL12_DIV5>,
			<&topckgen TOP_MUX_AUDIO_H>,
			<&clk26m>;
		clock-names = "aud_afe_clk",
			"aud_dac_clk",
			"aud_dac_predis_clk",
			"aud_adc_clk",
			"aud_adda6_adc_clk",
			"aud_apll22m_clk",
			"aud_apll24m_clk",
			"aud_apll1_tuner_clk",
			"aud_apll2_tuner_clk",
			"aud_tdm_clk",
			"aud_tml_clk",
			"aud_nle",
			"aud_dac_hires_clk",
			"aud_adc_hires_clk",
			"aud_adc_hires_tml",
			"aud_adda6_adc_hires_clk",
			"aud_3rd_dac_clk",
			"aud_3rd_dac_predis_clk",
			"aud_3rd_dac_tml",
			"aud_3rd_dac_hires_clk",
			"scp_sys_audio",
			"aud_infra_clk",
			"mtkaif_26m_clk",
			"top_mux_audio",
			"top_mux_audio_int",
			"top_mainpll_d2_d4",
			"top_mux_aud_1",
			"top_apll1_ck",
			"top_mux_aud_2",
			"top_apll2_ck",
			"top_mux_aud_eng1",
			"top_apll1_d8",
			"top_mux_aud_eng2",
			"top_apll2_d8",
			"top_i2s0_m_sel",
			"top_i2s1_m_sel",
			"top_i2s2_m_sel",
			"top_i2s3_m_sel",
			"top_i2s4_m_sel",
			"top_i2s5_m_sel",
			"top_apll12_div0",
			"top_apll12_div1",
			"top_apll12_div2",
			"top_apll12_div3",
			"top_apll12_div4",
			"top_apll12_divb",
			"top_apll12_div5",
			"top_mux_audio_h",
			"top_clk26m_clk";

		/* turn on after SB */
		/*assigned-clocks = <&topckgen TOP_MUX_AUDIO_H>;*/
		/*assigned-clock-parents = <&topckgen TOP_APLL1_CK>;*/

		pinctrl-names = "aud_clk_mosi_off",
				"aud_clk_mosi_on",
				"aud_dat_mosi_off",
				"aud_dat_mosi_on",
				"aud_dat_miso_off",
				"aud_dat_miso_on",
				"vow_dat_miso_off",
				"vow_dat_miso_on",
				"vow_clk_miso_off",
				"vow_clk_miso_on",
				"aud_nle_mosi_off",
				"aud_nle_mosi_on",
				"aud_dat_miso2_off",
				"aud_dat_miso2_on",
				"aud_gpio_i2s0_off",
				"aud_gpio_i2s0_on",
				"aud_gpio_i2s1_off",
				"aud_gpio_i2s1_on",
				"aud_gpio_i2s2_off",
				"aud_gpio_i2s2_on",
				"aud_gpio_i2s3_off",
				"aud_gpio_i2s3_on",
				"aud_gpio_i2s5_off",
				"aud_gpio_i2s5_on",
				"aud_dat_mosi_ch34_off",
				"aud_dat_mosi_ch34_on",
				"aud_dat_miso_ch34_off",
				"aud_dat_miso_ch34_on";
		pinctrl-0 = <&aud_clk_mosi_off>;
		pinctrl-1 = <&aud_clk_mosi_on>;
		pinctrl-2 = <&aud_dat_mosi_off>;
		pinctrl-3 = <&aud_dat_mosi_on>;
		pinctrl-4 = <&aud_dat_miso_off>;
		pinctrl-5 = <&aud_dat_miso_on>;
		pinctrl-6 = <&vow_dat_miso_off>;
		pinctrl-7 = <&vow_dat_miso_on>;
		pinctrl-8 = <&vow_clk_miso_off>;
		pinctrl-9 = <&vow_clk_miso_on>;
		pinctrl-10 = <&aud_nle_mosi_off>;
		pinctrl-11 = <&aud_nle_mosi_on>;
		pinctrl-12 = <&aud_dat_miso2_off>;
		pinctrl-13 = <&aud_dat_miso2_on>;
		pinctrl-14 = <&aud_gpio_i2s0_off>;
		pinctrl-15 = <&aud_gpio_i2s0_on>;
		pinctrl-16 = <&aud_gpio_i2s1_off>;
		pinctrl-17 = <&aud_gpio_i2s1_on>;
		pinctrl-18 = <&aud_gpio_i2s2_off>;
		pinctrl-19 = <&aud_gpio_i2s2_on>;
		pinctrl-20 = <&aud_gpio_i2s3_off>;
		pinctrl-21 = <&aud_gpio_i2s3_on>;
		pinctrl-22 = <&aud_gpio_i2s5_off>;
		pinctrl-23 = <&aud_gpio_i2s5_on>;
		pinctrl-24 = <&aud_dat_mosi_ch34_off>;
		pinctrl-25 = <&aud_dat_mosi_ch34_on>;
		pinctrl-26 = <&aud_dat_miso_ch34_off>;
		pinctrl-27 = <&aud_dat_miso_ch34_on>;
	};

	mt6359_snd: mt6359_snd {
		compatible = "mediatek,mt6359-sound";
		mediatek,pwrap-regmap = <&pwrap>;
	};

	auxadc: auxadc@11001000 {
		compatible = "mediatek,auxadc";
		reg = <0 0x11001000 0 0x1000>;
		interrupts = <GIC_SPI 64 IRQ_TYPE_EDGE_FALLING>;
		clocks = <&infracfg_ao INFRACFG_AO_AUXADC_CG>;
		clock-names = "auxadc-main";
	};

	sound: sound {
		compatible = "mediatek,mt6779-mt6359-sound";
		mediatek,audio-codec = <&mt6359_snd>;
		mediatek,platform = <&afe>;
		mtk_spk_i2s_out = <3>;
		mtk_spk_i2s_in = <0>;
		/* mtk_spk_i2s_mck = <3>; */
	};

	audio_sram@11211000 {
		compatible = "mediatek,audio_sram";
		reg = <0 0x11211000 0 0x18000>;
		prefer_mode = <1>;
		mode_size = <0x12000 0x18000>;
		block_size = <0x1000>;
	};

	mtk-btcvsd-snd@18050000 {
		compatible = "mediatek,mtk-btcvsd-snd";
		reg=<0 0x18050000 0 0x1000>, /*PKV_PHYSICAL_BASE*/
		    <0 0x18090000 0 0x10000>; /*SRAM_BANK2*/
		interrupts = <GIC_SPI 315 IRQ_TYPE_LEVEL_LOW>;
		mediatek,infracfg = <&infracfg_ao>;
		mediatek,offset =<0xf00 0x800 0x140 0x144 0x148>;
		/*INFRA MISC, conn_bt_cvsd_mask*/
		/*cvsd_mcu_read, write, packet_indicator*/
	};

	i2c_common: i2c_common {
		compatible = "mediatek,i2c_common";
		dma_support = /bits/ 8 <2>;
		idvfs = /bits/ 8 <1>;
		set_dt_div = /bits/ 8 <1>;
		check_max_freq = /bits/ 8 <1>;
		ver = /bits/ 8 <2>;
		set_ltiming = /bits/ 8 <1>;
		ext_time_config = /bits/ 16 <0x1801>;
		cnt_constraint = /bits/ 8 <1>;
	};

	i2c0: i2c0@11007000 {
		compatible = "mediatek,i2c";
		id = <0>;
		reg = <0 0x11007000 0 0x1000>,
			<0 0x11000080 0 0x80>;
		interrupts = <GIC_SPI 105 IRQ_TYPE_LEVEL_LOW>;
		clocks = <&infracfg_ao INFRACFG_AO_I2C0_CG>,
			<&infracfg_ao INFRACFG_AO_AP_DMA_CG>;
		clock-names = "main", "dma";
		clock-div = <5>;
		aed = <0x1a>;
		mediatek,hs_only;
	};

	i2c1: i2c1@11008000 {
		compatible = "mediatek,i2c";
		id = <1>;
		reg = <0 0x11008000 0 0x1000>,
			<0 0x11000100 0 0x80>;
		interrupts = <GIC_SPI 106 IRQ_TYPE_LEVEL_LOW>;
		clocks = <&infracfg_ao INFRACFG_AO_I2C0_CG>,
			<&infracfg_ao INFRACFG_AO_AP_DMA_CG>;
		clock-names = "main", "dma";
		clock-div = <5>;
		aed = <0x1a>;
		mediatek,hs_only;
	};

	i2c2: i2c2@11009000 {
		compatible = "mediatek,i2c";
		id = <2>;
		reg = <0 0x11009000 0 0x1000>,
			<0 0x11000180 0 0x180>;
		interrupts = <GIC_SPI 107 IRQ_TYPE_LEVEL_LOW>;
		clocks = <&infracfg_ao INFRACFG_AO_I2C0_CG>,
			<&infracfg_ao INFRACFG_AO_AP_DMA_CG>;
		clock-names = "main", "dma";
		clock-div = <5>;
		aed = <0x1a>;
		ch_offset_default = <0x100>;
		ch_offset_ccu = <0x200>;
		mediatek,hs_only;
	};

	i2c3: i2c3@1100f000 {
		compatible = "mediatek,i2c";
		id = <3>;
		reg = <0 0x1100f000 0 0x1000>,
			<0 0x11000300 0 0x100>;
		interrupts = <GIC_SPI 108 IRQ_TYPE_LEVEL_LOW>;
		clocks = <&infracfg_ao INFRACFG_AO_I2C0_CG>,
			<&infracfg_ao INFRACFG_AO_AP_DMA_CG>;
		clock-names = "main", "dma";
		clock-div = <5>;
		aed = <0x1a>;
		mediatek,hs_only;
	};

	i2c4: i2c4@11011000 {
		compatible = "mediatek,i2c";
		id = <4>;
		reg = <0 0x11011000 0 0x1000>,
			<0 0x11000400 0 0x180>;
		interrupts = <GIC_SPI 109 IRQ_TYPE_LEVEL_LOW>;
		clocks = <&infracfg_ao INFRACFG_AO_I2C0_CG>,
			<&infracfg_ao INFRACFG_AO_AP_DMA_CG>;
		clock-names = "main", "dma";
		clock-div = <5>;
		aed = <0x1a>;
		ch_offset_default = <0x100>;
		ch_offset_ccu = <0x200>;
		mediatek,hs_only;
	};

	i2c5: i2c5@11016000 {
		compatible = "mediatek,i2c";
		id = <5>;
		reg = <0 0x11016000 0 0x1000>,
			<0 0x11000580 0 0x80>;
		interrupts = <GIC_SPI 110 IRQ_TYPE_LEVEL_LOW>;
		clocks = <&infracfg_ao INFRACFG_AO_I2C0_CG>,
			<&infracfg_ao INFRACFG_AO_AP_DMA_CG>;
		clock-names = "main", "dma";
		clock-div = <5>;
		aed = <0x1a>;
		mediatek,hs_only;
	};

	i2c6: i2c6@11005000 {
		compatible = "mediatek,i2c";
		id = <6>;
		reg = <0 0x11005000 0 0x1000>,
			<0 0x11000600 0 0x80>;
		interrupts = <GIC_SPI 111 IRQ_TYPE_LEVEL_LOW>;
		clocks = <&infracfg_ao INFRACFG_AO_I2C0_CG>,
			<&infracfg_ao INFRACFG_AO_AP_DMA_CG>;
		clock-names = "main", "dma";
		clock-div = <5>;
		aed = <0x1a>;
		ch_offset_default = <0x100>;
		mediatek,hs_only;
	};
	i2c7: i2c7@1101a000 {
		compatible = "mediatek,i2c";
		id = <7>;
		reg = <0 0x1101a000 0 0x1000>,
			<0 0x11000680 0 0x80>;
		interrupts = <GIC_SPI 112 IRQ_TYPE_LEVEL_LOW>;
		clocks = <&infracfg_ao INFRACFG_AO_I2C0_CG>,
			<&infracfg_ao INFRACFG_AO_AP_DMA_CG>;
		clock-names = "main", "dma";
		clock-div = <5>;
		aed = <0x1a>;
		ch_offset_default = <0x100>;
		mediatek,hs_only;
	};
	i2c8: i2c8@1101b000 {
		compatible = "mediatek,i2c";
		id = <8>;
		reg = <0 0x1101b000 0 0x1000>,
			<0 0x11000780 0 0x80>;
		interrupts = <GIC_SPI 113 IRQ_TYPE_LEVEL_LOW>;
		clocks = <&infracfg_ao INFRACFG_AO_I2C0_CG>,
			<&infracfg_ao INFRACFG_AO_AP_DMA_CG>;
		clock-names = "main", "dma";
		clock-div = <5>;
		aed = <0x1a>;
		mediatek,hs_only;
	};
	i2c9: i2c9@11015000 {
		compatible = "mediatek,i2c";
		id = <9>;
		reg = <0 0x11015000 0 0x1000>,
			<0 0x11000800 0 0x80>;
		interrupts = <GIC_SPI 114 IRQ_TYPE_LEVEL_LOW>;
		clocks = <&infracfg_ao INFRACFG_AO_I2C0_CG>,
			<&infracfg_ao INFRACFG_AO_AP_DMA_CG>;
		clock-names = "main", "dma";
		clock-div = <5>;
		aed = <0x1a>;
		mediatek,hs_only;
	};
	spi0: spi@1100a000 {
		compatible = "mediatek,mt6765-spi";
		mediatek,pad-select = <0>;
		reg = <0 0x1100a000 0 0x1000>;
		interrupts = <GIC_SPI 143 IRQ_TYPE_LEVEL_LOW>;
		clocks = <&topckgen TOP_MAINPLL_D5_D2>,
			 <&topckgen TOP_MUX_SPI>,
			 <&infracfg_ao INFRACFG_AO_SPI0_CG>;
		clock-names = "parent-clk", "sel-clk", "spi-clk";
	};
	spi1: spi@11010000 {
		compatible = "mediatek,mt6765-spi";
		mediatek,pad-select = <0>;
		reg = <0 0x11010000 0 0x1000>;
		interrupts = <GIC_SPI 147 IRQ_TYPE_LEVEL_LOW>;
		clocks = <&topckgen TOP_MAINPLL_D5_D2>,
			 <&topckgen TOP_MUX_SPI>,
			 <&infracfg_ao INFRACFG_AO_SPI1_CG>;
		clock-names = "parent-clk", "sel-clk", "spi-clk";
	};
	spi2: spi@11012000 {
		compatible = "mediatek,mt6765-spi";
		mediatek,pad-select = <0>;
		reg = <0 0x11012000 0 0x1000>;
		interrupts = <GIC_SPI 152 IRQ_TYPE_LEVEL_LOW>;
		clocks = <&topckgen TOP_MAINPLL_D5_D2>,
			 <&topckgen TOP_MUX_SPI>,
			 <&infracfg_ao INFRACFG_AO_SPI2_CG>;
		clock-names = "parent-clk", "sel-clk", "spi-clk";
	};
	spi3: spi@11013000 {
		compatible = "mediatek,mt6765-spi";
		mediatek,pad-select = <0>;
		reg = <0 0x11013000 0 0x1000>;
		interrupts = <GIC_SPI 153 IRQ_TYPE_LEVEL_LOW>;
		clocks = <&topckgen TOP_MAINPLL_D5_D2>,
			 <&topckgen TOP_MUX_SPI>,
			 <&infracfg_ao INFRACFG_AO_SPI3_CG>;
		clock-names = "parent-clk", "sel-clk", "spi-clk";
	};
	spi4: spi@11018000 {
		compatible = "mediatek,mt6765-spi";
		mediatek,pad-select = <0>;
		reg = <0 0x11018000 0 0x1000>;
		interrupts = <GIC_SPI 156 IRQ_TYPE_LEVEL_LOW>;
		clocks = <&topckgen TOP_MAINPLL_D5_D2>,
			 <&topckgen TOP_MUX_SPI>,
			 <&infracfg_ao INFRACFG_AO_SPI4_CG>;
		clock-names = "parent-clk", "sel-clk", "spi-clk";
	};
	spi5: spi@11019000 {
		compatible = "mediatek,mt6765-spi";
		mediatek,pad-select = <0>;
		reg = <0 0x11019000 0 0x1000>;
		interrupts = <GIC_SPI 157 IRQ_TYPE_LEVEL_LOW>;
		clocks = <&topckgen TOP_MAINPLL_D5_D2>,
			 <&topckgen TOP_MUX_SPI>,
			 <&infracfg_ao INFRACFG_AO_SPI5_CG>;
		clock-names = "parent-clk", "sel-clk", "spi-clk";
	};
	spi6: spi@1101d000 {
		compatible = "mediatek,mt6765-spi";
		mediatek,pad-select = <0>;
		reg = <0 0x1101d000 0 0x1000>;
		interrupts = <GIC_SPI 144 IRQ_TYPE_LEVEL_LOW>;
		clocks = <&topckgen TOP_MAINPLL_D5_D2>,
			 <&topckgen TOP_MUX_SPI>,
			 <&infracfg_ao INFRACFG_AO_SPI6_CG>;
		clock-names = "parent-clk", "sel-clk", "spi-clk";
	};
	spi7: spi@1101e000 {
		compatible = "mediatek,mt6765-spi";
		mediatek,pad-select = <0>;
		reg = <0 0x1101e000 0 0x1000>;
		interrupts = <GIC_SPI 145 IRQ_TYPE_LEVEL_LOW>;
		clocks = <&topckgen TOP_MAINPLL_D5_D2>,
			 <&topckgen TOP_MUX_SPI>,
			 <&infracfg_ao INFRACFG_AO_SPI7_CG>;
		clock-names = "parent-clk", "sel-clk", "spi-clk";
	};

	dfd@13fc0000 {
		compatible = "mediatek,dfd";
		reg = <0 0x13fc0000 0 0x40000>;
	};

	g3d_config@13fbf000 {
		compatible = "mediatek,g3d_config";
		reg = <0 0x13fbf000 0 0x1000>;
	};

	g3d_dvfs@13fbc000 {
		compatible = "mediatek,g3d_dvfs";
		reg = <0 0x13fbc000 0 0x1000>;
	};

	g3d_ip@13000000 {
		compatible = "mediatek,g3d_ip";
		reg = <0 0x13000000 0 0x800000>;
	};

	g3d_ip@13010000 {
		compatible = "mediatek,g3d_ip";
		reg = <0 0x13010000 0 0x10000>;
	};

	g3d_ip@13020000 {
		compatible = "mediatek,g3d_ip";
		reg = <0 0x13020000 0 0x10000>;
	};

	g3d_ip@13030000 {
		compatible = "mediatek,g3d_ip";
		reg = <0 0x13030000 0 0x10000>;
	};

	g3d_ip@13040000 {
		compatible = "mediatek,g3d_ip";
		reg = <0 0x13040000 0 0x10000>;
	};

	g3d_ip@13050000 {
		compatible = "mediatek,g3d_ip";
		reg = <0 0x13050000 0 0x10000>;
	};

	g3d_ip@13060000 {
		compatible = "mediatek,g3d_ip";
		reg = <0 0x13060000 0 0x10000>;
	};

	g3d_ip@13070000 {
		compatible = "mediatek,g3d_ip";
		reg = <0 0x13070000 0 0x10000>;
	};

	g3d_ip@13080000 {
		compatible = "mediatek,g3d_ip";
		reg = <0 0x13080000 0 0x10000>;
	};

	mmsys_config: mmsys_config@14000000 {
		compatible = "mediatek,mmsys_config", "syscon";
		reg = <0 0x14000000 0 0x1000>;
		interrupts = <GIC_SPI 263 IRQ_TYPE_LEVEL_LOW>;
		#clock-cells = <1>;
		clocks = <&mmsys_config MMSYS_MDP_DL_TXCK>,
				<&mmsys_config MMSYS_MDP_DL_RX_CK>,
				<&mmsys_config MMSYS_IPU_DL_TXCK>,
				<&mmsys_config MMSYS_IPU_DL_RX_CK>;
		clock-names = "CAM_MDP_TX",
				"CAM_MDP_RX",
				"CAM_MDP2_TX",
				"CAM_MDP2_RX";
	};

	accdet: accdet {
		compatible = "mediatek,pmic-accdet";
	};

	mt6359_gauge {
		compatible = "mediatek,mt6359_gauge";
		gauge_name = "gauge";
		alias_name = "mt6359";
	};

	gauge_timer {
		compatible = "mediatek,gauge_timer_service";
	};

#if (CONFIG_MTK_ADDITIONAL_BATTERY_TABLE == 1)
	#include "bat_setting/mt6779_battery_prop_ext.dtsi"
#else
	#include "bat_setting/mt6779_battery_prop.dtsi"
#endif

	mdp_rdma0: mdp_rdma0@14001000 {
		compatible = "mediatek,mdp_rdma0";
		reg = <0 0x14001000 0 0x1000>;
		interrupts = <GIC_SPI 242 IRQ_TYPE_LEVEL_LOW>;
		clocks = <&mmsys_config MMSYS_MDP_RDMA0>;
		clock-names = "MDP_RDMA0";
	};

	mdp_rdma1: mdp_rdma1@14002000 {
		compatible = "mediatek,mdp_rdma1";
		reg = <0 0x14002000 0 0x1000>;
		interrupts = <GIC_SPI 243 IRQ_TYPE_LEVEL_LOW>;
		clocks = <&mmsys_config MMSYS_MDP_RDMA1>;
		clock-names = "MDP_RDMA1";
	};

	mdp_rsz0: mdp_rsz0@14003000 {
		compatible = "mediatek,mdp_rsz0";
		reg = <0 0x14003000 0 0x1000>;
		interrupts = <GIC_SPI 244 IRQ_TYPE_LEVEL_LOW>;
		clocks = <&mmsys_config MMSYS_MDP_RSZ0>;
		clock-names = "MDP_RSZ0";
	};

	mdp_rsz1: mdp_rsz1@14004000 {
		compatible = "mediatek,mdp_rsz1";
		reg = <0 0x14004000 0 0x1000>;
		interrupts = <GIC_SPI 245 IRQ_TYPE_LEVEL_LOW>;
		clocks = <&mmsys_config MMSYS_MDP_RSZ1>;
		clock-names = "MDP_RSZ1";
	};

	mdp_wrot0: mdp_wrot0@14005000 {
		compatible = "mediatek,mdp_wrot0";
		reg = <0 0x14005000 0 0x1000>;
		interrupts = <GIC_SPI 247 IRQ_TYPE_LEVEL_LOW>;
		clocks = <&mmsys_config MMSYS_MDP_WROT0>;
		clock-names = "MDP_WROT0";
	};

	mdp_tdshp: mdp_tdshp@14007000 {
		compatible = "mediatek,mdp_tdshp";
		reg = <0 0x14007000 0 0x1000>;
		interrupts = <GIC_SPI 246 IRQ_TYPE_LEVEL_LOW>;
		clocks = <&mmsys_config MMSYS_MDP_TDSHP>;
		clock-names = "MDP_TDSHP";
	};

	mtkfb {
		compatible = "mediatek,mtkfb";
	};

	dispsys {
		compatible = "mediatek,dispsys";
	};

	dsi_te: dsi_te {
		compatible = "mediatek, dsi_te-eint";
		status = "disabled";
	};

	disp_ovl0@14008000 {
		compatible = "mediatek,disp_ovl0";
		reg = <0 0x14008000 0 0x1000>;
		interrupts = <GIC_SPI 249 IRQ_TYPE_LEVEL_LOW>;
	};

	disp_ovl0_2l@14009000 {
		compatible = "mediatek,disp_ovl0_2l";
		reg = <0 0x14009000 0 0x1000>;
		interrupts = <GIC_SPI 250 IRQ_TYPE_LEVEL_LOW>;
	};

	disp_ovl1_2l@1400a000 {
		compatible = "mediatek,disp_ovl1_2l";
		reg = <0 0x1400a000 0 0x1000>;
		interrupts = <GIC_SPI 251 IRQ_TYPE_LEVEL_LOW>;
	};

	disp_rdma0@1400b000 {
		compatible = "mediatek,disp_rdma0";
		reg = <0 0x1400b000 0 0x1000>;
		interrupts = <GIC_SPI 252 IRQ_TYPE_LEVEL_LOW>;
	};

	disp_rdma1@1400c000 {
		compatible = "mediatek,disp_rdma1";
		reg = <0 0x1400c000 0 0x1000>;
		interrupts = <GIC_SPI 253 IRQ_TYPE_LEVEL_LOW>;
	};

	disp_wdma0@1400d000 {
		compatible = "mediatek,disp_wdma0";
		reg = <0 0x1400d000 0 0x1000>;
		interrupts = <GIC_SPI 254 IRQ_TYPE_LEVEL_LOW>;
	};

	disp_color0: disp_color0@1400e000 {
		compatible = "mediatek,disp_color0";
		reg = <0 0x1400e000 0 0x1000>;
		interrupts = <GIC_SPI 255 IRQ_TYPE_LEVEL_LOW>;
		clocks = <&mmsys_config MMSYS_DISP_COLOR0>;
		clock-names = "MDP_COLOR";
	};

	disp_ccorr0@1400f000 {
		compatible = "mediatek,disp_ccorr0";
		reg = <0 0x1400f000 0 0x1000>;
		interrupts = <GIC_SPI 256 IRQ_TYPE_LEVEL_LOW>;
	};

	disp_aal0@14010000 {
		compatible = "mediatek,disp_aal0";
		reg = <0 0x14010000 0 0x1000>;
		interrupts = <GIC_SPI 257 IRQ_TYPE_LEVEL_LOW>;
	};

	disp_gamma0@14011000 {
		compatible = "mediatek,disp_gamma0";
		reg = <0 0x14011000 0 0x1000>;
		interrupts = <GIC_SPI 258 IRQ_TYPE_LEVEL_LOW>;
	};

	disp_dither0@14012000 {
		compatible = "mediatek,disp_dither0";
		reg = <0 0x14012000 0 0x1000>;
		interrupts = <GIC_SPI 259 IRQ_TYPE_LEVEL_LOW>;
	};

	dsi_split@14013000 {
		compatible = "mediatek,dsi_split";
		reg = <0 0x14013000 0 0x1000>;
	};

	dsi0@14014000 {
		compatible = "mediatek,dsi0";
		reg = <0 0x14014000 0 0x1000>;
		interrupts = <GIC_SPI 260 IRQ_TYPE_LEVEL_LOW>;
	};

	dsi1@14015000 {
		compatible = "mediatek,dsi1";
		reg = <0 0x14015000 0 0x1000>;
	};

	mm_mutex: mm_mutex@14016000 {
		compatible = "mediatek,mm_mutex";
		reg = <0 0x14016000 0 0x1000>;
		interrupts = <GIC_SPI 241 IRQ_TYPE_LEVEL_LOW>;
	};

	smi_larb0: smi_larb0@14017000 {
		compatible = "mediatek,smi_larb0", "mediatek,smi_larb";
		reg = <0 0x14017000 0 0x1000>;
		interrupts = <GIC_SPI 264 IRQ_TYPE_LEVEL_LOW>;
		clocks = <&scpsys SCP_SYS_DIS>;
		clock-names = "mtcmos-dis";
		cell-index = <0>;
	};

	smi_larb1: smi_larb1@14018000 {
		compatible = "mediatek,smi_larb1", "mediatek,smi_larb";
		reg = <0 0x14018000 0 0x1000>;
		interrupts = <GIC_SPI 262 IRQ_TYPE_LEVEL_LOW>;
		clocks = <&scpsys SCP_SYS_DIS>;
		clock-names = "mtcmos-dis";
		cell-index = <1>;
	};

	smi_common@14019000 {
		compatible = "mediatek,smi_common";
		reg = <0 0x14019000 0 0x1000>;
		clocks = <&scpsys SCP_SYS_DIS>,
			<&mmsys_config MMSYS_GALS_COMM0>,
			<&mmsys_config MMSYS_GALS_COMM1>,
			<&mmsys_config MMSYS_SMI_COMMON>;
		clock-names = "mtcmos-dis",
			"gals-comm0", "gals-comm1", "mm-common";
		nr_larbs = <12>;
		mmsys_config = <&mmsys_config>;
	};

	mmdvfs_pmqos {
		compatible = "mediatek,mmdvfs_pmqos";
		larb_groups = <0 1 2 3 5 8 9 10>;
		larb0 = <7 7 7 7 7 7 7 8 7>;
		larb1 = <7 7 7 7 7 7 7 7 7 8 7 8 7 7>;
		larb2 = <7 7 8 7 7 7 7 7 7 7 8 7>;
		larb3 = <7 8 8 8 7 7 7 7 7 7 8 8 8 8 8 7
					7 7 7>;
		larb5 = <7 7 7 7 7 7 8 8 8 8 7 7 7 8 8 7
					7 6 6 8 7 7 7 7 7 7>;
		larb8 = <7 7 8 8 7 7 8 8 6 7>;
		larb9 = <8 8 7 7 8 7 7 7 8 8 8 8 8 8 8 8
					8 8 8 8 8 7 8 8>;
		larb10 = <8 8 7 7 8 7 7 7 8 8 7 7 8 7 7 7
					8 8 8 8 8 8 8 8 8 8 8 8 8 8 8>;
		cam_larb = <9 10 14>; /* include SMI common CCU */
		mm_step0 = <606 1 0 10>;
		mm_step1 = <450 1 0 14>;
		mm_step2 = <315 1 0 17>;
		cam_step0 = <560 1 1 11>;
		cam_step0_P95 = <546 1 1 12>;
		cam_step1 = <416 1 1 15>;
		cam_step2 = <315 1 1 17>;
		ccu_step0 = <560 1 7 11>;
		ccu_step0_P95 = <546 1 7 12>;
		ccu_step1 = <416 1 7 15>;
		ccu_step2 = <315 1 7 17>;
		img_step0 = <606 1 2 10>;
		img_step1 = <416 1 2 15>;
		img_step2 = <315 1 2 17>;
		img_step_limit_0 = <546 1 2 12>;
		ipe_step0 = <546 1 3 12>;
		ipe_step1 = <416 1 3 15>;
		ipe_step2 = <315 1 3 17>;
		dpe_step0 = <546 1 6 12>;
		dpe_step1 = <416 1 6 15>;
		dpe_step2 = <364 1 6 16>;
		venc_step0 = <630 1 4 8>;
		venc_step1 = <450 1 4 14>;
		venc_step2 = <364 1 4 16>;
		vdec_step0 = <624 1 5 9>;
		vdec_step1 = <416 1 5 15>;
		vdec_step2 = <312 1 5 18>;
		/* fmeter_mux_ids: Mapping to mux sequence in clocks */
		fmeter_mux_ids = <2 8 5 6 50 51 7 9>;
		vopp_steps = <0 1 2>;
		disp_freq = "mm_step0", "mm_step1", "mm_step2";
		mdp_freq = "mm_step0", "mm_step1", "mm_step2";
		cam_freq = "cam_step0","cam_step1","cam_step2";
		ccu_freq = "ccu_step0","ccu_step1","ccu_step2";
		img_freq = "img_step0","img_step1","img_step2";
		vdec_freq = "vdec_step0","vdec_step1","vdec_step2";
		venc_freq = "venc_step0","venc_step1","venc_step2";
		ipe_freq = "ipe_step0","ipe_step1","ipe_step2";
		dpe_freq = "dpe_step0","dpe_step1","dpe_step2";
		img_freq_limit_size = <3>;
		img_freq_limit_0 = "img_step_limit_0","img_step1","img_step2";
		img_freq_limit_1 = "img_step1","img_step1","img_step2";
		img_freq_limit_2 = "img_step2","img_step1","img_step2";
		clocks = <&topckgen TOP_MUX_MM>,	/* 0 */
			<&topckgen TOP_MUX_CAM>,		/* 1 */
			<&topckgen TOP_MUX_IMG>,		/* 2 */
			<&topckgen TOP_MUX_IPE>,		/* 3 */
			<&topckgen TOP_MUX_VENC>,		/* 4 */
			<&topckgen TOP_MUX_VDEC>,		/* 5 */
			<&topckgen TOP_MUX_DPE>,		/* 6 */
			<&topckgen TOP_MUX_CCU>,		/* 7 */
			<&topckgen TOP_MMPLL_D5>,		/* 8 */
			<&topckgen TOP_UNIVPLL_D2>,		/* 9 */
			<&topckgen TOP_TVDPLL_MAINPLL_D2_CK>,	/* 10 */
			<&topckgen TOP_ADSPPLL_D5>,		/* 11 */
			<&topckgen TOP_MAINPLL_D2>,		/* 12 */
			<&topckgen TOP_MMPLL_D6>,		/* 13 */
			<&topckgen TOP_MMPLL_D7>,		/* 14 */
			<&topckgen TOP_UNIVPLL_D3>,		/* 15 */
			<&topckgen TOP_MAINPLL_D3>,		/* 16 */
			<&topckgen TOP_MMPLL_D5_D2>,	/* 17 */
			<&topckgen TOP_UNIVPLL_D2_D2>;	/* 18 */
		clock-names = "mmdvfs_clk_mm_mux",	/* 0 */
			"mmdvfs_clk_cam_mux",			/* 1 */
			"mmdvfs_clk_img_mux",			/* 2 */
			"mmdvfs_clk_ipe_mux",			/* 3 */
			"mmdvfs_clk_venc_mux",			/* 4 */
			"mmdvfs_clk_vdec_mux",			/* 5 */
			"mmdvfs_clk_dpe_mux",			/* 6 */
			"mmdvfs_clk_ccu_mux",			/* 7 */
			"mmdvfs_clk_MMPLL_D5",			/* 8 */
			"mmdvfs_clk_UNIVPLL_D2",		/* 9 */
			"mmdvfs_clk_TVDPLL_MAINPLL_D2_CK",	/* 10 */
			"mmdvfs_clk_ADSPPLL_D5",		/* 11 */
			"mmdvfs_clk_MAINPLL_D2",		/* 12 */
			"mmdvfs_clk_MMPLL_D6",			/* 13 */
			"mmdvfs_clk_MMPLL_D7",			/* 14 */
			"mmdvfs_clk_UNIVPLL_D3",		/* 15 */
			"mmdvfs_clk_MAINPLL_D3",		/* 16 */
			"mmdvfs_clk_MMPLL_D5_D2",		/* 17 */
			"mmdvfs_clk_UNIVPLL_D2_D2";		/* 18 */
	};

	disp_rsz0@1401a000 {
		compatible = "mediatek,disp_rsz0";
		reg = <0 0x1401a000 0 0x1000>;
		interrupts = <GIC_SPI 265 IRQ_TYPE_LEVEL_LOW>;
	};

	mdp_aal: mdp_aal0@1401b000 {
		compatible = "mediatek,mdp_aal0";
		reg = <0 0x1401b000 0 0x1000>;
		clocks = <&mmsys_config MMSYS_MDP_AAL>;
		clock-names = "MDP_AAL";
	};

	mdp_hdr: mdp_hdr0@1401c000 {
		compatible = "mediatek,mdp_hdr0";
		reg = <0 0x1401c000 0 0x1000>;
		clocks = <&mmsys_config MMSYS_MDP_HDR>;
		clock-names = "MDP_HDR";
	};

	mdp_wrot1: mdp_wrot1@14020000 {
		compatible = "mediatek,mdp_wrot1";
		reg = <0 0x14020000 0 0x1000>;
		clocks = <&mmsys_config MMSYS_MDP_WROT1>;
		clock-names = "MDP_WROT1";
	};

	disp_postmask0@14021000 {
		compatible = "mediatek,disp_postmask0";
		reg = <0 0x14021000 0 0x1000>;
		interrupts = <GIC_SPI 268 IRQ_TYPE_LEVEL_LOW>;
	};

	imgsys: imgsys@15020000 {
		compatible = "mediatek,imgsys", "syscon";
		reg = <0 0x15020000 0 0x1000>;
		#clock-cells = <1>;
		clocks =
				<&imgsys IMG_LARB5>,
				<&imgsys IMG_DIP>;
		clock-names =
				"DIP_CG_IMG_LARB5",
				"DIP_CG_IMG_DIP";
	};

	dip1@15021000 {
		compatible = "mediatek,dip1";
		reg = <0 0x15021000 0 0xc000>;
		interrupts = <GIC_SPI 292 IRQ_TYPE_LEVEL_LOW>;
	};

	smi_larb5: smi_larb5@1502e000 {
		compatible = "mediatek,smi_larb5", "mediatek,smi_larb";
		reg = <0 0x1502e000 0 0x1000>;
		interrupts = <GIC_SPI 291 IRQ_TYPE_LEVEL_LOW>;
		clocks = <&scpsys SCP_SYS_ISP>, <&imgsys IMG_LARB5>;
		clock-names = "mtcmos-isp", "img-larb5";
		cell-index = <5>;
	};

	smi_larb6: smi_larb6@1502f000 {
		compatible = "mediatek,smi_larb6", "mediatek,smi_larb";
		reg = <0 0x1502f000 0 0x1000>;
		interrupts = <GIC_SPI 293 IRQ_TYPE_LEVEL_LOW>;
		clocks = <&scpsys SCP_SYS_ISP>, <&imgsys IMG_LARB6>;
		clock-names = "mtcmos-isp", "img-larb6";
		cell-index = <6>;
	};

	mfb@15010000 {
		compatible = "mediatek,mfb";
		reg = <0 0x15010000 0 0x1000>;
		interrupts = <GIC_SPI 294 IRQ_TYPE_LEVEL_LOW>;
	};

	wpe_a@15011000 {
		compatible = "mediatek,wpe_a";
		reg = <0 0x15011000 0 0x1000>;
		interrupts = <GIC_SPI 295 IRQ_TYPE_LEVEL_LOW>;
	};

	venc_gcon: venc_gcon@17000000 {
		compatible = "mediatek,venc_gcon", "syscon";
		reg = <0 0x17000000 0 0x10000>;
		#clock-cells = <1>;
	};

	smi_larb3: smi_larb3@17010000 {
		compatible = "mediatek,smi_larb3", "mediatek,smi_larb";
		reg = <0 0x17010000 0 0x1000>;
		interrupts = <GIC_SPI 269 IRQ_TYPE_LEVEL_LOW>;
		clocks = <&scpsys SCP_SYS_VEN>,
			<&venc_gcon VENC_GCON_LARB>;
		clock-names = "mtcmos-ven", "venc-larb";
		cell-index = <3>;
	};

	smi_larb4: smi_larb4@17011000 {
		compatible = "mediatek,smi_larb4", "mediatek,smi_larb";
		reg = <0 0x17011000 0 0x1000>;
		clocks = <&scpsys SCP_SYS_VEN>;
		clock-names = "mtcmos-ven";
		cell-index = <4>;
	};

	venc@17020000 {
		compatible = "mediatek,venc";
		reg = <0 0x17020000 0 0x2000>;
		interrupts = <GIC_SPI 270 IRQ_TYPE_LEVEL_LOW>;
	};

	jpgenc@17030000 {
		compatible = "mediatek,jpgenc";
		reg = <0 0x17030000 0 0x10000>;
		interrupts = <GIC_SPI 271 IRQ_TYPE_LEVEL_LOW>;
	};

	mbist@17070000 {
		compatible = "mediatek,mbist";
		reg = <0 0x17070000 0 0x10000>;
	};

	vdec_gcon: vdec_gcon@16000000 {
		compatible = "mediatek,vdec_gcon", "syscon";
		reg = <0 0x16000000 0 0x800>;
		#clock-cells = <1>;
	};

	vdec_wrap@16000800 {
		compatible = "mediatek,vdec_wrap";
		reg = <0 0x16000800 0 0x100>;
	};

	vdec_wrap@16002000 {
		compatible = "mediatek,vdec_wrap";
		reg = <0 0x16002000 0 0x2000>;
	};

	smi_larb2: smi_larb2@16010000 {
		compatible = "mediatek,smi_larb2", "mediatek,smi_larb";
		reg = <0 0x16010000 0 0x10000>;
		interrupts = <GIC_SPI 325 IRQ_TYPE_LEVEL_LOW>;
		clocks = <&scpsys SCP_SYS_VDE>, <&vdec_gcon VDEC_VDEC>;
		clock-names = "mtcmos-vde", "vdec-vdec";
		cell-index = <2>;
	};

	vdec@16020000 {
		compatible = "mediatek,vdec";
		reg = <0 0x16020000 0 0xe000>;
		interrupts = <GIC_SPI 324 IRQ_TYPE_LEVEL_LOW>;
	};

	vdec_mbist_ctrl@1602f800 {
		compatible = "mediatek,vdec_mbist_ctrl";
		reg = <0 0x1602f800 0 0x400>;
	};

	vdec_lat@16030000 {
		compatible = "mediatek,vdec_lat";
		reg = <0 0x16030000 0 0x10000>;
	};

	camsys: camsys@1a000000 {
		compatible = "mediatek,camsys", "syscon";
		reg = <0 0x1a000000 0 0x10000>;
		#if 0
		#clock-cells = <1>;
		/* Camera CCF */
		clocks = <&scpsys SCP_SYS_DIS>,
				<&scpsys SCP_SYS_CAM>,
				<&camsys CAMSYS_CAM_CGPDN>,
				<&camsys CAMSYS_CAMTG_CGPDN>,
				<&camsys CAMSYS_CAMSV0_CGPDN>,
				<&camsys CAMSYS_CAMSV1_CGPDN>,
				<&camsys CAMSYS_CAMSV2_CGPDN>,
				<&camsys CAMSYS_CAMSV3_CGPDN>;
		clock-names = "ISP_SCP_SYS_DIS",
				"ISP_SCP_SYS_CAM",
				"CAMSYS_CAM_CGPDN",
				"CAMSYS_CAMTG_CGPDN",
				"CAMSYS_CAMSV0_CGPDN",
				"CAMSYS_CAMSV1_CGPDN",
				"CAMSYS_CAMSV2_CGPDN",
				"CAMSYS_CAMSV3_CGPDN";
		#endif
	};

	smi_larb9: smi_larb9@1a001000 {
		compatible = "mediatek,smi_larb9", "mediatek,smi_larb";
		reg = <0 0x1a001000 0 0x1000>;
		clocks = <&scpsys SCP_SYS_CAM>,
			<&camsys CAMSYS_LARB9_CGPDN>;
		clock-names = "mtcmos-cam", "cam-larb9";
		cell-index = <9>;
	};

	smi_larb10: smi_larb10@1a002000 {
		compatible = "mediatek,smi_larb10", "mediatek,smi_larb";
		reg = <0 0x1a002000 0 0x1000>;
		clocks = <&scpsys SCP_SYS_CAM>,
			<&camsys CAMSYS_LARB10_CGPDN>;
		clock-names = "mtcmos-cam", "cam-larb10";
		cell-index = <10>;
	};

	smi_larb11: smi_larb11@1a003000 {
		compatible = "mediatek,smi_larb11", "mediatek,smi_larb";
		reg = <0 0x1a003000 0 0x1000>;
		clocks = <&scpsys SCP_SYS_CAM>,
			<&camsys CAMSYS_LARB11_CGPDN>;
		clock-names = "mtcmos-cam", "cam-larb11";
		cell-index = <11>;
	};

	cam1@1a010000 {
		compatible = "mediatek,cam1";
		reg = <0 0x1a010000 0 0x8000>;
		interrupts = <GIC_SPI 274 IRQ_TYPE_LEVEL_LOW>;
	};

	cam2@1a020000 {
		compatible = "mediatek,cam2";
		reg = <0 0x1a020000 0 0x8000>;
		interrupts = <GIC_SPI 275 IRQ_TYPE_LEVEL_LOW>;
	};

	cam3@1a030000 {
		compatible = "mediatek,cam3";
		reg = <0 0x1a030000 0 0x8000>;
		interrupts = <GIC_SPI 276 IRQ_TYPE_LEVEL_LOW>;
	};

	cam1_inner@1a018000 {
		compatible = "mediatek,cam1_inner";
		reg = <0 0x1a018000 0 0x8000>;
	};

	cam2_inner@1a028000 {
		compatible = "mediatek,cam2_inner";
		reg = <0 0x1a028000 0 0x8000>;
	};

	cam3_inner@1a038000 {
		compatible = "mediatek,cam3_inner";
		reg = <0 0x1a038000 0 0x8000>;
	};

	camsv1@1a051000 {
		compatible = "mediatek,camsv1";
		reg = <0 0x1a051000 0 0x1000>;
		interrupts = <GIC_SPI 279 IRQ_TYPE_LEVEL_LOW>;
	};

	camsv2@1a052000 {
		compatible = "mediatek,camsv2";
		reg = <0 0x1a052000 0 0x1000>;
		interrupts = <GIC_SPI 280 IRQ_TYPE_LEVEL_LOW>;
	};

	camsv3@1a053000 {
		compatible = "mediatek,camsv3";
		reg = <0 0x1a053000 0 0x1000>;
		interrupts = <GIC_SPI 281 IRQ_TYPE_LEVEL_LOW>;
	};

	camsv4@1a054000 {
		compatible = "mediatek,camsv4";
		reg = <0 0x1a054000 0 0x1000>;
		interrupts = <GIC_SPI 282 IRQ_TYPE_LEVEL_LOW>;
	};

	camsv5@1a055000 {
		compatible = "mediatek,camsv5";
		reg = <0 0x1a055000 0 0x1000>;
		interrupts = <GIC_SPI 283 IRQ_TYPE_LEVEL_LOW>;
	};

	camsv6@1a056000 {
		compatible = "mediatek,camsv6";
		reg = <0 0x1a056000 0 0x1000>;
		interrupts = <GIC_SPI 284 IRQ_TYPE_LEVEL_LOW>;
	};

	camsv7@1a057000 {
		compatible = "mediatek,camsv7";
		reg = <0 0x1a057000 0 0x1000>;
		interrupts = <GIC_SPI 288 IRQ_TYPE_LEVEL_LOW>;
	};

	camsv8@1a058000 {
		compatible = "mediatek,camsv8";
		reg = <0 0x1a058000 0 0x1000>;
		interrupts = <GIC_SPI 289 IRQ_TYPE_LEVEL_LOW>;
	};

	apu_vcore: apu_vcore@19020000 {
		compatible = "mediatek,apu_vcore", "syscon";
		reg = <0 0x19020000 0 0x1000>;
		#clock-cells = <1>;
	};

	apu_conn: apu_conn@19000000 {
		compatible = "mediatek,apu_conn", "syscon";
		reg = <0 0x19000000 0 0x1000>;
		#clock-cells = <1>;
	};

	apu0: apu0@19180000 {
		compatible = "mediatek,apu0", "syscon";
		reg = <0 0x19180000 0 0x1000>;
		#clock-cells = <1>;
	};

	apu1: apu1@19280000 {
		compatible = "mediatek,apu1", "syscon";
		reg = <0 0x19280000 0 0x1000>;
		#clock-cells = <1>;
	};

	apu_mdla: apu_mdla@19380000 {
		compatible = "mediatek,apu_mdla", "syscon";
		reg = <0 0x19380000 0 0x1000>;
		#clock-cells = <1>;
	};

	ipu_conn@19000000 {
		compatible = "mediatek,ipu_conn";
		reg = <0 0x19000000 0 0x1000>;
	};

	ipu_vcore@19020000 {
		compatible = "mediatek,ipu_vcore";
		reg = <0 0x19020000 0 0x1000>;
	};

	vpu_core0@0x19100000  {
		compatible = "mediatek,vpu_core0";
		reg = <0 0x19100000 0 0x94000>;
		interrupts = <GIC_SPI 320 IRQ_TYPE_LEVEL_LOW>;
		clocks = <&topckgen TOP_MUX_DSP>,
			<&topckgen TOP_MUX_DSP1>,
			<&topckgen TOP_MUX_DSP2>,
			<&topckgen TOP_MUX_DSP3>,
			<&topckgen TOP_MUX_IPU_IF>,
			<&apu0 APU0_JTAG_CG>,
			<&apu0 APU0_AXI_M_CG>,
			<&apu0 APU0_APU_CG>,
			<&apu1 APU1_JTAG_CG>,
			<&apu1 APU1_AXI_M_CG>,
			<&apu1 APU1_APU_CG>,
			<&apu_mdla APU_MDLA_APB_CG>,
			<&apu_mdla APU_MDLA_CG_B0>,
			<&apu_mdla APU_MDLA_CG_B1>,
			<&apu_mdla APU_MDLA_CG_B2>,
			<&apu_mdla APU_MDLA_CG_B3>,
			<&apu_mdla APU_MDLA_CG_B4>,
			<&apu_mdla APU_MDLA_CG_B5>,
			<&apu_mdla APU_MDLA_CG_B6>,
			<&apu_mdla APU_MDLA_CG_B7>,
			<&apu_mdla APU_MDLA_CG_B8>,
			<&apu_mdla APU_MDLA_CG_B9>,
			<&apu_mdla APU_MDLA_CG_B10>,
			<&apu_mdla APU_MDLA_CG_B11>,
			<&apu_mdla APU_MDLA_CG_B12>,
			<&apu_conn APU_CONN_APU_CG>,
			<&apu_conn APU_CONN_AHB_CG>,
			<&apu_conn APU_CONN_AXI_CG>,
			<&apu_conn APU_CONN_ISP_CG>,
			<&apu_conn APU_CONN_CAM_ADL_CG>,
			<&apu_conn APU_CONN_IMG_ADL_CG>,
			<&apu_conn APU_CONN_EMI_26M_CG>,
			<&apu_conn APU_CONN_VPU_UDI_CG>,
			<&apu_vcore APU_VCORE_AHB_CG>,
			<&apu_vcore APU_VCORE_AXI_CG>,
			<&apu_vcore APU_VCORE_ADL_CG>,
			<&apu_vcore APU_VCORE_QOS_CG>,
			<&topckgen TOP_CLK26M>,
			<&topckgen TOP_UNIVPLL_D3_D8>,
			<&topckgen TOP_UNIVPLL_D3_D4>,
			<&topckgen TOP_MAINPLL_D2_D4>,
			<&topckgen TOP_UNIVPLL_D3_D2>,
			<&topckgen TOP_MAINPLL_D2_D2>,
			<&topckgen TOP_UNIVPLL_D2_D2>,
			<&topckgen TOP_MAINPLL_D3>,
			<&topckgen TOP_UNIVPLL_D3>,
			<&topckgen TOP_MMPLL_D7>,
			<&topckgen TOP_MMPLL_D6>,
			<&topckgen TOP_ADSPPLL_D5>,
			<&topckgen TOP_TVDPLL_CK>,
			<&topckgen TOP_TVDPLL_MAINPLL_D2_CK>,
			<&topckgen TOP_UNIVPLL_D2>,
			<&topckgen TOP_ADSPPLL_D4>,
			<&topckgen TOP_MAINPLL_D2>,
			<&topckgen TOP_MMPLL_D4>,
			<&mmsys_config MMSYS_GALS_IPU2MM>,
			<&mmsys_config MMSYS_GALS_IPU12MM>,
			<&mmsys_config MMSYS_GALS_COMM1>,
			<&mmsys_config MMSYS_GALS_COMM0>,
			<&mmsys_config MMSYS_SMI_COMMON>,
			<&mmsys_config MMSYS_IPU_DL_TXCK>,
			<&mmsys_config MMSYS_IPU_DL_RX_CK>,
			<&scpsys SCP_SYS_DIS>,
			<&scpsys SCP_SYS_VPU_VCORE_DORMANT>,
			<&scpsys SCP_SYS_VPU_VCORE_SHUTDOWN>,
			<&scpsys SCP_SYS_VPU_CONN_DORMANT>,
			<&scpsys SCP_SYS_VPU_CONN_SHUTDOWN>,
			<&scpsys SCP_SYS_VPU_CORE0_DORMANT>,
			<&scpsys SCP_SYS_VPU_CORE0_SHUTDOWN>,
			<&scpsys SCP_SYS_VPU_CORE1_DORMANT>,
			<&scpsys SCP_SYS_VPU_CORE1_SHUTDOWN>,
			<&scpsys SCP_SYS_VPU_CORE2_DORMANT>,
			<&scpsys SCP_SYS_VPU_CORE2_SHUTDOWN>;

		clock-names = "clk_top_dsp_sel",
			"clk_top_dsp1_sel",
			"clk_top_dsp2_sel",
			"clk_top_dsp3_sel",
			"clk_top_ipu_if_sel",
			"clk_apu_core0_jtag_cg",
			"clk_apu_core0_axi_m_cg",
			"clk_apu_core0_apu_cg",
			"clk_apu_core1_jtag_cg",
			"clk_apu_core1_axi_m_cg",
			"clk_apu_core1_apu_cg",
			"clk_apu_mdla_apb_cg",
			"clk_apu_mdla_cg_b0",
			"clk_apu_mdla_cg_b1",
			"clk_apu_mdla_cg_b2",
			"clk_apu_mdla_cg_b3",
			"clk_apu_mdla_cg_b4",
			"clk_apu_mdla_cg_b5",
			"clk_apu_mdla_cg_b6",
			"clk_apu_mdla_cg_b7",
			"clk_apu_mdla_cg_b8",
			"clk_apu_mdla_cg_b9",
			"clk_apu_mdla_cg_b10",
			"clk_apu_mdla_cg_b11",
			"clk_apu_mdla_cg_b12",
			"clk_apu_conn_apu_cg",
			"clk_apu_conn_ahb_cg",
			"clk_apu_conn_axi_cg",
			"clk_apu_conn_isp_cg",
			"clk_apu_conn_cam_adl_cg",
			"clk_apu_conn_img_adl_cg",
			"clk_apu_conn_emi_26m_cg",
			"clk_apu_conn_vpu_udi_cg",
			"clk_apu_vcore_ahb_cg",
			"clk_apu_vcore_axi_cg",
			"clk_apu_vcore_adl_cg",
			"clk_apu_vcore_qos_cg",
			"clk_top_clk26m",
			"clk_top_univpll_d3_d8",
			"clk_top_univpll_d3_d4",
			"clk_top_mainpll_d2_d4",
			"clk_top_univpll_d3_d2",
			"clk_top_mainpll_d2_d2",
			"clk_top_univpll_d2_d2",
			"clk_top_mainpll_d3",
			"clk_top_univpll_d3",
			"clk_top_mmpll_d7",
			"clk_top_mmpll_d6",
			"clk_top_adsppll_d5",
			"clk_top_tvdpll_ck",
			"clk_top_tvdpll_mainpll_d2_ck",
			"clk_top_univpll_d2",
			"clk_top_adsppll_d4",
			"clk_top_mainpll_d2",
			"clk_top_mmpll_d4",
			"clk_mmsys_gals_ipu2mm",
			"clk_mmsys_gals_ipu12mm",
			"clk_mmsys_gals_comm1",
			"clk_mmsys_gals_comm0",
			"clk_mmsys_smi_common",
			"clk_mmsys_ipu_dl_txck",
			"clk_mmsys_ipu_dl_rx_ck",
			"mtcmos_dis",
			"mtcmos_vpu_vcore_dormant",
			"mtcmos_vpu_vcore_shutdown",
			"mtcmos_vpu_conn_dormant",
			"mtcmos_vpu_conn_shutdown",
			"mtcmos_vpu_core0_dormant",
			"mtcmos_vpu_core0_shutdown",
			"mtcmos_vpu_core1_dormant",
			"mtcmos_vpu_core1_shutdown",
			"mtcmos_vpu_core2_dormant",
			"mtcmos_vpu_core2_shutdown";
	};

	vpu_core1@0x19200000  {
		compatible = "mediatek,vpu_core1";
		reg = <0 0x19200000 0 0x94000>;
		interrupts = <GIC_SPI 321 IRQ_TYPE_LEVEL_LOW>;
	};

	apu_dvfs@19180000 {
		compatible = "mediatek,apu_dvfs";
		reg = <0 0x19180000 0 0x1000>;
	};
	mtk_mdla: mdla@19390000 {
		compatible = "mtk,mdla";
		reg = <0 0x19380000 0 0x1000>,    /* mdla config  */
		<0 0x19390000 0 0x1000>,  /* mdla command */
		<0 0x19391000 0 0x1000>,  /* mdla bui     */
		<0 0x1d000000 0 0x100000>;/* GSM          */
		interrupts = <GIC_SPI 322 IRQ_TYPE_LEVEL_LOW>;
		clocks = <&topckgen TOP_MUX_DSP>,
			<&topckgen TOP_MUX_DSP1>,
			<&topckgen TOP_MUX_DSP2>,
			<&topckgen TOP_MUX_DSP3>,
			<&topckgen TOP_MUX_IPU_IF>,
			<&apu0 APU0_JTAG_CG>,
			<&apu0 APU0_AXI_M_CG>,
			<&apu0 APU0_APU_CG>,
			<&apu1 APU1_JTAG_CG>,
			<&apu1 APU1_AXI_M_CG>,
			<&apu1 APU1_APU_CG>,
			<&apu_mdla APU_MDLA_APB_CG>,
			<&apu_mdla APU_MDLA_CG_B0>,
			<&apu_mdla APU_MDLA_CG_B1>,
			<&apu_mdla APU_MDLA_CG_B2>,
			<&apu_mdla APU_MDLA_CG_B3>,
			<&apu_mdla APU_MDLA_CG_B4>,
			<&apu_mdla APU_MDLA_CG_B5>,
			<&apu_mdla APU_MDLA_CG_B6>,
			<&apu_mdla APU_MDLA_CG_B7>,
			<&apu_mdla APU_MDLA_CG_B8>,
			<&apu_mdla APU_MDLA_CG_B9>,
			<&apu_mdla APU_MDLA_CG_B10>,
			<&apu_mdla APU_MDLA_CG_B11>,
			<&apu_mdla APU_MDLA_CG_B12>,
			<&apu_conn APU_CONN_APU_CG>,
			<&apu_conn APU_CONN_AHB_CG>,
			<&apu_conn APU_CONN_AXI_CG>,
			<&apu_conn APU_CONN_ISP_CG>,
			<&apu_conn APU_CONN_CAM_ADL_CG>,
			<&apu_conn APU_CONN_IMG_ADL_CG>,
			<&apu_conn APU_CONN_EMI_26M_CG>,
			<&apu_conn APU_CONN_VPU_UDI_CG>,
			<&apu_vcore APU_VCORE_AHB_CG>,
			<&apu_vcore APU_VCORE_AXI_CG>,
			<&apu_vcore APU_VCORE_ADL_CG>,
			<&apu_vcore APU_VCORE_QOS_CG>,
			<&topckgen TOP_CLK26M>,
			<&topckgen TOP_UNIVPLL_D3_D8>,
			<&topckgen TOP_UNIVPLL_D3_D4>,
			<&topckgen TOP_MAINPLL_D2_D4>,
			<&topckgen TOP_UNIVPLL_D3_D2>,
			<&topckgen TOP_MAINPLL_D2_D2>,
			<&topckgen TOP_UNIVPLL_D2_D2>,
			<&topckgen TOP_MAINPLL_D3>,
			<&topckgen TOP_UNIVPLL_D3>,
			<&topckgen TOP_MMPLL_D7>,
			<&topckgen TOP_MMPLL_D6>,
			<&topckgen TOP_ADSPPLL_D5>,
			<&topckgen TOP_TVDPLL_CK>,
			<&topckgen TOP_TVDPLL_MAINPLL_D2_CK>,
			<&topckgen TOP_UNIVPLL_D2>,
			<&topckgen TOP_ADSPPLL_D4>,
			<&topckgen TOP_MAINPLL_D2>,
			<&topckgen TOP_MMPLL_D4>,
			<&mmsys_config MMSYS_GALS_IPU2MM>,
			<&mmsys_config MMSYS_GALS_IPU12MM>,
			<&mmsys_config MMSYS_GALS_COMM1>,
			<&mmsys_config MMSYS_GALS_COMM0>,
			<&mmsys_config MMSYS_SMI_COMMON>,
			<&mmsys_config MMSYS_IPU_DL_TXCK>,
			<&mmsys_config MMSYS_IPU_DL_RX_CK>,
			<&scpsys SCP_SYS_DIS>,
			<&scpsys SCP_SYS_VPU_VCORE_DORMANT>,
			<&scpsys SCP_SYS_VPU_VCORE_SHUTDOWN>,
			<&scpsys SCP_SYS_VPU_CONN_DORMANT>,
			<&scpsys SCP_SYS_VPU_CONN_SHUTDOWN>,
			<&scpsys SCP_SYS_VPU_CORE0_DORMANT>,
			<&scpsys SCP_SYS_VPU_CORE0_SHUTDOWN>,
			<&scpsys SCP_SYS_VPU_CORE1_DORMANT>,
			<&scpsys SCP_SYS_VPU_CORE1_SHUTDOWN>,
			<&scpsys SCP_SYS_VPU_CORE2_DORMANT>,
			<&scpsys SCP_SYS_VPU_CORE2_SHUTDOWN>;

		clock-names = "clk_top_dsp_sel",
			"clk_top_dsp1_sel",
			"clk_top_dsp2_sel",
			"clk_top_dsp3_sel",
			"clk_top_ipu_if_sel",
			"clk_apu_core0_jtag_cg",
			"clk_apu_core0_axi_m_cg",
			"clk_apu_core0_apu_cg",
			"clk_apu_core1_jtag_cg",
			"clk_apu_core1_axi_m_cg",
			"clk_apu_core1_apu_cg",
			"clk_apu_mdla_apb_cg",
			"clk_apu_mdla_cg_b0",
			"clk_apu_mdla_cg_b1",
			"clk_apu_mdla_cg_b2",
			"clk_apu_mdla_cg_b3",
			"clk_apu_mdla_cg_b4",
			"clk_apu_mdla_cg_b5",
			"clk_apu_mdla_cg_b6",
			"clk_apu_mdla_cg_b7",
			"clk_apu_mdla_cg_b8",
			"clk_apu_mdla_cg_b9",
			"clk_apu_mdla_cg_b10",
			"clk_apu_mdla_cg_b11",
			"clk_apu_mdla_cg_b12",
			"clk_apu_conn_apu_cg",
			"clk_apu_conn_ahb_cg",
			"clk_apu_conn_axi_cg",
			"clk_apu_conn_isp_cg",
			"clk_apu_conn_cam_adl_cg",
			"clk_apu_conn_img_adl_cg",
			"clk_apu_conn_emi_26m_cg",
			"clk_apu_conn_vpu_udi_cg",
			"clk_apu_vcore_ahb_cg",
			"clk_apu_vcore_axi_cg",
			"clk_apu_vcore_adl_cg",
			"clk_apu_vcore_qos_cg",
			"clk_top_clk26m",
			"clk_top_univpll_d3_d8",
			"clk_top_univpll_d3_d4",
			"clk_top_mainpll_d2_d4",
			"clk_top_univpll_d3_d2",
			"clk_top_mainpll_d2_d2",
			"clk_top_univpll_d2_d2",
			"clk_top_mainpll_d3",
			"clk_top_univpll_d3",
			"clk_top_mmpll_d7",
			"clk_top_mmpll_d6",
			"clk_top_adsppll_d5",
			"clk_top_tvdpll_ck",
			"clk_top_tvdpll_mainpll_d2_ck",
			"clk_top_univpll_d2",
			"clk_top_adsppll_d4",
			"clk_top_mainpll_d2",
			"clk_top_mmpll_d4",
			"clk_mmsys_gals_ipu2mm",
			"clk_mmsys_gals_ipu12mm",
			"clk_mmsys_gals_comm1",
			"clk_mmsys_gals_comm0",
			"clk_mmsys_smi_common",
			"clk_mmsys_ipu_dl_txck",
			"clk_mmsys_ipu_dl_rx_ck",
			"mtcmos_dis",
			"mtcmos_vpu_vcore_dormant",
			"mtcmos_vpu_vcore_shutdown",
			"mtcmos_vpu_conn_dormant",
			"mtcmos_vpu_conn_shutdown",
			"mtcmos_vpu_core0_dormant",
			"mtcmos_vpu_core0_shutdown",
			"mtcmos_vpu_core1_dormant",
			"mtcmos_vpu_core1_shutdown",
			"mtcmos_vpu_core2_dormant",
			"mtcmos_vpu_core2_shutdown";
	};

	ipesys_config: ipesys_config@1b000000 {
		compatible = "mediatek,ipesys_config", "syscon";
		reg = <0 0x1b000000 0 0x1000>;
		#clock-cells = <1>;
	};

	fdvt@1b001000 {
		compatible = "mediatek,fdvt";
		reg = <0 0x1b001000 0 0x1000>;
		interrupts = <GIC_SPI 299 IRQ_TYPE_LEVEL_LOW>;
	};

	fe@1b002000 {
		compatible = "mediatek,fe";
		reg = <0 0x1b002000 0 0x1000>;
		interrupts = <GIC_SPI 301 IRQ_TYPE_LEVEL_LOW>;
	};

	rsc@1b003000 {
		compatible = "mediatek,rsc";
		reg = <0 0x1b003000 0 0x1000>;
		interrupts = <GIC_SPI 300 IRQ_TYPE_LEVEL_LOW>;
	};

	ipe_smi_subcom@1b00e000 {
		compatible = "mediatek,ipe_smi_subcom";
		reg = <0 0x1b00e000 0 0x1000>;
	};

	smi_larb8: smi_larb8@1b00f000 {
		compatible = "mediatek,smi_larb8", "mediatek,smi_larb";
		reg = <0 0x1b00f000 0 0x1000>;
		interrupts = <GIC_SPI 298 IRQ_TYPE_LEVEL_LOW>;
		clocks = <&scpsys SCP_SYS_IPE>, <&ipesys_config IPE_LARB8>;
		clock-names = "mtcmos-ipe", "ipe-larb8";
		cell-index = <8>;
	};

	dvs@1b100000 {
		compatible = "mediatek,dvs";
		reg = <0 0x1b100000 0 0x1000>;
		interrupts = <GIC_SPI 302 IRQ_TYPE_LEVEL_LOW>;
	};

	dvp@1b100800 {
		compatible = "mediatek,dvp";
		reg = <0 0x1b100000 0 0x1000>;
		interrupts = <GIC_SPI 303 IRQ_TYPE_LEVEL_LOW>;
	};

	smi_larb7: smi_larb7@1b10f000 {
		compatible = "mediatek,smi_larb7", "mediatek,smi_larb";
		reg = <0 0x1b10f000 0 0x1000>;
		interrupts = <GIC_SPI 297 IRQ_TYPE_LEVEL_LOW>;
		clocks = <&scpsys SCP_SYS_IPE>, <&topckgen TOP_MUX_DPE>,
			<&ipesys_config IPE_LARB7>;
		clock-names = "mtcmos-ipe", "top-dpe", "ipe-larb7";
		cell-index = <7>;
	};

	seninf1@1a004000 {
		compatible = "mediatek,seninf1";
		reg = <0 0x1a004000 0 0x1000>;
	};

	seninf2@1a005000 {
		compatible = "mediatek,seninf2";
		reg = <0 0x1a005000 0 0x1000>;
	};

	seninf3@1a006000 {
		compatible = "mediatek,seninf3";
		reg = <0 0x1a006000 0 0x1000>;
	};

	seninf4@1a007000 {
		compatible = "mediatek,seninf4";
		reg = <0 0x1a007000 0 0x1000>;
	};

	seninf5@1a008000 {
		compatible = "mediatek,seninf5";
		reg = <0 0x1a008000 0 0x1000>;
	};

	seninf_top@1a004000 {
		compatible = "mediatek,seninf_top";
		reg = <0 0x1a004000 0 0x1000>;
#if 0
		interrupts = <GIC_SPI 251 IRQ_TYPE_LEVEL_LOW>;
#endif

#if 0
		clocks = <&scpsys SCP_SYS_DIS>,
			<&scpsys SCP_SYS_CAM>,
			<&camsys CAMSYS_SENINF_CGPDN>,
			<&topckgen TOP_MUX_SENINF>,
			<&topckgen TOP_MUX_CAMTG>,
			<&topckgen TOP_MUX_CAMTG2>,
			<&topckgen TOP_MUX_CAMTG3>,
			<&topckgen TOP_MUX_CAMTG4>,
			<&clk26m>,
			<&topckgen TOP_UNIVP_192M_D8>,
			<&topckgen TOP_UNIVPLL_D3_D8>,
			<&topckgen TOP_UNIVP_192M_D4>,
			<&topckgen TOP_F26M_CK_D2>,
			<&topckgen TOP_UNIVP_192M_D16>,
			<&topckgen TOP_UNIVP_192M_D32>;
		clock-names = "SCP_SYS_DIS",
			"SCP_SYS_CAM",
			"CAMSYS_SENINF_CGPDN",
			"TOP_MUX_SENINF",
			"TOP_MUX_CAMTG",
			"TOP_MUX_CAMTG2",
			"TOP_MUX_CAMTG3",
			"TOP_MUX_CAMTG4",
			"TOP_CLK26M",
			"TOP_UNIVP_192M_D8",
			"TOP_UNIVPLL_D3_D8",
			"TOP_UNIVP_192M_D4",
			"TOP_F26M_CK_D2",
			"TOP_UNIVP_192M_D16",
			"TOP_UNIVP_192M_D32";
#endif
	};

	kd_camera_hw1:kd_camera_hw1@1a004000 {
		compatible = "mediatek,imgsensor";
	};

	firmware {
		android {
			compatible = "android,firmware";
#ifdef CONFIG_MTK_AVB20_SUPPORT
			vbmeta {
				compatible = "android,vbmeta";
#ifndef CONFIG_MTK_AB_OTA_UPDATER
				parts = "vbmeta,boot,system,vendor,recovery";
#else
				parts = "vbmeta,boot,system,vendor";
#endif
			};
#endif
			fstab {
				compatible = "android,fstab";
#if !defined(CONFIG_SYSTEM_AS_ROOT) && !defined(CONFIG_MTK_AB_OTA_UPDATER)
				system {
					compatible = "android,system";
					dev = "/dev/block/platform/bootdevice/by-name/system";
					type = "ext4";
					mnt_flags = "ro";
#ifndef CONFIG_MTK_DM_VERITY_OFF
#ifdef CONFIG_MTK_AVB20_SUPPORT
					fsmgr_flags = "wait,avb";
#else
					fsmgr_flags = "wait,verify";
#endif
#else
					fsmgr_flags = "wait";
#endif
				};
#endif
#ifndef CONFIG_MTK_LATE_MOUNT
				vendor {
					compatible = "android,vendor";
					dev = "/dev/block/platform/bootdevice/by-name/vendor";
					type = "ext4";
					mnt_flags = "ro";
#ifndef CONFIG_MTK_AB_OTA_UPDATER
#ifndef CONFIG_MTK_DM_VERITY_OFF
#ifdef CONFIG_MTK_AVB20_SUPPORT
					fsmgr_flags = "wait,avb";
#else
					fsmgr_flags = "wait,verify";
#endif
#else
					fsmgr_flags = "wait";
#endif
#else
#ifndef CONFIG_MTK_DM_VERITY_OFF
#ifdef CONFIG_MTK_AVB20_SUPPORT
					fsmgr_flags = "wait,slotselect,avb";
#else
					fsmgr_flags = "wait,slotselect,verify";
#endif
#else
					fsmgr_flags = "wait,slotselect";
#endif
#endif
				};
#endif
#ifdef CONFIG_TARGET_COPY_OUT_ODM
				odm {
					compatible = "android,odm";
					dev = "/dev/block/platform/bootdevice/by-name/odm";
					type = "ext4";
					mnt_flags = "ro";
#ifndef CONFIG_MTK_AB_OTA_UPDATER
#ifndef CONFIG_MTK_DM_VERITY_OFF
#ifdef CONFIG_MTK_AVB20_SUPPORT
					fsmgr_flags = "wait,avb";
#else
					fsmgr_flags = "wait,verify";
#endif
#else
					fsmgr_flags = "wait";
#endif
#else
#ifndef CONFIG_MTK_DM_VERITY_OFF
#ifdef CONFIG_MTK_AVB20_SUPPORT
					fsmgr_flags = "wait,slotselect,avb";
#else
					fsmgr_flags = "wait,slotselect,verify";
#endif
#else
					fsmgr_flags = "wait,slotselect";
#endif
#endif
				};
#endif
			};
		};
	};

	odm: odm {
		compatible = "simple-bus";
		/* reserved for overlay by odm */
	};

	msdc1_ins: msdc1_ins {
	};

	mt_charger: mt_charger {
		compatible = "mediatek,mt-charger";
	};

	lk_charger: lk_charger {
		compatible = "mediatek,lk_charger";
		enable_anime;
		enable_pe_plus;
		power_path_support;
		max_charger_voltage = <6500000>;
		fast_charge_voltage = <3000000>;

		/* charging current */
		usb_charger_current = <500000>;
		ac_charger_current = <2050000>;
		ac_charger_input_current = <3200000>;
		non_std_ac_charger_current = <500000>;
		charging_host_charger_current = <1500000>;
		ta_ac_charger_current = <3000000>;
		pd_charger_current = <500000>;

		/* battery temperature protection */
		temp_t4_threshold = <50>;
		temp_t3_threshold = <45>;
		temp_t1_threshold = <0>;
	};

	charger: charger {
		compatible = "mediatek,charger";
		algorithm_name = "SwitchCharging";
		/* enable_sw_jeita; */
		enable_pe_plus;
		enable_pe_2;
		enable_pe_3;
		enable_pe_4;
		enable_type_c;
		power_path_support;

		/* common */
		battery_cv = <4350000>;
		max_charger_voltage = <6500000>;
		min_charger_voltage = <4600000>;

		/* charging current */
		usb_charger_current_suspend = <0>;
		usb_charger_current_unconfigured = <70000>;
		usb_charger_current_configured = <500000>;
		usb_charger_current = <500000>;
		ac_charger_current = <2050000>;
		ac_charger_input_current = <3200000>;
		non_std_ac_charger_current = <500000>;
		charging_host_charger_current = <1500000>;
		apple_1_0a_charger_current = <650000>;
		apple_2_1a_charger_current = <800000>;
		ta_ac_charger_current = <3000000>;

		/* sw jeita */
		jeita_temp_above_t4_cv = <4240000>;
		jeita_temp_t3_to_t4_cv = <4240000>;
		jeita_temp_t2_to_t3_cv = <4340000>;
		jeita_temp_t1_to_t2_cv = <4240000>;
		jeita_temp_t0_to_t1_cv = <4040000>;
		jeita_temp_below_t0_cv = <4040000>;
		temp_t4_thres = <50>;
		temp_t4_thres_minus_x_degree = <47>;
		temp_t3_thres = <45>;
		temp_t3_thres_minus_x_degree = <39>;
		temp_t2_thres = <10>;
		temp_t2_thres_plus_x_degree = <16>;
		temp_t1_thres = <0>;
		temp_t1_thres_plus_x_degree = <6>;
		temp_t0_thres = <0>;
		temp_t0_thres_plus_x_degree = <0>;
		temp_neg_10_thres = <0>;

		/* battery temperature protection */
		enable_min_charge_temp;
		min_charge_temp = <0>;
		min_charge_temp_plus_x_degree = <6>;
		max_charge_temp = <50>;
		max_charge_temp_minus_x_degree = <47>;

		/* PE */
		ta_12v_support;
		ta_9v_support;
		pe_ichg_level_threshold = <1000000>; /* uA */
		ta_ac_12v_input_current = <3200000>;
		ta_ac_9v_input_current = <3200000>;
		ta_ac_7v_input_current = <3200000>;

		/* PE 2.0 */
		pe20_ichg_level_threshold = <1000000>; /* uA */
		ta_start_battery_soc = <0>;
		ta_stop_battery_soc = <85>;

		/* PE 4.0 single charger*/
		pe40_single_charger_input_current = <3000000>;
		pe40_single_charger_current = <3000000>;

		/* PE 4.0 dual charger*/
		pe40_dual_charger_input_current = <3000000>;
		pe40_dual_charger_chg1_current = <2000000>;
		pe40_dual_charger_chg2_current = <2000000>;
		pe40_stop_battery_soc = <80>;

		/* PE 4.0 cable impedance (mohm) */
		pe40_r_cable_1a_lower = <553>;
		pe40_r_cable_2a_lower = <415>;
		pe40_r_cable_3a_lower = <275>;

		/* dual charger */
		chg1_ta_ac_charger_current = <1500000>;
		chg2_ta_ac_charger_current = <1500000>;

		/* cable measurement impedance */
		cable_imp_threshold = <699>;
		vbat_cable_imp_threshold = <3900000>; /* uV */

		/* bif */
		bif_threshold1 = <4250000>;
		bif_threshold2 = <4300000>;
		bif_cv_under_threshold2 = <4450000>;
	};

	rt-pd-manager {
		compatible = "mediatek,rt-pd-manager";
	};

	subpmic_pmu_eint: mt6360_pmu_eint {
	};
	tcpc_pd: tcpc_pd {
	};

	gyro:gyro {
	};

	als: als {
	};

	smart_pa: smart_pa {
	};

	md1_sim1_hot_plug_eint: md1_sim1_hot_plug_eint {
	};

	md1_sim2_hot_plug_eint: md1_sim2_hot_plug_eint {
	};
};

&pio {
	aud_clk_mosi_off: aud_clk_mosi_off {
		pins_cmd0_dat {
			pinmux = <PINMUX_GPIO189__FUNC_GPIO189>,
				 <PINMUX_GPIO190__FUNC_GPIO190>;
		};
	};
	aud_clk_mosi_on: aud_clk_mosi_on {
		pins_cmd0_dat {
			pinmux = <PINMUX_GPIO189__FUNC_AUD_CLK_MOSI>,
				 <PINMUX_GPIO190__FUNC_AUD_SYNC_MOSI>;
		};
	};
	aud_dat_mosi_off: aud_dat_mosi_off {
		pins_cmd1_dat {
			pinmux = <PINMUX_GPIO191__FUNC_GPIO191>;
			input-enable;
			slew-rate = <0>;
			bias-disable;
		};
		pins_cmd2_dat {
			pinmux = <PINMUX_GPIO192__FUNC_GPIO192>;
			input-enable;
			slew-rate = <0>;
			bias-disable;
		};
	};
	aud_dat_mosi_on: aud_dat_mosi_on {
		pins_cmd1_dat {
			pinmux = <PINMUX_GPIO191__FUNC_AUD_DAT_MOSI0>,
				 <PINMUX_GPIO192__FUNC_AUD_DAT_MOSI1>;
		};
	};
	aud_dat_mosi_ch34_off: aud_dat_mosi_ch34_off {
		pins_cmd1_dat {
			pinmux = <PINMUX_GPIO143__FUNC_GPIO143>;
			input-enable;
			slew-rate = <0>;
			bias-disable;
		};
	};
	aud_dat_mosi_ch34_on: aud_dat_mosi_ch34_on {
		pins_cmd1_dat {
			pinmux = <PINMUX_GPIO143__FUNC_AUD_DAT_MOSI2>;
		};
	};
	aud_dat_miso_off: aud_dat_miso_off {
		pins_cmd1_dat {
			pinmux = <PINMUX_GPIO193__FUNC_GPIO193>;
			input-enable;
			slew-rate = <0>;
			bias-disable;
		};
		pins_cmd2_dat {
			pinmux = <PINMUX_GPIO194__FUNC_GPIO194>;
			input-enable;
			slew-rate = <0>;
			bias-disable;
		};
	};
	aud_dat_miso_on: aud_dat_miso_on {
		pins_cmd1_dat {
			pinmux = <PINMUX_GPIO193__FUNC_AUD_DAT_MISO0>;
			input-schmitt-enable;
		};
		pins_cmd2_dat {
			pinmux = <PINMUX_GPIO194__FUNC_AUD_DAT_MISO1>;
			input-schmitt-enable;
		};
	};
	aud_dat_miso_ch34_off: aud_dat_miso_ch34_off {
		pins_cmd1_dat {
			pinmux = <PINMUX_GPIO146__FUNC_GPIO146>;
			input-enable;
			slew-rate = <0>;
			bias-disable;
		};
	};
	aud_dat_miso_ch34_on: aud_dat_miso_ch34_on {
		pins_cmd1_dat {
			pinmux = <PINMUX_GPIO146__FUNC_AUD_DAT_MISO2>;
			input-schmitt-enable;
		};
	};
	vow_dat_miso_off: vow_dat_miso_off {
		pins_cmd1_dat {
			pinmux = <PINMUX_GPIO193__FUNC_GPIO193>;
		};
	};
	vow_dat_miso_on: vow_dat_miso_on {
		pins_cmd1_dat {
			pinmux = <PINMUX_GPIO193__FUNC_VOW_DAT_MISO>;
		};
	};
	vow_clk_miso_off: vow_clk_miso_off {
		pins_cmd3_dat {
			pinmux = <PINMUX_GPIO194__FUNC_GPIO194>;
			input-schmitt-enable;
		};
	};
	vow_clk_miso_on: vow_clk_miso_on {
		pins_cmd3_dat {
			pinmux = <PINMUX_GPIO194__FUNC_VOW_CLK_MISO>;
			input-schmitt-enable;
		};
	};
	aud_nle_mosi_off: aud_nle_mosi_off {
		pins_cmd3_dat {
			pinmux = <PINMUX_GPIO144__FUNC_GPIO144>,
				 <PINMUX_GPIO145__FUNC_GPIO145>;
		};
	};
	aud_nle_mosi_on: aud_nle_mosi_on {
		pins_cmd3_dat {
			pinmux = <PINMUX_GPIO144__FUNC_AUD_NLE_MOSI1>,
				 <PINMUX_GPIO145__FUNC_AUD_NLE_MOSI0>;
		};
	};
	aud_dat_miso2_off: aud_dat_miso2_off {
		pins_cmd3_dat {
			pinmux = <PINMUX_GPIO146__FUNC_GPIO146>;
		};
	};
	aud_dat_miso2_on: aud_dat_miso2_on {
		pins_cmd3_dat {
			pinmux = <PINMUX_GPIO146__FUNC_AUD_DAT_MISO2>;
		};
	};
	aud_gpio_i2s0_off: aud_gpio_i2s0_off {
		pins_cmd_dat {
			pinmux = <PINMUX_GPIO70__FUNC_GPIO70>;
		};
	};
	aud_gpio_i2s0_on: aud_gpio_i2s0_on {
		pins_cmd_dat {
			pinmux = <PINMUX_GPIO70__FUNC_I2S0_DI>;
		};
	};
	aud_gpio_i2s1_off: aud_gpio_i2s1_off {
	};
	aud_gpio_i2s1_on: aud_gpio_i2s1_on {
	};
	aud_gpio_i2s2_off: aud_gpio_i2s2_off {
	};
	aud_gpio_i2s2_on: aud_gpio_i2s2_on {
	};
	aud_gpio_i2s3_off: aud_gpio_i2s3_off {
		pins_cmd_dat {
			pinmux = <PINMUX_GPIO67__FUNC_GPIO67>,
				 <PINMUX_GPIO68__FUNC_GPIO68>,
				 <PINMUX_GPIO71__FUNC_GPIO71>;
		};
	};
	aud_gpio_i2s3_on: aud_gpio_i2s3_on {
		pins_cmd_dat {
			pinmux = <PINMUX_GPIO67__FUNC_I2S3_LRCK>,
				 <PINMUX_GPIO68__FUNC_I2S3_DO>,
				 <PINMUX_GPIO71__FUNC_I2S3_BCK>;
		};
	};
	aud_gpio_i2s5_off: aud_gpio_i2s5_off {
	};
	aud_gpio_i2s5_on: aud_gpio_i2s5_on {
	};
};

#include "mt6359.dtsi"
#include "cust_mt6779_msdc.dtsi"

#ifdef CONFIG_MTK_ENABLE_GENIEZONE
#include "trusty.dtsi"
#endif
#include "mt6360.dtsi"
#include "mt6360_pd.dtsi"
