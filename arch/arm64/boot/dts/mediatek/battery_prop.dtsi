bat_gm30: bat_gm30{
	compatible = "mediatek,bat_gm30";
	g_FG_PSEUDO100_T0 = <(98)>;	/*	Pseudo 100% percentage at T0.*/
	g_FG_PSEUDO100_T1 = <(95)>;	/*	Pseudo 100% percentage at T1.*/
	g_FG_PSEUDO100_T2 = <(90)>;	/*	Pseudo 100% percentage at T2.*/
	g_FG_PSEUDO100_T3 = <(80)>;	/*	Pseudo 100% percentage at T3.*/
	DIFFERENCE_FULLOCV_ITH = <(150)>;	/*	Charging termination current.*/
	MTK_CHR_EXIST = <(1)>;	/*	Configures whether MTK charger exist or not.*/
	Q_MAX_SYS_VOLTAGE_BAT0 = <(3200)>;	/*	System shut down voltage.*/
	Q_MAX_SYS_VOLTAGE_BAT1 = <(3200)>;	/*	System shut down voltage.*/
	Q_MAX_SYS_VOLTAGE_BAT2 = <(3200)>;	/*	System shut down voltage.*/
	Q_MAX_SYS_VOLTAGE_BAT3 = <(3200)>;	/*	System shut down voltage.*/
	SHUTDOWN_1_TIME = <(60)>;	/*	Configures how long should ui_soc keep showing 1%.*/
	KEEP_100_PERCENT = <(2)>;	/*	Configures how long should ui_soc keeps 100% after unplugged.*/
	R_FG_VALUE = <(10)>;	/*	R_sense resistance.*/
	TEMPERATURE_T0 = <(25)>;	/*	Battery temperature T0*/
	TEMPERATURE_T1 = <(10)>;	/*	Battery temperature T1*/
	TEMPERATURE_T2 = <(0)>;	/*	Battery temperature T2*/
	TEMPERATURE_T3 = <(-10)>;	/*	Battery temperature T3*/
	EMBEDDED_SEL = <(0)>;	/*	Configures whether using embedded battery or not.*/
	PMIC_SHUTDOWN_CURRENT = <(20)>;	/*	System shutdown current.*/
	FG_METER_RESISTANCE = <(50)>;	/*	The resistance of PCB*/
	CAR_TUNE_VALUE = <(100)>;	/*	Tune value for current measurement.*/
#if (CONFIG_MTK_ADDITIONAL_BATTERY_TABLE == 1)
#include "battery_table_ext.dtsi"
#else
#include "battery_table.dtsi"
#endif
};
