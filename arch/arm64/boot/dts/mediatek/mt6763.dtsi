/*
 * Mediatek's MT3887 SoC device tree source
 *
 * Copyright (C) 2015 MediaTek Inc.
 *
 * This program is free software; you can redistribute it and/or modify
 * it under the terms of the GNU General Public License version 2 as
 * published by the Free Software Foundation.
 *
 * This program is distributed in the hope that it will be useful,
 * but WITHOUT ANY WARRANTY; without even the implied warranty of
 * MERCHANTABILITY or FITNESS FOR A PARTICULAR PURPOSE.
 * See http://www.gnu.org/licenses/gpl-2.0.html for more details.
 */

#include <dt-bindings/interrupt-controller/arm-gic.h>
#include <dt-bindings/interrupt-controller/irq.h>
#include <dt-bindings/mmc/mt6763-msdc.h>
#include <dt-bindings/gce/mt6763-gce.h>
#include <generated/autoconf.h>
/ {
	model = "MT3887";
	compatible = "mediatek,MT3887";
	interrupt-parent = <&sysirq>;
	#address-cells = <2>;
	#size-cells = <2>;

	/* chosen */
	chosen {
	bootargs = "console=tty0 console=ttyMT0,921600n1 root=/dev/ram\
initrd=0x45000000,0x200000 loglevel=8 androidboot.selinux=permissive \
loop.max_part=7";
	};

	cpus {
	};

	memory {
		device_type = "memory";
		reg = <0 0x40000000 0 0x20000000>;
	};

	reserved-memory {
		#address-cells = <2>;
		#size-cells = <2>;
		ranges;

		reserve-memory-sspm_share {
			compatible = "mediatek,reserve-memory-sspm_share";
			no-map;
			status = "okay";
			size = <0 0x110000>; /* 1M + 64K */
			alignment = <0 0x10000>;
			alloc-ranges = <0 0x40000000 0 0x60000000>;
		};
	};

	/* ATF logger SW IRQ number 279 = 32 + 247 */
	atf_logger {
		compatible = "mediatek,atf_logger";
		interrupts = <GIC_SPI 247 IRQ_TYPE_EDGE_RISING>;
	};

	gic: interrupt-controller@0c000000 {
		compatible = "arm,gic-v3";
		#interrupt-cells = <3>;
		#address-cells = <2>;
		#size-cells = <2>;
		#redistributor-regions = <1>;
		interrupt-parent = <&gic>;
		interrupt-controller;
		reg = <0 0x0c000000 0 0x40000>, // distributor
		      <0 0x0c100000 0 0x200000>; // redistributor
		interrupts = <GIC_PPI 9 IRQ_TYPE_LEVEL_HIGH>;
	};

	sysirq: intpol-controller@10200a80 {
		compatible = "mediatek,mt6577-sysirq";
		interrupt-controller;
		#interrupt-cells = <3>;
		interrupt-parent = <&gic>;
		reg = <0 0x10200a80 0 0x50>;
	};


	infracfg_ao@10001000 {
		compatible = "mediatek,infracfg_ao";
		reg = <0 0x10001000 0 0x0>;
		interrupts = <GIC_SPI 147 IRQ_TYPE_EDGE_RISING>;
	};

	topckgen@10000000 {
		compatible = "mediatek,topckgen";
		reg = <0 0x10000000 0 0x0>;
	};

	pericfg@10003000 {
		compatible = "mediatek,pericfg";
		reg = <0 0x10003000 0 0x0>;
	};

	efuse_dbg@10004000 {
		compatible = "mediatek,efuse_dbg";
		reg = <0 0x10004000 0 0x0>;
	};

	gpio: gpio@10005000 {
		compatible = "mediatek,gpio";
		reg = <0 0x10005000 0 0x0>;
	};

	iocfg_lt@11f20000 {
		compatible = "mediatek,iocfg_lt";
		reg = <0 0x11f20000 0 0x1000>;
	};

	iocfg_lm@11e80000 {
		compatible = "mediatek,iocfg_lm";
		reg = <0 0x11e80000 0 0x1000>;
	};

	iocfg_lb@11e70000 {
		compatible = "mediatek,iocfg_lb";
		reg = <0 0x11e70000 0 0x1000>;
	};

	iocfg_bl@11e90000 {
		compatible = "mediatek,iocfg_bl";
		reg = <0 0x11e90000 0 0x1000>;
	};

	iocfg_rb@11d30000 {
		compatible = "mediatek,iocfg_rb";
		reg = <0 0x11d30000 0 0x1000>;
	};

	iocfg_rm@11d20000 {
		compatible = "mediatek,iocfg_rm";
		reg = <0 0x11d20000 0 0x1000>;
	};

	iocfg_rt@11c50000 {
		compatible = "mediatek,iocfg_rt";
		reg = <0 0x11c50000 0 0x1000>;
	};

	iocfg_tl@11f30000 {
		compatible = "mediatek,iocfg_tl";
		reg = <0 0x11f30000 0 0x1000>;
	};

	pio: pinctrl@1000b000 {
		compatible = "mediatek,pinctrl";
		reb_bases = <&gpio>,
			    <&iocfg_lt>,
			    <&iocfg_lm>,
			    <&iocfg_lb>,
			    <&iocfg_bl>,
			    <&iocfg_rb>,
			    <&iocfg_rm>,
			    <&iocfg_rt>,
			    <&iocfg_tl>;
		reg_base_eint = <&eint>;
		pins-are-numbered;
		gpio-controller;
		#gpio-cells = <2>;
		gpio-ranges = <&pio 0 0 163>;
		interrupt-controller;
		#interrupt-cells = <4>;
		interrupts = <GIC_SPI 167 IRQ_TYPE_LEVEL_HIGH>;
	};

	sleep@10006000 {
		compatible = "mediatek,sleep";
		reg = <0 0x10006000 0 0x0>;
		interrupts = <GIC_SPI 181 IRQ_TYPE_LEVEL_LOW>;
	};

	toprgu@10007000 {
		compatible = "mediatek,toprgu";
		reg = <0 0x10007000 0 0x0>;
		interrupts = <GIC_SPI 139 IRQ_TYPE_NONE>;
	};

	timer {
		compatible = "arm,armv8-timer";
		interrupt-parent = <&gic>;
		interrupts = <GIC_PPI 13 IRQ_TYPE_LEVEL_LOW>,
			     <GIC_PPI 14 IRQ_TYPE_LEVEL_LOW>,
			     <GIC_PPI 11 IRQ_TYPE_LEVEL_LOW>,
			     <GIC_PPI 10 IRQ_TYPE_LEVEL_LOW>;
		/* clock-frequency = <13000000>; */
		clock-frequency = <150000000>;
	};

	apxgpt@10008000 {
		compatible = "mediatek,apxgpt";
		reg = <0 0x10008000 0 0x1000>;
		interrupts = <GIC_SPI 170 IRQ_TYPE_LEVEL_LOW>;
	};

	sej@1000a000 {
		compatible = "mediatek,sej";
		reg = <0 0x1000a000 0 0x0>;
		interrupts = <GIC_SPI 189 IRQ_TYPE_LEVEL_LOW>;
	};

	eint: apirq@1000b000 {
		compatible = "mediatek,apirq";
		reg = <0 0x1000b000 0 0x0>;
		interrupts = <GIC_SPI 171 IRQ_TYPE_LEVEL_HIGH>;
	};

	apmixed@1000c000 {
		compatible = "mediatek,apmixed";
		reg = <0 0x1000c000 0 0x0>;
	};

	fhctl@1000ce00 {
		compatible = "mediatek,fhctl";
		reg = <0 0x1000ce00 0 0x0>;
	};

	pwrap@1000d000 {
		compatible = "mediatek,pwrap";
		reg = <0 0x1000d000 0 0x0>;
		interrupts = <GIC_SPI 179 IRQ_TYPE_LEVEL_HIGH>;
	};

	devapc_ao_infra_peri@1000e000 {
		compatible = "mediatek,devapc_ao_infra_peri";
		reg = <0 0x1000e000 0 0x0>;
	};

	sleep_reg_md@1000f000 {
		compatible = "mediatek,sleep_reg_md";
		reg = <0 0x1000f000 0 0x0>;
	};

	kp@10010000 {
		compatible = "mediatek,kp";
		reg = <0 0x10010000 0 0x0>;
		interrupts = <GIC_SPI 180 IRQ_TYPE_EDGE_FALLING>;
	};

	topmisc@10011000 {
		compatible = "mediatek,topmisc";
		reg = <0 0x10011000 0 0x0>;
	};

	dvfsrc@10012000 {
		compatible = "mediatek,dvfsrc";
		reg = <0 0x10012000 0 0x0>;
	};

	mbist_ao@10013000 {
		compatible = "mediatek,mbist_ao";
		reg = <0 0x10013000 0 0x0>;
	};

	apcldmain_ao@10014000 {
		compatible = "mediatek,apcldmain_ao";
		reg = <0 0x10014000 0 0x0>;
	};

	apcldmaout_ao@10014400 {
		compatible = "mediatek,apcldmaout_ao";
		reg = <0 0x10014400 0 0x0>;
	};

	apcldmamisc_ao@10014800 {
		compatible = "mediatek,apcldmamisc_ao";
		reg = <0 0x10014800 0 0x0>;
	};

	apcldmamisc_ao@10014c00 {
		compatible = "mediatek,apcldmamisc_ao";
		reg = <0 0x10014c00 0 0x0>;
	};

	ddrphy@10015000 {
		compatible = "mediatek,ddrphy";
		reg = <0 0x10015000 0 0x0>;
	};

	aes_top0@10016000 {
		compatible = "mediatek,aes_top0";
		reg = <0 0x10016000 0 0x0>;
	};

	sys_timer@10017000 {
		compatible = "mediatek,sys_timer";
		reg = <0 0x10017000 0 0x0>;
		interrupts = <GIC_SPI 194 IRQ_TYPE_LEVEL_HIGH>;
	};

	modem_temp_share@10018000 {
		compatible = "mediatek,modem_temp_share";
		reg = <0 0x10018000 0 0x0>;
	};

	devapc_ao_md@10019000 {
		compatible = "mediatek,devapc_ao_md";
		reg = <0 0x10019000 0 0x0>;
	};

	security_ao@1001a000 {
		compatible = "mediatek,security_ao";
		reg = <0 0x1001a000 0 0x0>;
	};

	topckgen_ao@1001b000 {
		compatible = "mediatek,topckgen_ao";
		reg = <0 0x1001b000 0 0x0>;
	};

	devapc_ao_mm@1001c000 {
		compatible = "mediatek,devapc_ao_mm";
		reg = <0 0x1001c000 0 0x0>;
	};

	dramc0@1001d000 {
		compatible = "mediatek,dramc0";
		reg = <0 0x1001d000 0 0x0>;
	};

	ddrphy@1001e000 {
		compatible = "mediatek,ddrphy";
		reg = <0 0x1001e000 0 0x0>;
	};

	iocfg_0@10002000 {
		compatible = "mediatek,iocfg_0";
		reg = <0 0x10002000 0 0x0>;
	};

	iocfg_1@10002200 {
		compatible = "mediatek,iocfg_1";
		reg = <0 0x10002200 0 0x0>;
	};

	iocfg_2@10002400 {
		compatible = "mediatek,iocfg_2";
		reg = <0 0x10002400 0 0x0>;
	};

	iocfg_3@10002600 {
		compatible = "mediatek,iocfg_3";
		reg = <0 0x10002600 0 0x0>;
	};

	iocfg_4@10002800 {
		compatible = "mediatek,iocfg_4";
		reg = <0 0x10002800 0 0x0>;
	};

	iocfg_5@10002a00 {
		compatible = "mediatek,iocfg_5";
		reg = <0 0x10002a00 0 0x0>;
	};

	mdcldmain_ao@10015000 {
		compatible = "mediatek,mdcldmain_ao";
		reg = <0 0x10015000 0 0x0>;
	};

	mdcldmaout_ao@10015400 {
		compatible = "mediatek,mdcldmaout_ao";
		reg = <0 0x10015400 0 0x0>;
	};

	mdcldmamisc_ao@10015800 {
		compatible = "mediatek,mdcldmamisc_ao";
		reg = <0 0x10015800 0 0x0>;
	};

	sys_cirq@10204000 {
		compatible = "mediatek,sys_cirq";
		reg = <0 0x10204000 0 0x0>;
		interrupts = <GIC_SPI 280 IRQ_TYPE_LEVEL_LOW>;
	};

	mcucfg@10200000 {
		compatible = "mediatek,mcucfg";
		reg = <0 0x10200000 0 0x0>;
		interrupts = <GIC_SPI 0 IRQ_TYPE_LEVEL_LOW>;
	};

	mcucfg@10200200 {
		compatible = "mediatek,mcucfg";
		reg = <0 0x10200200 0 0x0>;
		interrupts = <GIC_SPI 1 IRQ_TYPE_LEVEL_LOW>;
	};

	mcucfg@10200400 {
		compatible = "mediatek,mcucfg";
		reg = <0 0x10200400 0 0x0>;
		interrupts = <GIC_SPI 2 IRQ_TYPE_LEVEL_LOW>;
	};

	mcucfg@10200600 {
		compatible = "mediatek,mcucfg";
		reg = <0 0x10200600 0 0x0>;
		interrupts = <GIC_SPI 3 IRQ_TYPE_LEVEL_LOW>;
	};

	mcucfg@10200800 {
		compatible = "mediatek,mcucfg";
		reg = <0 0x10200800 0 0x0>;
		interrupts = <GIC_SPI 4 IRQ_TYPE_LEVEL_LOW>;
	};

	mcucfg@10200a00 {
		compatible = "mediatek,mcucfg";
		reg = <0 0x10200a00 0 0x0>;
		interrupts = <GIC_SPI 5 IRQ_TYPE_LEVEL_LOW>;
	};

	mcucfg@10200f00 {
		compatible = "mediatek,mcucfg";
		reg = <0 0x10200f00 0 0x0>;
		interrupts = <GIC_SPI 6 IRQ_TYPE_LEVEL_LOW>;
	};

	m4u@10205000 {
		cell-index = <0>;
		compatible = "mediatek,m4u";
		reg = <0 0x10205000 0 0x1000>;
		interrupts = <GIC_SPI 158 IRQ_TYPE_LEVEL_LOW>;
	};

	devapc@10207000 {
		compatible = "mediatek,devapc";
		reg = <0 0x10207000 0 0x0>;
		interrupts = <GIC_SPI 142 IRQ_TYPE_LEVEL_LOW>;
	};

	bus_dbg@10208000 {
		compatible = "mediatek,bus_dbg";
		reg = <0 0x10208000 0 0x0>;
		interrupts = <GIC_SPI 141 IRQ_TYPE_LEVEL_LOW>;
	};

	ap_ccif0@10209000 {
		compatible = "mediatek,ap_ccif0";
		reg = <0 0x10209000 0 0x0>;
		interrupts = <GIC_SPI 148 IRQ_TYPE_LEVEL_LOW>;
	};

	md_ccif0@1020a000 {
		compatible = "mediatek,md_ccif0";
		reg = <0 0x1020a000 0 0x0>;
	};

	ap_ccif1@1020b000 {
		compatible = "mediatek,ap_ccif1";
		reg = <0 0x1020b000 0 0x0>;
		interrupts = <GIC_SPI 150 IRQ_TYPE_LEVEL_LOW>;
	};

	md_ccif1@1020c000 {
		compatible = "mediatek,md_ccif1";
		reg = <0 0x1020c000 0 0x0>;
	};

	infra_mbist@1020d000 {
		compatible = "mediatek,infra_mbist";
		reg = <0 0x1020d000 0 0x0>;
	};

	infracfg@1020e000 {
		compatible = "mediatek,infracfg";
		reg = <0 0x1020e000 0 0x0>;
	};

	trng@1020f000 {
		compatible = "mediatek,trng";
		reg = <0 0x1020f000 0 0x0>;
		interrupts = <GIC_SPI 161 IRQ_TYPE_LEVEL_LOW>;
	};

	dxcc_sec@10210000 {
		compatible = "mediatek,dxcc_sec";
		reg = <0 0x10210000 0 0x0>;
		interrupts = <GIC_SPI 162 IRQ_TYPE_LEVEL_HIGH>;
	};

	mcupm_sram2@10211000 {
		compatible = "mediatek,mcupm_sram2";
		reg = <0 0x10211000 0 0x0>;
	};

	cq_dma@10212000 {
		compatible = "mediatek,cq_dma";
		reg = <0 0x10212000 0 0x0>;
	};

	mcupm_sram3@10213000 {
		compatible = "mediatek,mcupm_sram3";
		reg = <0 0x10213000 0 0x0>;
	};

	sramrom@10214000 {
		compatible = "mediatek,sramrom";
		reg = <0 0x10214000 0 0x0>;
	};

	mipi_tx0@10215000 {
		compatible = "mediatek,mipi_tx0";
		reg = <0 0x10215000 0 0x0>;
	};

	mcupm_reg@10216000 {
		compatible = "mediatek,mcupm_reg";
		reg = <0 0x10216000 0 0x0>;
	};

	mcupm_sram0@10217000 {
		compatible = "mediatek,mcupm_sram0";
		reg = <0 0x10217000 0 0x0>;
	};

	mcupm_sram1@10218000 {
		compatible = "mediatek,mcupm_sram1";
		reg = <0 0x10218000 0 0x0>;
	};

	emi@10219000 {
		compatible = "mediatek,emi";
		reg = <0 0x10219000 0 0x0>;
		interrupts = <GIC_SPI 144 IRQ_TYPE_LEVEL_LOW>;
	};

	chn_emi@1021a000 {
		compatible = "mediatek,chn_emi";
		reg = <0 0x1021a000 0 0x0>;
	};

	apcldmain@1021b000 {
		compatible = "mediatek,apcldmain";
		reg = <0 0x1021b000 0 0x0>;
	};

	apcldmain@1021b100 {
		compatible = "mediatek,apcldmain";
		reg = <0 0x1021b100 0 0x0>;
	};

	apcldmaout@1021b400 {
		compatible = "mediatek,apcldmaout";
		reg = <0 0x1021b400 0 0x0>;
	};

	apcldmaout@1021b500 {
		compatible = "mediatek,apcldmaout";
		reg = <0 0x1021b500 0 0x0>;
	};

	apcldmamisc@1021b800 {
		compatible = "mediatek,apcldmamisc";
		reg = <0 0x1021b800 0 0x0>;
		interrupts = <GIC_SPI 165 IRQ_TYPE_LEVEL_HIGH>;
	};

	apcldmamisc@1021b900 {
		compatible = "mediatek,apcldmamisc";
		reg = <0 0x1021b900 0 0x0>;
	};

	mdcldmain@1021c000 {
		compatible = "mediatek,mdcldmain";
		reg = <0 0x1021c000 0 0x0>;
	};

	mdcldmaout@1021c400 {
		compatible = "mediatek,mdcldmaout";
		reg = <0 0x1021c400 0 0x0>;
	};

	mdcldmamisc@1021c000 {
		compatible = "mediatek,mdcldmamisc";
		reg = <0 0x1021c000 0 0x0>;
	};

	mdcldmamisc@1021c900 {
		compatible = "mediatek,mdcldmamisc";
		reg = <0 0x1021c900 0 0x0>;
	};

	dramc_nao@1021d000 {
		compatible = "mediatek,dramc_nao";
		reg = <0 0x1021d000 0 0x0>;
	};

	bpi_bsi_slv0@1021e000 {
		compatible = "mediatek,bpi_bsi_slv0";
		reg = <0 0x1021e000 0 0x0>;
	};

	bpi_bsi_slv1@1021f000 {
		compatible = "mediatek,bpi_bsi_slv1";
		reg = <0 0x1021f000 0 0x0>;
	};

	bpi_bsi_slv2@10225000 {
		compatible = "mediatek,bpi_bsi_slv2";
		reg = <0 0x10225000 0 0x0>;
	};

	emi_mpu@10226000 {
		compatible = "mediatek,emi_mpu";
		reg = <0 0x10226000 0 0x0>;
	};

	dvfsp@10227000 {
		compatible = "mediatek,dvfsp";
		reg = <0 0x10227000 0 0x0>;
	};

	dramc_ch0_top0@10228000 {
		compatible = "mediatek,dramc_ch0_top0";
		reg = <0 0x10228000 0 0x0>;
	};

	dramc_ch0_top1@1022a000 {
		compatible = "mediatek,dramc_ch0_top1";
		reg = <0 0x1022a000 0 0x0>;
	};

	dramc_ch0_top2@1022c000 {
		compatible = "mediatek,dramc_ch0_top2";
		reg = <0 0x1022c000 0 0x0>;
	};

	dramc_ch0_top3@1022d000 {
		compatible = "mediatek,dramc_ch0_top3";
		reg = <0 0x1022d000 0 0x0>;
	};

	dramc_ch0_rsv@1022e000 {
		compatible = "mediatek,dramc_ch0_rsv";
		reg = <0 0x1022e000 0 0x0>;
	};

	dramc_ch1_top0@10230000 {
		compatible = "mediatek,dramc_ch1_top0";
		reg = <0 0x10230000 0 0x0>;
	};

	dramc_ch1_top1@10232000 {
		compatible = "mediatek,dramc_ch1_top1";
		reg = <0 0x10232000 0 0x0>;
	};

	dramc_ch1_top2@10234000 {
		compatible = "mediatek,dramc_ch1_top2";
		reg = <0 0x10234000 0 0x0>;
	};

	dramc_ch1_top3@10235000 {
		compatible = "mediatek,dramc_ch1_top3";
		reg = <0 0x10235000 0 0x0>;
	};

	dramc_ch1_rsv@10236000 {
		compatible = "mediatek,dramc_ch1_rsv";
		reg = <0 0x10236000 0 0x0>;
	};

	gce_mbox: gce_mbox@10238000 {
		compatible = "mediatek,mailbox-gce";
		reg = <0 0x10238000 0 0x4000>;
		interrupts = <GIC_SPI 154 IRQ_TYPE_LEVEL_LOW>;
		#mbox-cells = <3>;
		#gce-event-cells = <1>;
		#gce-subsys-cells = <2>;
		max_prefetch_cnt = <4>;
		prefetch_size = <160 32 32 32>;
		clocks = <&infracfg_ao INFRACFG_AO_GCE_CG>,
			<&infracfg_ao INFRACFG_AO_GCE_26M_CG>;
		clock-names = "gce", "GCE_TIMER";
	};

#if defined(CONFIG_MTK_SEC_VIDEO_PATH_SUPPORT) || \
	defined(CONFIG_MTK_CAM_SECURITY_SUPPORT)
	gce_mbox_svp: gce_mbox_svp@10238000 {
		compatible = "mediatek,mailbox-gce-svp";
		reg = <0 0x10238000 0 0x4000>;
		interrupts = <GIC_SPI 154 IRQ_TYPE_LEVEL_LOW>,
			<GIC_SPI 155 IRQ_TYPE_LEVEL_LOW>;
		#mbox-cells = <3>;
		clocks = <&infracfg_ao INFRACFG_AO_GCE_CG>,
			<&infracfg_ao INFRACFG_AO_GCE_26M_CG>;
		clock-names = "GCE", "GCE_TIMER";
	};
#endif

	gce@10238000 {
		compatible = "mediatek,gce";
		reg = <0 0x10238000 0 0x4000>;
		interrupts = <GIC_SPI 154 IRQ_TYPE_LEVEL_LOW>,
			<GIC_SPI 155 IRQ_TYPE_LEVEL_LOW>;
		g3d_config_base = <0x13000000 0 0xffff0000>;
		mmsys_config_base = <0x14000000 1 0xffff0000>;
		disp_dither_base = <0x14010000 2 0xffff0000>;
		mm_na_base = <0x14020000 3 0xffff0000>;
		imgsys_base = <0x15020000 4 0xffff0000>;
		vdec_gcon_base = <0x18800000 5 0xffff0000>;
		venc_gcon_base = <0x18810000 6 0xffff0000>;
		conn_peri_base = <0x18820000 7 0xffff0000>;
		topckgen_base = <0x18830000 8 0xffff0000>;
		kp_base = <0x18840000 9 0xffff0000>;
		scp_sram_base = <0x10000000 10 0xffff0000>;
		infra_na3_base = <0x10010000 11 0xffff0000>;
		infra_na4_base = <0x10020000 12 0xffff0000>;
		scp_base = <0x10030000 13 0xffff0000>;
		mcucfg_base = <0x10040000 14 0xffff0000>;
		gcpu_base = <0x10050000 15 0xffff0000>;
		usb0_base = <0x10200000 16 0xffff0000>;
		usb_sif_base = <0x10280000 17 0xffff0000>;
		audio_base = <0x17000000 18 0xffff0000>;
		vdec_base = <0x17010000 19 0xffff0000>;
		msdc2_base = <0x17020000 20 0xffff0000>;
		vdec1_base = <0x17030000 21 0xffff0000>;
		msdc3_base = <0x18000000 22 0xffff0000>;
		ap_dma_base = <0x18010000 23 0xffff0000>;
		gce_base = <0x18020000 24 0xffff0000>;
		vdec2_base = <0x18040000 25 0xffff0000>;
		vdec3_base = <0x18050000 26 0xffff0000>;
		camsys_base = <0x18080000 27 0xffff0000>;
		camsys1_base = <0x180a0000 28 0xffff0000>;
		camsys2_base = <0x180b0000 29 0xffff0000>;
		pwm_sw_base = <0x1100e000 99 0xffff0000>;
		mdp_rdma0_sof = <0>;
		mdp_ccorr0_sof = <1>;
		mdp_rsz0_sof = <2>;
		mdp_rsz1_sof = <3>;
		mdp_wdma_sof = <4>;
		mdp_wrot0_sof = <5>;
		mdp_tdshp0_sof = <6>;
		disp_ovl0_sof = <7>;
		disp_2l_ovl0_sof = <8>;
		disp_rdma0_sof = <9>;
		disp_wdma0_sof = <10>;
		disp_color0_sof = <11>;
		disp_ccorr0_sof = <12>;
		disp_aal0_sof = <13>;
		disp_gamma0_sof = <14>;
		disp_dither0_sof = <15>;
		disp_dsi0_sof = <16>;
		disp_rsz0_sof = <17>;
		img_dl_relay_sof = <18>;
		disp_pwm0_sof = <19>;
		mdp_rdma0_frame_done = <20>;
		mdp_ccorr0_frame_done = <21>;
		mdp_rsz0_frame_done = <22>;
		mdp_rsz1_frame_done = <23>;
		mdp_wrot0_write_frame_done = <24>;
		mdp_wdma_frame_done = <25>;
		mdp_tdshp0_frame_done = <26>;
		disp_ovl0_frame_done = <27>;
		disp_2l_ovl0_frame_done = <28>;
		disp_rsz0_frame_done = <29>;
		disp_rdma0_frame_done = <30>;
		disp_wdma0_frame_done = <31>;
		disp_color0_frame_done = <32>;
		disp_ccorr0_frame_done = <33>;
		disp_aal0_frame_done = <34>;
		disp_gamma0_frame_done = <35>;
		disp_dither0_frame_done = <36>;
		disp_dsi0_frame_done = <37>;
		stream_done_0 = <130>;
		stream_done_1 = <131>;
		stream_done_2 = <132>;
		stream_done_3 = <133>;
		stream_done_4 = <134>;
		stream_done_5 = <135>;
		stream_done_6 = <136>;
		stream_done_7 = <137>;
		stream_done_8 = <138>;
		stream_done_9 = <139>;
		buf_underrun_event_0 = <140>;
		dsi0_te_event = <141>;
		dsi0_irq_event = <142>;
		dsi0_done_event = <143>;
		disp_wdma0_rst_done = <147>;
		mdp_wdma_rst_done = <148>;
		mdp_wrot0_rst_done = <149>;
		mdp_rdma0_rst_done = <151>;
		disp_ovl0_frame_rst_done_pusle = <152>;
		dip_cq_thread0_frame_done = <257>;
		dip_cq_thread1_frame_done = <258>;
		dip_cq_thread2_frame_done = <259>;
		dip_cq_thread3_frame_done = <260>;
		dip_cq_thread4_frame_done = <261>;
		dip_cq_thread5_frame_done = <262>;
		dip_cq_thread6_frame_done = <263>;
		dip_cq_thread7_frame_done = <264>;
		dip_cq_thread8_frame_done = <265>;
		dip_cq_thread9_frame_done = <266>;
		dip_cq_thread10_frame_done = <267>;
		dip_cq_thread11_frame_done = <268>;
		dip_cq_thread12_frame_done = <269>;
		dip_cq_thread13_frame_done = <270>;
		dip_cq_thread14_frame_done = <271>;
		dip_cq_thread15_frame_done = <272>;
		dip_cq_thread16_frame_done = <273>;
		dip_cq_thread17_frame_done = <274>;
		dip_cq_thread18_frame_done = <275>;
		dve_frame_done = <276>;
		wmf_frame_done = <277>;
		rsc_frame_done = <278>;
		venc_done = <289>;
		jpgenc_done = <290>;
		jpgdec_done = <291>;
		venc_mb_done = <292>;
		venc_128byte_cnt_done = <293>;
		max_prefetch_cnt = <1>;
		prefetch_size = <96>;
		sram_size_cpr_64 = <64>;
		mmsys_config = <&mmsys_config>;
		mdp_rdma0 = <&mdp_rdma0>;
		mdp_rsz0 = <&mdp_rsz0>;
		mdp_rsz1 = <&mdp_rsz1>;
		mdp_wdma0 = <&mdp_wdma0>;
		mdp_wrot0 = <&mdp_wrot0>;
		mdp_tdshp0 = <&mdp_tdshp0>;
		mm_mutex = <&disp_mutex0>;
		sram_share_cnt = <1>;
		sram_share_engine = <11>;
		sram_share_event = <710>;
		thread_count = <24>;
		mediatek,mailbox-gce = <&gce_mbox>;
		mboxes = <&gce_mbox 0 0 CMDQ_THR_PRIO_4>,
			<&gce_mbox 1 0 CMDQ_THR_PRIO_4>,
			<&gce_mbox 2 0 CMDQ_THR_PRIO_5>,
			<&gce_mbox 3 0 CMDQ_THR_PRIO_4>,
			<&gce_mbox 4 0 CMDQ_THR_PRIO_4>,
			<&gce_mbox 5 0 CMDQ_THR_PRIO_4>,
			<&gce_mbox 6 0 CMDQ_THR_PRIO_4>,
			<&gce_mbox 7 CMDQ_NO_TIMEOUT CMDQ_THR_PRIO_2>,
#if defined(CONFIG_MTK_SEC_VIDEO_PATH_SUPPORT) || \
	defined(CONFIG_MTK_CAM_SECURITY_SUPPORT)
			secure_thread = <8 10>;
			<&gce_mbox_svp 8 0 CMDQ_THR_PRIO_4>,
			<&gce_mbox_svp 9 0 CMDQ_THR_PRIO_4>,
			<&gce_mbox_svp 10 0 CMDQ_THR_PRIO_1>,
#else
			<&gce_mbox 8 0 CMDQ_THR_PRIO_1>,
			<&gce_mbox 9 0 CMDQ_THR_PRIO_1>,
			<&gce_mbox 10 0 CMDQ_THR_PRIO_1>,
#endif
			<&gce_mbox 11 0 CMDQ_THR_PRIO_1>,
			<&gce_mbox 12 0 CMDQ_THR_PRIO_1>,
			<&gce_mbox 13 0 CMDQ_THR_PRIO_1>,
			<&gce_mbox 14 0 CMDQ_THR_PRIO_1>,
			<&gce_mbox 15 CMDQ_NO_TIMEOUT CMDQ_THR_PRIO_1>,
			<&gce_mbox 18 0 CMDQ_THR_PRIO_1>,
			<&gce_mbox 19 0 CMDQ_THR_PRIO_1>,
			<&gce_mbox 20 0 CMDQ_THR_PRIO_1>,
			<&gce_mbox 21 0 CMDQ_THR_PRIO_1>,
			<&gce_mbox 22 0 CMDQ_THR_PRIO_1>,
			<&gce_mbox 23 0 CMDQ_THR_PRIO_1>;
		clocks = <&infracfg_ao INFRACFG_AO_GCE_CG>,
			<&infracfg_ao INFRACFG_AO_GCE_26M_CG>;
		clock-names = "GCE", "GCE_TIMER";
	};

	ap_ccif2@1023c000 {
		compatible = "mediatek,ap_ccif2";
		reg = <0 0x1023c000 0 0x0>;
		interrupts = <GIC_SPI 143 IRQ_TYPE_LEVEL_LOW>;
	};

	md_ccif2@1023d000 {
		compatible = "mediatek,md_ccif2";
		reg = <0 0x1023d000 0 0x0>;
	};

	ap_ccif3@1023e000 {
		compatible = "mediatek,ap_ccif3";
		reg = <0 0x1023e000 0 0x0>;
		interrupts = <GIC_SPI 146 IRQ_TYPE_LEVEL_LOW>;
	};

	md_ccif3@1023f000 {
		compatible = "mediatek,md_ccif3";
		reg = <0 0x1023f000 0 0x0>;
	};

	sspm@10440000 {
		compatible = "mediatek,sspm";
		reg = <0 0x10440000 0 0x10000>,
			<0 0x10450000 0 0x100>,
			<0 0x10451000 0 0x8>,
			<0 0x10460000 0 0x100>,
			<0 0x10461000 0 0x8>,
			<0 0x10470000 0 0x100>,
			<0 0x10471000 0 0x8>,
			<0 0x10480000 0 0x100>,
			<0 0x10481000 0 0x8>,
			<0 0x10490000 0 0x100>,
			<0 0x10491000 0 0x8>;

		reg-names = "cfgreg",
			"mbox0_base",
			"mbox0_ctrl",
			"mbox1_base",
			"mbox1_ctrl",
			"mbox2_base",
			"mbox2_ctrl",
			"mbox3_base",
			"mbox3_ctrl",
			"mbox4_base",
			"mbox4_ctrl";

		interrupts = <GIC_SPI 202 IRQ_TYPE_LEVEL_HIGH>,
			<GIC_SPI 205 IRQ_TYPE_LEVEL_HIGH>,
			<GIC_SPI 206 IRQ_TYPE_LEVEL_HIGH>,
			<GIC_SPI 207 IRQ_TYPE_LEVEL_HIGH>,
			<GIC_SPI 208 IRQ_TYPE_LEVEL_HIGH>,
			<GIC_SPI 209 IRQ_TYPE_LEVEL_HIGH>;

		interrupt-names = "ipc",
			"mbox0",
			"mbox1",
			"mbox2",
			"mbox3",
			"mbox4";
	};

	gic500@0c000000 {
		compatible = "mediatek,gic500";
		reg = <0 0x0c000000 0 0x0>;
	};

	gic_cpu@0c400000 {
		compatible = "mediatek,gic_cpu";
		reg = <0 0x0c400000 0 0x0>;
	};

	dfd@0c600000 {
		compatible = "mediatek,dfd";
		reg = <0 0x0c600000 0 0x0>;
	};

	dbg_cti@0d020000 {
		compatible = "mediatek,dbg_cti";
		reg = <0 0x0d020000 0 0x0>;
	};

	dbg_etr@0d030000 {
		compatible = "mediatek,dbg_etr";
		reg = <0 0x0d030000 0 0x0>;
	};

	dbg_funnel@0d040000 {
		compatible = "mediatek,dbg_funnel";
		reg = <0 0x0d040000 0 0x0>;
	};

	dbg_dem@0d0a0000 {
		compatible = "mediatek,dbg_dem";
		reg = <0 0x0d0a0000 0 0x0>;
		interrupts = <GIC_SPI 140 IRQ_TYPE_LEVEL_LOW>;
	};

	dbg_mdsys1@0d0c0000 {
		compatible = "mediatek,dbg_mdsys1";
		reg = <0 0x0d0c0000 0 0x0>;
	};

	dbg_apmcu_mp0@0d400000 {
		compatible = "mediatek,dbg_apmcu_mp0";
		reg = <0 0x0d400000 0 0x0>;
	};

	dbg_apmcu_mp0@0d410000 {
		compatible = "mediatek,dbg_apmcu_mp0";
		reg = <0 0x0d410000 0 0x0>;
	};

	dbg_apmcu_mp0@0d420000 {
		compatible = "mediatek,dbg_apmcu_mp0";
		reg = <0 0x0d420000 0 0x0>;
	};

	dbg_apmcu_mp0@0d430000 {
		compatible = "mediatek,dbg_apmcu_mp0";
		reg = <0 0x0d430000 0 0x0>;
	};

	dbg_apmcu_mp0@0d440000 {
		compatible = "mediatek,dbg_apmcu_mp0";
		reg = <0 0x0d440000 0 0x0>;
	};

	dbg_apmcu_mp0@0d510000 {
		compatible = "mediatek,dbg_apmcu_mp0";
		reg = <0 0x0d510000 0 0x0>;
	};

	dbg_apmcu_mp0@0d520000 {
		compatible = "mediatek,dbg_apmcu_mp0";
		reg = <0 0x0d520000 0 0x0>;
	};

	dbg_apmcu_mp0@0d530000 {
		compatible = "mediatek,dbg_apmcu_mp0";
		reg = <0 0x0d530000 0 0x0>;
	};

	dbg_apmcu_mp0@0d540000 {
		compatible = "mediatek,dbg_apmcu_mp0";
		reg = <0 0x0d540000 0 0x0>;
	};

	dbg_apmcu_mp0@0d610000 {
		compatible = "mediatek,dbg_apmcu_mp0";
		reg = <0 0x0d610000 0 0x0>;
	};

	dbg_apmcu_mp0@0d620000 {
		compatible = "mediatek,dbg_apmcu_mp0";
		reg = <0 0x0d620000 0 0x0>;
	};

	dbg_apmcu_mp0@0d630000 {
		compatible = "mediatek,dbg_apmcu_mp0";
		reg = <0 0x0d630000 0 0x0>;
	};

	dbg_apmcu_mp0@0d640000 {
		compatible = "mediatek,dbg_apmcu_mp0";
		reg = <0 0x0d640000 0 0x0>;
	};

	dbg_apmcu_mp0@0d710000 {
		compatible = "mediatek,dbg_apmcu_mp0";
		reg = <0 0x0d710000 0 0x0>;
	};

	dbg_apmcu_mp0@0d720000 {
		compatible = "mediatek,dbg_apmcu_mp0";
		reg = <0 0x0d720000 0 0x0>;
	};

	dbg_apmcu_mp0@0d730000 {
		compatible = "mediatek,dbg_apmcu_mp0";
		reg = <0 0x0d730000 0 0x0>;
	};

	dbg_apmcu_mp0@0d740000 {
		compatible = "mediatek,dbg_apmcu_mp0";
		reg = <0 0x0d740000 0 0x0>;
	};

	dbg_apmcu_mp1@0d800000 {
		compatible = "mediatek,dbg_apmcu_mp1";
		reg = <0 0x0d800000 0 0x0>;
	};

	dbg_apmcu_mp1@0d810000 {
		compatible = "mediatek,dbg_apmcu_mp1";
		reg = <0 0x0d810000 0 0x0>;
	};

	dbg_apmcu_mp1@0d820000 {
		compatible = "mediatek,dbg_apmcu_mp1";
		reg = <0 0x0d820000 0 0x0>;
	};

	dbg_apmcu_mp1@0d830000 {
		compatible = "mediatek,dbg_apmcu_mp1";
		reg = <0 0x0d830000 0 0x0>;
	};

	dbg_apmcu_mp1@0d840000 {
		compatible = "mediatek,dbg_apmcu_mp1";
		reg = <0 0x0d840000 0 0x0>;
	};

	dbg_apmcu_mp1@0d910000 {
		compatible = "mediatek,dbg_apmcu_mp1";
		reg = <0 0x0d910000 0 0x0>;
	};

	dbg_apmcu_mp1@0d920000 {
		compatible = "mediatek,dbg_apmcu_mp1";
		reg = <0 0x0d920000 0 0x0>;
	};

	dbg_apmcu_mp1@0d930000 {
		compatible = "mediatek,dbg_apmcu_mp1";
		reg = <0 0x0d930000 0 0x0>;
	};

	dbg_apmcu_mp1@0d940000 {
		compatible = "mediatek,dbg_apmcu_mp1";
		reg = <0 0x0d940000 0 0x0>;
	};

	dbg_apmcu_mp1@0da10000 {
		compatible = "mediatek,dbg_apmcu_mp1";
		reg = <0 0x0da10000 0 0x0>;
	};

	dbg_apmcu_mp1@0da20000 {
		compatible = "mediatek,dbg_apmcu_mp1";
		reg = <0 0x0da20000 0 0x0>;
	};

	dbg_apmcu_mp1@0da30000 {
		compatible = "mediatek,dbg_apmcu_mp1";
		reg = <0 0x0da30000 0 0x0>;
	};

	dbg_apmcu_mp1@0da40000 {
		compatible = "mediatek,dbg_apmcu_mp1";
		reg = <0 0x0da40000 0 0x0>;
	};

	dbg_apmcu_mp1@0db10000 {
		compatible = "mediatek,dbg_apmcu_mp1";
		reg = <0 0x0db10000 0 0x0>;
	};

	dbg_apmcu_mp1@0db20000 {
		compatible = "mediatek,dbg_apmcu_mp1";
		reg = <0 0x0db20000 0 0x0>;
	};

	dbg_apmcu_mp1@0db30000 {
		compatible = "mediatek,dbg_apmcu_mp1";
		reg = <0 0x0db30000 0 0x0>;
	};

	dbg_apmcu_mp1@0db40000 {
		compatible = "mediatek,dbg_apmcu_mp1";
		reg = <0 0x0db40000 0 0x0>;
	};

	ap_dma@11000000 {
		compatible = "mediatek,ap_dma";
		reg = <0 0x11000000 0 0x0>;
		interrupts = <GIC_SPI 97 IRQ_TYPE_LEVEL_LOW>;
	};

	auxadc@11001000 {
		compatible = "mediatek,auxadc";
		reg = <0 0x11001000 0 0x0>;
		interrupts = <GIC_SPI 76 IRQ_TYPE_EDGE_FALLING>;
	};

	apuart0: apuart0@11002000 {
		cell-index = <0>;
		compatible = "mediatek,mtk-uart";
		reg = <0 0x11002000 0 0x1000>, /* UART base */
			<0 0x11000680 0 0x80>, /* DMA Tx base */
			<0 0x11000700 0 0x80>; /* DMA Rx base */
		interrupts = <GIC_SPI 91 IRQ_TYPE_LEVEL_LOW>, /* UART IRQ */
			<GIC_SPI 104 IRQ_TYPE_LEVEL_LOW>, /* DMA Tx IRQ */
			<GIC_SPI 105 IRQ_TYPE_LEVEL_LOW>; /* DMA Rx IRQ */
		clock-frequency = <26000000>;
		clock-div = <1>;
		clock-names = "uart0-main", "uart-apdma";
	};

	apuart1: apuart1@11003000 {
		cell-index = <1>;
		compatible = "mediatek,mtk-uart";
		reg = <0 0x11003000 0 0x1000>, /* UART base */
			<0 0x11000780 0 0x80>, /* DMA Tx base */
			<0 0x11000800 0 0x80>; /* DMA Rx base */
		interrupts = <GIC_SPI 92 IRQ_TYPE_LEVEL_LOW>, /* UART IRQ */
			<GIC_SPI 106 IRQ_TYPE_LEVEL_LOW>, /* DMA Tx IRQ */
			<GIC_SPI 107 IRQ_TYPE_LEVEL_LOW>; /* DMA Rx IRQ */
		clock-frequency = <26000000>;
		clock-div = <1>;
		/*clocks = <&pericfg CLK_PERICFG_RG_UART1>;*/
		clock-names = "uart1-main";
	};
	i2c_common: i2c_common {
		compatible = "mediatek,i2c_common";
		dma_support = /bits/ 8 <2>;
		idvfs = /bits/ 8 <1>;
		set_dt_div = /bits/ 8 <1>;
		check_max_freq = /bits/ 8 <1>;
		ver = /bits/ 8 <2>;
		set_ltiming = /bits/ 8 <1>;
	};
	i2c0: i2c0@11007000 {
		compatible = "mediatek,i2c";
		id = <0>;
		reg = <0 11007000 0 0x10000>,
			<0 0x11000080 0 0x80>;
		interrupts = <GIC_SPI 84 IRQ_TYPE_LEVEL_LOW>;
		/*
		 *clocks = <&pericfg CLK_PERICFG_RG_I2C0_BCLK>,
		 *	<&pericfg CLK_PERICFG_RG_AP_DM>;
		 */
		clock-names = "main", "dma";
		clock-div = <5>;
		aed = <0x1a>;
	};

	i2c1: i2c1@11090000 {
		compatible = "mediatek,i2c";
		id = <1>;
		reg = <0 0x11090000 0 0x10000>,
			<0 0x11000100 0 0x80>;
		interrupts = <GIC_SPI 85 IRQ_TYPE_LEVEL_LOW>;
		/*
		 *clocks = <&pericfg CLK_PERICFG_RG_I2C1_BCLK>,
		 *	<&pericfg CLK_PERICFG_RG_AP_DM>;
		 */
		clock-names = "main", "dma";
		clock-div = <5>;
		aed = <0x1a>;
	};

	i2c2: i2c2@11090000 {
		compatible = "mediatek,i2c";
		id = <1>;
		reg = <0 0x11090000 0 0x10000>,
			<0 0x11000100 0 0x80>;
		interrupts = <GIC_SPI 86 IRQ_TYPE_LEVEL_LOW>;
		/*
		 *clocks = <&pericfg CLK_PERICFG_RG_I2C2_BCLK>,
		 *	<&pericfg CLK_PERICFG_RG_AP_DM>;
		 */
		clock-names = "main", "dma";
		clock-div = <5>;
		aed = <0x1a>;
	};

	i2c3: i2c3@11090000 {
		compatible = "mediatek,i2c";
		id = <1>;
		reg = <0 0x11090000 0 0x10000>,
			<0 0x11000100 0 0x80>;
		interrupts = <GIC_SPI 87 IRQ_TYPE_LEVEL_LOW>;
		/*
		 *clocks = <&pericfg CLK_PERICFG_RG_I2C3_BCLK>,
		 *	<&pericfg CLK_PERICFG_RG_AP_DM>;
		 */
		clock-names = "main", "dma";
		clock-div = <5>;
		aed = <0x1a>;
	};

	i2c4: i2c4@11090000 {
		compatible = "mediatek,i2c";
		id = <1>;
		reg = <0 0x11090000 0 0x10000>,
			<0 0x11000100 0 0x80>;
		interrupts = <GIC_SPI 88 IRQ_TYPE_LEVEL_LOW>;
		/*
		 *clocks = <&pericfg CLK_PERICFG_RG_I2C4_BCLK>,
		 *	<&pericfg CLK_PERICFG_RG_AP_DM>;
		 */
		clock-names = "main", "dma";
		clock-div = <5>;
		aed = <0x1a>;
	};

	i2c5: i2c5@11090000 {
		compatible = "mediatek,i2c";
		id = <1>;
		reg = <0 0x11090000 0 0x10000>,
			<0 0x11000100 0 0x80>;
		interrupts = <GIC_SPI 130 IRQ_TYPE_LEVEL_LOW>;
		/*
		 *clocks = <&pericfg CLK_PERICFG_RG_I2C5_BCLK>,
		 *	<&pericfg CLK_PERICFG_RG_AP_DM>;
		 */
		clock-names = "main", "dma";
		clock-div = <5>;
		aed = <0x1a>;
	};

	i2c6: i2c6@11090000 {
		compatible = "mediatek,i2c";
		id = <1>;
		reg = <0 0x11090000 0 0x10000>,
			<0 0x11000100 0 0x80>;
		interrupts = <GIC_SPI 131 IRQ_TYPE_LEVEL_LOW>;
		/*
		 *clocks = <&pericfg CLK_PERICFG_RG_I2C6_BCLK>,
		 *	<&pericfg CLK_PERICFG_RG_AP_DM>;
		 */
		clock-names = "main", "dma";
		clock-div = <5>;
		aed = <0x1a>;
	};


	pwm@11006000 {
		compatible = "mediatek,pwm";
		reg = <0 0x11006000 0 0x0>;
		interrupts = <GIC_SPI 77 IRQ_TYPE_LEVEL_LOW>;
	};

	spi0: spi@1100a000 {
		compatible = "mediatek,mt6765-spi";
		mediatek,pad-select = <0>;
		reg = <0 0x1100a000 0 0x1000>;
		interrupts = <GIC_SPI 118 IRQ_TYPE_LEVEL_LOW>;
		/* clocks = <&topckgen CLK_TOP_SYSPLL3_D2>,
		 *		<&topckgen CLK_TOP_SPI_SEL>,
		 *		<&infracfg_ao CLK_INFRA_SPI0>;
		 */
		clock-names = "parent-clk", "sel-clk", "spi-clk";
	};


	therm_ctrl@1100b000 {
		compatible = "mediatek,therm_ctrl";
		reg = <0 0x1100b000 0 0x0>;
		interrupts = <GIC_SPI 78 IRQ_TYPE_LEVEL_LOW>;
	};

	btif@1100c000 {
		compatible = "mediatek,btif";
		reg = <0 0x1100c000 0 0x0>;
		interrupts = <GIC_SPI 112 IRQ_TYPE_LEVEL_LOW>;
	};


	disp_pwm@1100e000 {
		compatible = "mediatek,disp_pwm";
		reg = <0 0x1100e000 0 0x0>;
	};

	spi1: spi@11010000 {
		compatible = "mediatek,mt6765-spi";
		mediatek,pad-select = <0>;
		reg = <0 0x11010000 0 0x1000>;
		interrupts = <GIC_SPI 122 IRQ_TYPE_LEVEL_LOW>;
		/* clocks = <&topckgen CLK_TOP_SYSPLL3_D2>,
		 *		<&topckgen CLK_TOP_SPI_SEL>,
		 *		<&infracfg_ao CLK_INFRA_SPI1>;
		 */
		clock-names = "parent-clk", "sel-clk", "spi-clk";
	};

	spi2: spi@11012000 {
		compatible = "mediatek,mt6765-spi";
		mediatek,pad-select = <0>;
		reg = <0 0x11012000 0 0x1000>;
		interrupts = <GIC_SPI 128 IRQ_TYPE_LEVEL_LOW>;
		/* clocks = <&topckgen CLK_TOP_SYSPLL3_D2>,
		 *		<&topckgen CLK_TOP_SPI_SEL>,
		 *		<&infracfg_ao CLK_INFRA_SPI2>;
		 */
		clock-names = "parent-clk", "sel-clk", "spi-clk";
	};

	spi3: spi@11013000 {
		compatible = "mediatek,mt6765-spi";
		mediatek,pad-select = <0>;
		reg = <0 0x11013000 0 0x1000>;
		interrupts = <GIC_SPI 129 IRQ_TYPE_LEVEL_LOW>;
		/* clocks = <&topckgen CLK_TOP_SYSPLL3_D2>,
		 *		<&topckgen CLK_TOP_SPI_SEL>,
		 *		<&infracfg_ao CLK_INFRA_SPI3>;
		 */
		clock-names = "parent-clk", "sel-clk", "spi-clk";
	};

	spi4: spi@11014000 {
		compatible = "mediatek,mt6765-spi";
		mediatek,pad-select = <0>;
		reg = <0 0x11014000 0 0x1000>;
		interrupts = <GIC_SPI 134 IRQ_TYPE_LEVEL_LOW>;
		/* clocks = <&topckgen CLK_TOP_SYSPLL3_D2>,
		 *		<&topckgen CLK_TOP_SPI_SEL>,
		 *		<&infracfg_ao CLK_INFRA_SPI4>;
		 */
		clock-names = "parent-clk", "sel-clk", "spi-clk";
	};

	spi5: spi@11015000 {
		compatible = "mediatek,mt6765-spi";
		mediatek,pad-select = <0>;
		reg = <0 0x11015000 0 0x1000>;
		interrupts = <GIC_SPI 135 IRQ_TYPE_LEVEL_LOW>;
		/* clocks = <&topckgen CLK_TOP_SYSPLL3_D2>,
		 *		<&topckgen CLK_TOP_SPI_SEL>,
		 *		<&infracfg_ao CLK_INFRA_SPI5>;
		 */
		clock-names = "parent-clk", "sel-clk", "spi-clk";
	};

	imp_iic@11017000 {
		compatible = "mediatek,imp_iic";
		reg = <0 0x11017000 0 0x0>;
	};

	nfi@11018000 {
		compatible = "mediatek,nfi";
		reg = <0 0x11018000 0 0x0>;
	};

	nfiecc@11019000 {
		compatible = "mediatek,nfiecc";
		reg = <0 0x11019000 0 0x0>;
	};

	usb1p@11200000 {
		compatible = "mediatek,usb1p";
		reg = <0 0x11200000 0 0x0>;
	};

	usb1p_sub@11200de0 {
		compatible = "mediatek,usb1p_sub";
		reg = <0 0x11200de0 0 0x0>;
	};

	msdc0:msdc@11230000 {
		compatible = "mediatek,msdc";
		reg = <0 0x11230000 0 0x10000>;
		interrupts = <GIC_SPI 79 IRQ_TYPE_LEVEL_LOW>;
	};

	msdc1:msdc@11240000 {
		compatible = "mediatek,msdc";
		reg = <0 0x11240000 0 0x10000>;
		interrupts = <GIC_SPI 80 IRQ_TYPE_LEVEL_LOW>;
	};

	msdc2:msdc@11250000 {
		compatible = "mediatek,msdc2";
		reg = <0 0x11250000 0 0x0>;
	};

	msdc3:msdc@11260000 {
		compatible = "mediatek,msdc3";
		reg = <0 0x11250000 0 0x0>;
	};

	msdc1_ins:msdc1_ins@0 {
		compatible = "mediatek,mt3887-sdcard-ins";
	};

	msdc0_top@11f50000 {
		compatible = "mediatek,msdc0_top";
		reg = <0 0x11f50000 0 0x1000>;
	};

	msdc1_top@11e10000 {
		compatible = "mediatek,msdc1_top";
		reg = <0 0x11e10000 0 0x1000>;
	};
	usb1p_sif@11210000 {
		compatible = "mediatek,usb1p_sif";
		reg = <0 0x11210000 0 0x0>;
	};

	audio@11220000 {
		compatible = "mediatek,audio";
		reg = <0 0x11220000 0 0x0>;
		interrupts = <GIC_SPI 153 IRQ_TYPE_LEVEL_LOW>;
	};

	audio_sram@11221000 {
		compatible = "mediatek,audio_sram";
		reg = <0 0x11221000 0 0x0>;
	};

	mipi_rx_ana_csi0@11c10000 {
		compatible = "mediatek,mipi_rx_ana_csi0";
		reg = <0 0x11c10000 0 0x0>;
	};

	mipi_rx_ana_csi1@11c20000 {
		compatible = "mediatek,mipi_rx_ana_csi1";
		reg = <0 0x11c20000 0 0x0>;
	};

	mipi_rx_ana_csi2@11c30000 {
		compatible = "mediatek,mipi_rx_ana_csi2";
		reg = <0 0x11c30000 0 0x0>;
	};

	efusec@11c50000 {
		compatible = "mediatek,efusec";
		reg = <0 0x11c50000 0 0x0>;
	};

	mipi_tx0@11c80000 {
		compatible = "mediatek,mipi_tx0";
		reg = <0 0x11c80000 0 0x0>;
	};

	msdc1_pad_macro@11c90000 {
		compatible = "mediatek,msdc1_pad_macro";
		reg = <0 0x11c90000 0 0x0>;
	};

	usb_phy@11cc0000 {
		compatible = "mediatek,usb_phy";
		reg = <0 0x11cc0000 0 0x0>;
	};

	msdc0_pad_macro@11cd0000 {
		compatible = "mediatek,msdc0_pad_macro";
		reg = <0 0x11cd0000 0 0x0>;
	};

	gpu@13000000 {
		compatible = "mediatek,gpu";
		reg = <0 0x13000000 0 0x0>;
	};

	gpu_config@13ffe000 {
		compatible = "mediatek,gpu_config";
		reg = <0 0x13ffe000 0 0x0>;
	};

	mmsys_config: mmsys_config@14000000 {
		compatible = "mediatek,mmsys_config";
		reg = <0 0x14000000 0 0x1000>;
		interrupts = <GIC_SPI 227 IRQ_TYPE_LEVEL_LOW>;
	};

	disp_mutex0: disp_mutex0@14001000 {
		compatible = "mediatek,disp_mutex0";
		reg = <0 0x14001000 0 0x0>;
	};

	smi_common@14002000 {
		compatible = "mediatek,smi_common";
		reg = <0 0x14002000 0 0x0>;
	};

	smi_larb0@14003000 {
		compatible = "mediatek,smi_larb0";
		reg = <0 0x14003000 0 0x1000>;
	};

	mdp_rdma0: mdp_rdma0@14004000 {
		compatible = "mediatek,mdp_rdma0";
		reg = <0 0x14004000 0 0x0>;
		interrupts = <GIC_SPI 211 IRQ_TYPE_LEVEL_LOW>;
	};

	mdp_ccorr0@14005000 {
		compatible = "mediatek,mdp_ccorr0";
		reg = <0 0x14005000 0 0x0>;
		interrupts = <GIC_SPI 226 IRQ_TYPE_LEVEL_LOW>;
	};

	mdp_rsz0: mdp_rsz0@14006000 {
		compatible = "mediatek,mdp_rsz0";
		reg = <0 0x14006000 0 0x0>;
		interrupts = <GIC_SPI 212 IRQ_TYPE_LEVEL_LOW>;
	};

	mdp_rsz1: mdp_rsz1@14007000 {
		compatible = "mediatek,mdp_rsz1";
		reg = <0 0x14007000 0 0x0>;
		interrupts = <GIC_SPI 213 IRQ_TYPE_LEVEL_LOW>;
	};

	mdp_wdma0: mdp_wdma0@14008000 {
		compatible = "mediatek,mdp_wdma0";
		reg = <0 0x14008000 0 0x0>;
		interrupts = <GIC_SPI 216 IRQ_TYPE_LEVEL_LOW>;
	};

	mdp_wrot0: mdp_wrot0@14009000 {
		compatible = "mediatek,mdp_wrot0";
		reg = <0 0x14009000 0 0x0>;
		interrupts = <GIC_SPI 215 IRQ_TYPE_LEVEL_LOW>;
	};

	mdp_tdshp0: mdp_tdshp0@1400a000 {
		compatible = "mediatek,mdp_tdshp0";
		reg = <0 0x1400a000 0 0x0>;
	};

	disp_ovl0@1400b000 {
		compatible = "mediatek,disp_ovl0";
		reg = <0 0x1400b000 0 0x0>;
		interrupts = <GIC_SPI 217 IRQ_TYPE_LEVEL_LOW>;
	};

	disp_ovl0_2l@1400c000 {
		compatible = "mediatek,disp_ovl0_2l";
		reg = <0 0x1400c000 0 0x0>;
		interrupts = <GIC_SPI 229 IRQ_TYPE_LEVEL_LOW>;
	};

	disp_rdma0@1400d000 {
		compatible = "mediatek,disp_rdma0";
		reg = <0 0x1400d000 0 0x0>;
		interrupts = <GIC_SPI 218 IRQ_TYPE_LEVEL_LOW>;
	};

	disp_wdma0@1400e000 {
		compatible = "mediatek,disp_wdma0";
		reg = <0 0x1400e000 0 0x0>;
		interrupts = <GIC_SPI 219 IRQ_TYPE_LEVEL_LOW>;
	};

	disp_color0@1400f000 {
		compatible = "mediatek,disp_color0";
		reg = <0 0x1400f000 0 0x0>;
		interrupts = <GIC_SPI 220 IRQ_TYPE_LEVEL_LOW>;
	};

	disp_ccorr0@14010000 {
		compatible = "mediatek,disp_ccorr0";
		reg = <0 0x14010000 0 0x0>;
		interrupts = <GIC_SPI 221 IRQ_TYPE_LEVEL_LOW>;
	};

	disp_aal0@14011000 {
		compatible = "mediatek,disp_aal0";
		reg = <0 0x14011000 0 0x0>;
		interrupts = <GIC_SPI 222 IRQ_TYPE_LEVEL_LOW>;
	};

	disp_gamma0@14012000 {
		compatible = "mediatek,disp_gamma0";
		reg = <0 0x14012000 0 0x0>;
		interrupts = <GIC_SPI 223 IRQ_TYPE_LEVEL_LOW>;
	};

	disp_dither0@14013000 {
		compatible = "mediatek,disp_dither0";
		reg = <0 0x14013000 0 0x0>;
		interrupts = <GIC_SPI 224 IRQ_TYPE_LEVEL_LOW>;
	};

	dsi0@14014000 {
		compatible = "mediatek,dsi0";
		reg = <0 0x14014000 0 0x0>;
		interrupts = <GIC_SPI 225 IRQ_TYPE_LEVEL_LOW>;
	};

	dsi1@14015000 {
		compatible = "mediatek,dsi1";
		reg = <0 0x14015000 0 0x0>;
	};

	mm_mutex@14016000 {
		compatible = "mediatek,mm_mutex";
		reg = <0 0x14016000 0 0x0>;
	};

	smi_common@14019000 {
		compatible = "mediatek,smi_common";
		reg = <0 0x14019000 0 0x0>;
	};

	smi_larb2@15021000 {
		compatible = "mediatek,smi_larb2";
		reg = <0 0x15021000 0 0x1000>;
	};

	venc_gcon@17000000 {
		compatible = "mediatek,venc_gcon";
		reg = <0 0x17000000 0 0x1000>;
	};

	smi_larb1@17010000 {
		compatible = "mediatek,smi_larb1";
		reg = <0 0x17010000 0 0x1000>;
	};

	venc@17020000 {
		compatible = "mediatek,venc";
		reg = <0 0x17020000 0 0x1000>;
		interrupts = <GIC_SPI 230 IRQ_TYPE_LEVEL_LOW>;
	};

	jpgenc@17030000 {
		compatible = "mediatek,jpgenc";
		reg = <0 0x17030000 0 0x1000>;
		interrupts = <GIC_SPI 232 IRQ_TYPE_LEVEL_LOW>;
	};

	vdec@17040000 {
		compatible = "mediatek,vdec";
		reg = <0 0x17040000 0 0x4000>;
		interrupts = <GIC_SPI 233 IRQ_TYPE_LEVEL_LOW>;
	};

	mbist@17050000 {
		compatible = "mediatek,mbist";
		reg = <0 0x17050000 0 0x400>;
	};

	camsys_config@1a000000  {
		compatible = "mediatek,camsys_config";
		reg = <0 0x1a000000  0 0x0>;
	};

	smi_larb3@1a002000 {
		compatible = "mediatek,smi_larb3";
		reg = <0 0x1a002000 0 0x1000>;
	};

	cam@1a003000 {
		compatible = "mediatek,cam";
		reg = <0 0x1a003000 0 0x0>;
	};

	cama@1a004000  {
		compatible = "mediatek,cama";
		reg = <0 0x1a004000  0 0x0>;
	};

	camb@1a005000 {
		compatible = "mediatek,camb";
		reg = <0 0x1a005000 0 0x0>;
	};

	cam_set@1a00b000 {
		compatible = "mediatek,cam_set";
		reg = <0 0x1a00b000 0 0x0>;
	};

	cama_set@1a00c000 {
		compatible = "mediatek,cama_set";
		reg = <0 0x1a00c000 0 0x0>;
	};

	camb_set@1a00d000 {
		compatible = "mediatek,camb_set";
		reg = <0 0x1a00d000 0 0x0>;
	};

	cam_inner@1a013000 {
		compatible = "mediatek,cam_inner";
		reg = <0 0x1a013000 0 0x0>;
	};

	cama_inner@1a014000 {
		compatible = "mediatek,cama_inner";
		reg = <0 0x1a014000 0 0x0>;
	};

	camb_inner@1a015000 {
		compatible = "mediatek,camb_inner";
		reg = <0 0x1a015000 0 0x0>;
	};

	cam_clear@1a01b000 {
		compatible = "mediatek,cam_clear";
		reg = <0 0x1a01b000 0 0x0>;
	};

	cama_clear@1a01c000 {
		compatible = "mediatek,cama_clear";
		reg = <0 0x1a01c000 0 0x0>;
	};

	camb_clear@1a01d000 {
		compatible = "mediatek,camb_clear";
		reg = <0 0x1a01d000 0 0x0>;
	};

	cama_ext@1a024000 {
		compatible = "mediatek,cama_ext";
		reg = <0 0x1a024000 0 0x0>;
	};

	camb_ext@1a025000 {
		compatible = "mediatek,camb_ext";
		reg = <0 0x1a025000 0 0x0>;
	};

	seiinfa@1a040000 {
		compatible = "mediatek,seiinfa";
		reg = <0 0x1a040000 0 0x0>;
	};

	seiinfa@1a041000 {
		compatible = "mediatek,seiinfa";
		reg = <0 0x1a041000 0 0x0>;
	};

	seiinfa@1a042000 {
		compatible = "mediatek,seiinfa";
		reg = <0 0x1a042000 0 0x0>;
	};

	seiinfa@1a043000 {
		compatible = "mediatek,seiinfa";
		reg = <0 0x1a043000 0 0x0>;
	};

	seiinfa@1a044000 {
		compatible = "mediatek,seiinfa";
		reg = <0 0x1a044000 0 0x0>;
	};

	seiinfa@1a045000 {
		compatible = "mediatek,seiinfa";
		reg = <0 0x1a045000 0 0x0>;
	};

	seiinfa@1a046000 {
		compatible = "mediatek,seiinfa";
		reg = <0 0x1a046000 0 0x0>;
	};

	seiinfa@1a047000 {
		compatible = "mediatek,seiinfa";
		reg = <0 0x1a047000 0 0x0>;
	};

	camsva@1a050000 {
		compatible = "mediatek,camsva";
		reg = <0 0x1a050000 0 0x0>;
	};

	camsvb@1a051000 {
		compatible = "mediatek,camsvb";
		reg = <0 0x1a051000 0 0x0>;
	};

	camsvc@1a052000 {
		compatible = "mediatek,camsvc";
		reg = <0 0x1a052000 0 0x0>;
	};

	camsvd@1a053000 {
		compatible = "mediatek,camsvd";
		reg = <0 0x1a053000 0 0x0>;
	};

	ccu@1a080000 {
		compatible = "mediatek,ccu";
		reg = <0 0x1a080000 0 0x0>;
		interrupts = <GIC_SPI 246 IRQ_TYPE_LEVEL_LOW>;
	};

	ccu@1a090000 {
		compatible = "mediatek,ccu";
		reg = <0 0x1a090000 0 0x0>;
	};

	ccu@1a0a0000 {
		compatible = "mediatek,ccu";
		reg = <0 0x1a0a0000 0 0x0>;
	};

	ccu@1a0b0000 {
		compatible = "mediatek,ccu";
		reg = <0 0x1a0b0000 0 0x0>;
	};

	ccu@1a0b1000 {
		compatible = "mediatek,ccu";
		reg = <0 0x1a0b1000 0 0x0>;
	};

};
#include "cust_mt3887_msdc.dtsi"
