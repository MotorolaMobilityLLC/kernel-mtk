/* Copyright (c) 2019, Motorola Mobility Inc. All rights reserved.
 *
 * This program is free software; you can redistribute it and/or modify
 * it under the terms of the GNU General Public License version 2 and
 * only version 2 as published by the Free Software Foundation.
 *
 * This program is distributed in the hope that it will be useful,
 * but WITHOUT ANY WARRANTY; without even the implied warranty of
 * MERCHANTABILITY or FITNESS FOR A PARTICULAR PURPOSE.  See the
 * GNU General Public License for more details.
 */

/dts-v1/;
/plugin/;

#include "mediatek/mt6879-manaus-row-common-overlay.dtsi"

/* Board match root node */
/ {
	fragment@model {
		target-path = "/";
		__overlay__ {
			mot,model = "manaus";
			mot,board-id = <0x47 0xA100>;
		};
	};
};

&awinic_sar {
	channel_use_flag = <0x1f>;
	platform_state = "evt";
};

&sx937x {
	Semtech,button-flag = <0x1f>;
	Semtech,reg-num = <52>;
	Semtech,reg-init = <
		0x8024  0x7F00
		0x4004  0x70
		0x4008  0x8
		0x8020  0x32
		0x8028  0x85E
		0x8034  0x85E
		0x8040  0x85E
		0x804C  0x85E
		0x8058  0x85E
		0x8064  0x85E
		0x8070  0x85E
		0x807C  0x85E
		0x8030  0xFFF9FD
		0x803C  0xFFD9FF
		0x8048  0xFEF9FF
		0x8054  0xF7F9FF
		0x8060  0xBFF9FF
		0x806C  0xFFF9EF
		0x8078  0xFFF97F
		0x8084  0xFFF9FF
		0x8098  0x5A40
		0x80B8  0x5A40
		0x80D8  0x5A5A
		0x80F8  0x5A5A
		0x8118  0x5A5A
		0x8138  0x5A40
		0x8158  0x5A40
		0x8178  0x5A40
		0x8090  0x54AC5000
		0x80B0  0x54AC5000
		0x80D0  0x54AC5000
		0x80F0  0x54AC5000
		0x8110  0x54AC5000
		0x8130  0x54AC5000
		0x8150  0x54AC5000
		0x8170  0x54AC5000
		0x8088  0x300000
		0x80A8  0x300000
		0x80C8  0x300000
		0x80E8  0x300000
		0x8108  0x300000
		0x8128  0x300000
		0x8148  0x300000
		0x8168  0x300000
		0x808C  0x60200030
		0x80AC  0x60200030
		0x80CC  0x60200030
		0x80EC  0x60200030
		0x810C  0x60200030
		0x812C  0x60200030
		0x814C  0x60200030
		0x816C  0x60200030
	>;
};

#include <manaus_evb/cust.dtsi>
#include "mediatek/cust_mt6879_camera_v4l2_manaus.dtsi"
/*End of this file, DO NOT ADD ANYTHING HERE*/
