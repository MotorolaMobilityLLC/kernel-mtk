/* Please set primary/secondary charger to corresponding I2C bus */
&i2c1 {
	bq24157@6a {
		status = "okay";
		compatible = "mediatek,bq24157";
		reg = <0x6a>;
		/*rt,cd_gpio = <&gpio 25 0x0>;*/

		/*
		 * Charger name
		 * Main charger: primary_chg
		 * Slave charger: secondary_chg
		 */
		charger_name = "primary_chg";
		ichg = <1550000>; /* uA */
		aicr = <500000>;  /* uA */
		mivr = <4500000>; /* uV */
		ieoc = <200000>;  /* uA */
		cv = <4350000>; /* uV */
		vmreg = <4350000>; /* uV */
		enable_eoc_shdn;
	};
};
