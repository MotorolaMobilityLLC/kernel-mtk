/* Copyright (c) 2019, Motorola Mobility Inc. All rights reserved.
 *
 * This program is free software; you can redistribute it and/or modify
 * it under the terms of the GNU General Public License version 2 and
 * only version 2 as published by the Free Software Foundation.
 *
 * This program is distributed in the hope that it will be useful,
 * but WITHOUT ANY WARRANTY; without even the implied warranty of
 * MERCHANTABILITY or FITNESS FOR A PARTICULAR PURPOSE.  See the
 * GNU General Public License for more details.
 */

/dts-v1/;
/plugin/;

#include "mediatek/mt6891-lyriq-common-overlay.dtsi"

/* Board match root node */
/ {
	fragment@model {
		target-path = "/";
		__overlay__ {
			mot,model = "lyriq";
			mot,board-id = <0x43 0xA200>;
		};
	};
};

&odm {
	BATTERY_TMP_TO_ENABLE_EXTFG = <1>;
};

#include <lyriq_evb/cust.dtsi>


/* #include "mediatek/lyriq-touchscreen.dtsi" */
/*End of this file, DO NOT ADD ANYTHING HERE*/
