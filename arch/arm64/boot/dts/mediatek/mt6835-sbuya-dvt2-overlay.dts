/* Copyright (c) 2023, Motorola Mobility Inc. All rights reserved.
 *
 * This program is free software; you can redistribute it and/or modify
 * it under the terms of the GNU General Public License version 2 and
 * only version 2 as published by the Free Software Foundation.
 *
 * This program is distributed in the hope that it will be useful,
 * but WITHOUT ANY WARRANTY; without even the implied warranty of
 * MERCHANTABILITY or FITNESS FOR A PARTICULAR PURPOSE.  See the
 * GNU General Public License for more details.
 */

/dts-v1/;
/plugin/;

/* NOTE: copied from mt6835-kansas-dvt-overlay.dts for reusing Kansas DVT or later HW */

#include "mediatek/mt6835-sbuya-common-overlay.dtsi"
#include "mediatek/mt6835_sbuya_camera_overlay_evb.dtsi"
/* Board match root node */
/ {
	fragment@model {
		target-path = "/";
		__overlay__ {
			mot,model = "sbuya";
			mot,board-id = <0x47 0xB200>;
		};
	};
};

#include <sbuya_dvt2/cust.dtsi>
#include "mediatek/sbuya-charger.dtsi"
/*End of this file, DO NOT ADD ANYTHING HERE*/
