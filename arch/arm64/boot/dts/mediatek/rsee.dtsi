/ {
	rsee {
		compatible = "rongcard,rsee-tz";
		method = "smc";
	};
	spi0-clk {
		compatible = "rsee,peri-clk";
		clkname = "main";
		clocks = <&topckgen CLK_TOP_SYSPLL3_D2>,
				<&topckgen CLK_TOP_SPI_SEL>,
				<&infracfg_ao CLK_INFRA_SPI0>;
		clock-names = "parent-clk", "sel-clk", "spi-clk";
		clock-frequency = <109000000>;
	};
};

