/* Copyright (c) 2019, Motorola Mobility Inc. All rights reserved.
 *
 * This program is free software; you can redistribute it and/or modify
 * it under the terms of the GNU General Public License version 2 and
 * only version 2 as published by the Free Software Foundation.
 *
 * This program is distributed in the hope that it will be useful,
 * but WITHOUT ANY WARRANTY; without even the implied warranty of
 * MERCHANTABILITY or FITNESS FOR A PARTICULAR PURPOSE.  See the
 * GNU General Public License for more details.
 */

/dts-v1/;
/plugin/;

#include "mediatek/mt6879-tesla-common-overlay.dtsi"
#include "mediatek/tesla-connsys-vzw.dtsi"

#define TESLA_RADIO_VZW 2

/* Board match root node */
/ {
	fragment@model {
		target-path = "/";
		__overlay__ {
			mot,model = "tesla";
			mot,board-id = <(TESLA_RADIO_VZW << 8 | 0x41) 0xA200>;
		};
	};
};

&sx937x {
	Semtech,button-flag = <0x1b>;
};

#include <tesla_evt1/cust.dtsi>
#include "mediatek/cust_mt6879_camera_v4l2_tesla_evt.dtsi"
/*End of this file, DO NOT ADD ANYTHING HERE*/
