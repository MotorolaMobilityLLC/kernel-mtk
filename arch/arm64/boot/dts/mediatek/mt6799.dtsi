/*
 * Mediatek's mt6799 SoC device tree source
 *
 * Copyright (c) 2013 MediaTek Co., Ltd.
 *              http://www.mediatek.com
 *
 */

#include <dt-bindings/clock/mt6799-clk.h>
#include <dt-bindings/interrupt-controller/arm-gic.h>
#include <dt-bindings/interrupt-controller/irq.h>
#include <dt-bindings/mmc/mt6799-msdc.h>
#include <dt-bindings/pinctrl/mt6799-pinfunc.h>
#include <generated/autoconf.h>

/ {
	model = "mt6799";
	compatible = "mediatek,mt6799";
	interrupt-parent = <&gic>;
	#address-cells = <2>;
	#size-cells = <2>;

	/* chosen */
	chosen {
		bootargs = "console=tty0 console=ttyMT0,921600n1 root=/dev/ram";
	};

	msdc0:msdc@11240000 {
		compatible = "mediatek,msdc";
		reg = <0x0 0x11240000 0x0 0x10000
		       0x0 0x10000e84 0x0 0x2>;    /* FPGA PWR_GPIO, PWR_GPIO_EO */
		interrupts = <GIC_SPI 79 IRQ_TYPE_LEVEL_LOW>;
	};

	msdc1:msdc@11250000 {
		compatible = "mediatek,msdc";
		reg = <0x0 0x11250000 0x0 0x10000>;
		interrupts = <GIC_SPI 80 IRQ_TYPE_LEVEL_LOW>;
	};

	msdc3:msdc@11270000 {
		compatible = "mediatek,msdc";
		reg = <0x0 0x11270000 0x0 0x10000>;
		interrupts = <GIC_SPI 82 IRQ_TYPE_LEVEL_LOW>;
	};

	msdc1_ins: msdc1_ins@0 {
		compatible = "mediatek,mt6799-sdcard-ins";
	};

	ufshci0:ufshci@11290000 {
		compatible = "mediatek,ufshci";
		reg = <0x0 0x11290000 0x0 0x10000>;
		interrupts = <GIC_SPI 109 IRQ_TYPE_LEVEL_LOW>;
		clocks = <&pericfg CLK_PERICFG_RG_UFSCARD>,
			<&pericfg CLK_PERICFG_RG_UFSCARD_MP_SAP_CFG>;
		clock-names = "ufs0-clock", "ufs0-mp-clk";
		freq-table-hz = <0 0>, <0 0>;

		/* vccq is not used and mt_pmic_vufs18_ldo_reg is not for vccq */
		/* put here to avoid kernel NULL pointer access in ufshcd_config_vreg_hpm() */
		vcc-supply = <&mt_pmic_vemc_ldo_reg>;
		vcc-fixed-regulator;
		vccq-supply = <&mt_pmic_vufs18_ldo_reg>;
		vccq-fixed-regulator;
		vccq2-supply = <&mt_pmic_vufs18_ldo_reg>;
		vccq2-fixed-regulator;

		/* Auto-Hibern8 Timer. Unit: ms	(0 means disabled) */
		auto-hibern8-timer = <0>;

		/* System Suspend Level */
		spm-level = <3>;

		/* Runtime Suspend Configuration */
		/* 1. Runtime PM on/off (on: 1, off: 0) */
		rpm-enable = <0>;

		/* 2. Auto Suspend Delay. Unit: ms */
		rpm-autosuspend-delay = <2000>;

		/* 3. Runtime Suspend Level */
		rpm-level = <3>;
	};

	mobicore {
		compatible = "trustonic,mobicore";
		interrupts = <GIC_SPI 292 IRQ_TYPE_EDGE_RISING>;
	};

	psci {
		compatible = "arm,psci-0.2";
		method = "smc";
		cpu_suspend = <0x84000001>;
		cpu_off = <0x84000002>;
		cpu_on = <0x84000003>;
		affinity_info = <0x84000004>;
	};

	/* ATF logger SW IRQ number 346 = 32 + 314 */
	atf_logger {
		compatible = "mediatek,atf_logger";
		interrupts = <GIC_SPI 314 IRQ_TYPE_EDGE_RISING>;
	};

	/* Microtrust SW IRQ number 337(369) ~ 341(373) */
	utos {
		compatible = "microtrust,utos";
		interrupts = <GIC_SPI 337 IRQ_TYPE_EDGE_RISING>,
			<GIC_SPI 338 IRQ_TYPE_EDGE_RISING>;
	};

	cpus {
		#address-cells = <1>;
		#size-cells = <0>;

		cpu0: cpu@0 {
			device_type = "cpu";
			compatible = "arm,cortex-a35";
			reg = <0x000>;
			enable-method = "psci";
			cpu-idle-states = <&LEGACY_MCDI &LEGACY_SODI &LEGACY_SODI3 &LEGACY_DPIDLE>,
					  <&LEGACY_SUSPEND &MCDI &SODI &SODI3 &DPIDLE &SUSPEND>;
			cpu-release-addr = <0x0 0x40000200>;
			clock-frequency = <1248000000>;
		};

		cpu1: cpu@001 {
			device_type = "cpu";
			compatible = "arm,cortex-a35";
			reg = <0x001>;
			enable-method = "psci";
			cpu-idle-states = <&LEGACY_MCDI &LEGACY_SODI &LEGACY_SODI3 &LEGACY_DPIDLE>,
					  <&LEGACY_SUSPEND &MCDI &SODI &SODI3 &DPIDLE &SUSPEND>;
			cpu-release-addr = <0x0 0x40000200>;
			clock-frequency = <1248000000>;
		};

		cpu2: cpu@002 {
			device_type = "cpu";
			compatible = "arm,cortex-a35";
			reg = <0x002>;
			enable-method = "psci";
			cpu-idle-states = <&LEGACY_MCDI &LEGACY_SODI &LEGACY_SODI3 &LEGACY_DPIDLE>,
					  <&LEGACY_SUSPEND &MCDI &SODI &SODI3 &DPIDLE &SUSPEND>;
			cpu-release-addr = <0x0 0x40000200>;
			clock-frequency = <1248000000>;
		};

		cpu3: cpu@003 {
			device_type = "cpu";
			compatible = "arm,cortex-a35";
			reg = <0x003>;
			enable-method = "psci";
			cpu-idle-states = <&LEGACY_MCDI &LEGACY_SODI &LEGACY_SODI3 &LEGACY_DPIDLE>,
					  <&LEGACY_SUSPEND &MCDI &SODI &SODI3 &DPIDLE &SUSPEND>;
			cpu-release-addr = <0x0 0x40000200>;
			clock-frequency = <1248000000>;
		};

		cpu4: cpu@100 {
			device_type = "cpu";
			compatible = "arm,cortex-a53";
			reg = <0x100>;
			enable-method = "psci";
			cpu-idle-states = <&LEGACY_MCDI &LEGACY_SODI &LEGACY_SODI3 &LEGACY_DPIDLE>,
					  <&LEGACY_SUSPEND &MCDI &SODI &SODI3 &DPIDLE &SUSPEND>;
			cpu-release-addr = <0x0 0x40000200>;
			clock-frequency = <1378000000>;
		};

		cpu5: cpu@101 {
			device_type = "cpu";
			compatible = "arm,cortex-a53";
			reg = <0x101>;
			enable-method = "psci";
			cpu-idle-states = <&LEGACY_MCDI &LEGACY_SODI &LEGACY_SODI3 &LEGACY_DPIDLE>,
					  <&LEGACY_SUSPEND &MCDI &SODI &SODI3 &DPIDLE &SUSPEND>;
			cpu-release-addr = <0x0 0x40000200>;
			clock-frequency = <1378000000>;
		};

		cpu6: cpu@102 {
			device_type = "cpu";
			compatible = "arm,cortex-a53";
			reg = <0x102>;
			enable-method = "psci";
			cpu-idle-states = <&LEGACY_MCDI &LEGACY_SODI &LEGACY_SODI3 &LEGACY_DPIDLE>,
					  <&LEGACY_SUSPEND &MCDI &SODI &SODI3 &DPIDLE &SUSPEND>;
			cpu-release-addr = <0x0 0x40000200>;
			clock-frequency = <1378000000>;
		};

		cpu7: cpu@103 {
			device_type = "cpu";
			compatible = "arm,cortex-a53";
			reg = <0x103>;
			enable-method = "psci";
			cpu-idle-states = <&LEGACY_MCDI &LEGACY_SODI &LEGACY_SODI3 &LEGACY_DPIDLE>,
					  <&LEGACY_SUSPEND &MCDI &SODI &SODI3 &DPIDLE &SUSPEND>;
			cpu-release-addr = <0x0 0x40000200>;
			clock-frequency = <1378000000>;
		};

		cpu8: cpu@200 {
			device_type = "cpu";
			compatible = "arm,cortex-a73";
			reg = <0x200>;
			enable-method = "psci";
			cpu-idle-states = <&LEGACY_MCDI &LEGACY_SODI &LEGACY_SODI3 &LEGACY_DPIDLE>,
					  <&LEGACY_SUSPEND &MCDI &SODI &SODI3 &DPIDLE &SUSPEND>;
			cpu-release-addr = <0x0 0x40000200>;
			clock-frequency = <1638000000>;
		};

		cpu9: cpu@201 {
			device_type = "cpu";
			compatible = "arm,cortex-a73";
			reg = <0x201>;
			enable-method = "psci";
			cpu-idle-states = <&LEGACY_MCDI &LEGACY_SODI &LEGACY_SODI3 &LEGACY_DPIDLE>,
					  <&LEGACY_SUSPEND &MCDI &SODI &SODI3 &DPIDLE &SUSPEND>;
			cpu-release-addr = <0x0 0x40000200>;
			clock-frequency = <1638000000>;
		};

		cpu-map {
			cluster0 {
				core0 {
					cpu = <&cpu0>;
				};


				core1 {
					cpu = <&cpu1>;
				};

				core2 {
					cpu = <&cpu2>;
				};

				core3 {
					cpu = <&cpu3>;
				};

			};

			cluster1 {
				core0 {
					cpu = <&cpu4>;
				};

				core1 {
					cpu = <&cpu5>;
				};

				core2 {
					cpu = <&cpu6>;
				};

				core3 {
					cpu = <&cpu7>;
				};

			};

			cluster2 {
				core0 {
					cpu = <&cpu8>;
				};

				core1 {
					cpu = <&cpu9>;
				};

			};
		};

		idle-states {
			entry-method = "arm,psci";

			LEGACY_MCDI: legacy-mcdi {
				compatible = "arm,idle-state";
				arm,psci-suspend-param = <0x0000001>;
				entry-latency-us = <600>;
				exit-latency-us = <600>;
				min-residency-us = <1200>;
			};

			LEGACY_SODI: legacy-sodi {
				compatible = "arm,idle-state";
				arm,psci-suspend-param = <0x0000002>;
				entry-latency-us = <600>;
				exit-latency-us = <600>;
				min-residency-us = <1200>;
			};

			LEGACY_SODI3: legacy-sodi3 {
				compatible = "arm,idle-state";
				arm,psci-suspend-param = <0x0000003>;
				entry-latency-us = <600>;
				exit-latency-us = <600>;
				min-residency-us = <1200>;
			};

			LEGACY_DPIDLE: legacy-dpidle {
				compatible = "arm,idle-state";
				arm,psci-suspend-param = <0x0000004>;
				entry-latency-us = <600>;
				exit-latency-us = <600>;
				min-residency-us = <1200>;
			};

			LEGACY_SUSPEND: legacy-suspend {
				compatible = "arm,idle-state";
				arm,psci-suspend-param = <0x0000005>;
				entry-latency-us = <600>;
				exit-latency-us = <600>;
				min-residency-us = <1200>;
			};

			MCDI: mcdi {
				compatible = "arm,idle-state";
				arm,psci-suspend-param = <0x0010001>;
				entry-latency-us = <600>;
				exit-latency-us = <600>;
				min-residency-us = <1200>;
			};

			SODI: sodi {
				compatible = "arm,idle-state";
				arm,psci-suspend-param = <0x1010002>;
				entry-latency-us = <800>;
				exit-latency-us = <1000>;
				min-residency-us = <2000>;
			};

			SODI3: sodi3 {
				compatible = "arm,idle-state";
				arm,psci-suspend-param = <0x1010003>;
				entry-latency-us = <800>;
				exit-latency-us = <1000>;
				min-residency-us = <2000>;
			};

			DPIDLE: dpidle {
				compatible = "arm,idle-state";
				arm,psci-suspend-param = <0x1010004>;
				entry-latency-us = <800>;
				exit-latency-us = <1000>;
				min-residency-us = <2000>;
			};

			SUSPEND: suspend {
				compatible = "arm,idle-state";
				arm,psci-suspend-param = <0x1010005>;
				entry-latency-us = <800>;
				exit-latency-us = <1000>;
				min-residency-us = <2000>;
			};

		};
	};

	memory@00000000 {
		device_type = "memory";
		reg = <0 0x40000000 0 0x40000000>;
	};

	reserved-memory {
		#address-cells = <2>;
		#size-cells = <2>;
		ranges;

		pstore-reserved-memory@44410000 {
			compatible = "mediatek,pstore";
			reg = <0 0x44410000 0 0xe0000>;
		};
		ram_console-reserved-memory@44400000 {
			compatible = "ram_console-reserve-memory";
			reg = <0 0x44400000 0 0x10000>;
		};

		minirdump-reserved-memory@444f0000{
			compatible = "mediatek,minirdump";
			reg = <0 0x444f0000 0 0x10000>;
		};

		spm-reserve-memory@44600000 {
			compatible = "mediatek,spm-reserve-memory";
			no-map;
			reg = <0 0x44600000 0 0x10000>;
		};
		/* we reserved 2 sections for ATF */
		/* atf-reserved-memory for ATF image, xlat tab, bss, etc. */
		/* atf-ramdump-memory for ATF debug purpose, for ramdump */
		/* We use MPU region 1 to protected these 2 sections */
		/* reserve 64KB at DRAM start + 70MB, for ATF use */
		atf-reserved-memory@44610000 {
			compatible = "mediatek,mt6799-atf-reserved-memory";
			no-map;
			reg = <0 0x44610000 0 0x20000>;
		};

		reserve-memory-scp_share {
			compatible = "mediatek,reserve-memory-scp_share";
			no-map;
			size = <0 0x01400000>; /*20 MB share mem size */
			alignment = <0 0x1000000>;
			alloc-ranges = <0 0x40000000 0 0x50000000>; /*0x4000_0000~0x8FFF_FFFF*/
		};

		reserve-memory-sspm_share {
			compatible = "mediatek,reserve-memory-sspm_share";
			no-map;
			status = "disabled";
			size = <0 0x804000>;
			alignment = <0 0x400000>;
			debug-only = <0 0x400000>;
			alloc-ranges = <0 0x40000000 0 0x60000000>;
		};

		/* MET/ondiemet buffer allocation */
		ondiemet-reserve-memory {
			compatible = "mediatek,ondiemet-reserve-memory";
			no-map;
			size = <0 0x400000>;
			alignment = <0 0x400000>;
			alloc-ranges = <0 0x40000000 0 0x60000000>;
		};
	};

	chipid@08000000 {
		compatible = "mediatek,chipid";
		reg = <0 0x08000000 0 0x0004>,
		      <0 0x08000004 0 0x0004>,
		      <0 0x08000008 0 0x0004>,
		      <0 0x0800000C 0 0x0004>;
	};

	gic: interrupt-controller@40001000 {
		compatible = "arm,gic-v3";
		#interrupt-cells = <3>;
		#address-cells = <2>;
		#size-cells = <2>;
		#redistributor-regions = <1>;
		interrupt-controller;
		reg = <0 0x0c000000 0 0x40000>, // distributor
		      <0 0x0c200000 0 0x200000>, // redistributor
		      <0 0x10200620 0 0x001000>, // INTPOL
		      <0 0x10200690 0 0x001000>; // INTPOL1
		interrupts = <GIC_PPI 9 IRQ_TYPE_LEVEL_HIGH>;
		mediatek,reg_len_pol0 = <8>; // 8*32 irq polarity setting in INTPOL0

	};

	clk26m: clk26m {
		compatible = "fixed-clock";
		#clock-cells = <0>;
		clock-frequency = <26000000>;
	};

	clk32k: clk32k {
		compatible = "fixed-clock";
		#clock-cells = <0>;
		clock-frequency = <32000>;
	};

	dramc_sram_debug: dramc_sram_debug@0012d800 {
		compatible = "mediatek,dramc_sram_debug";
		reg = <0 0x0012d800 0 0x100>;
	};

	cpu_dbgapb: cpu_dbgapb {
		compatible = "mediatek,hw_dbg";
		num = <10>;
		reg =  <0 0x0d410000 0 0x1000
			0 0x0d510000 0 0x1000
			0 0x0d610000 0 0x1000
			0 0x0d710000 0 0x1000
			0 0x0d810000 0 0x1000
			0 0x0d910000 0 0x1000
			0 0x0da10000 0 0x1000
			0 0x0db10000 0 0x1000
			0 0x0dc10000 0 0x1000
			0 0x0dd10000 0 0x1000>;
	};

	infracfg_ao: infracfg_ao@10000000 {
		compatible = "mediatek,mt6799-infracfg_ao", "syscon";
		reg = <0 0x10000000 0 0x1000>;
		#clock-cells = <1>;
	};

	topckgen: topckgen@10210000 {
		compatible = "mediatek,mt6799-topckgen";
		reg = <0 0x10210000 0 0x1000>;
		#clock-cells = <1>;
	};

	scpsys: scpsys@10000000 {
		compatible = "mediatek,mt6799-scpsys";
		reg = <0 0x10000000 0 0x1000>,
		<0 0x10b00000 0 0x1000>;
		#clock-cells = <1>;
	};

	pwrap@10010000 {
		compatible = "mediatek,pwrap";
		reg = <0 0x10010000 0 0x1000>;
		interrupts = <GIC_SPI 194 IRQ_TYPE_LEVEL_HIGH>;
		mt6335_pmic: mt6335 {
			compatible = "mediatek,mt6335-pmic";
			interrupt-controller;
		};
		mt6337_pmic: mt6337 {
			compatible = "mediatek,mt6337-pmic";
			interrupt-controller;
		};
	};

	pwrap_p2p@109cb000 {
		compatible = "mediatek,pwrap_p2p";
		reg = <0 0x109cb000 0 0x1000>;
	};

	pwrap_md32@10a48000 {
		compatible = "mediatek,pwrap_md32";
		reg = <0 0x10a48000 0 0x1000>;
	};

	pericfg: pericfg@11010000 {
		compatible = "mediatek,mt6799-pericfg", "syscon";
		reg = <0 0x11010000 0 0x1000>;
		#clock-cells = <1>;
	};


	keypad: keypad@10030000 {
		compatible = "mediatek,mt6799-keypad";
		reg = <0 0x10030000 0 0x1000>;
		interrupts = <GIC_SPI 195 IRQ_TYPE_EDGE_FALLING>;

		mrdump_ext_rst: mrdump_ext_rst {
			compatible = "mediatek, mrdump_ext_rst-eint";
			status = "disabled";
		};
	};

	timer {
		compatible = "arm,armv8-timer";
		interrupts = <GIC_PPI 13 IRQ_TYPE_LEVEL_LOW>, /*Secure Physical Timer Event*/
			     <GIC_PPI 14 IRQ_TYPE_LEVEL_LOW>, /*Non-Secure Physical Timer Event*/
			     <GIC_PPI 11 IRQ_TYPE_LEVEL_LOW>, /*Virtual Timer Event*/
			     <GIC_PPI 10 IRQ_TYPE_LEVEL_LOW>; /*Hypervisor Timer Event*/
		clock-frequency = <13000000>;
	};


	apxgpt@10040000 {
		compatible = "mediatek,mt6799-timer",
			     "mediatek,mt6577-timer";
		reg = <0 0x10040000 0 0x1000>;
		interrupts = <GIC_SPI 185 IRQ_TYPE_LEVEL_LOW>;
		clocks = <&topckgen CLK_TOP_CLK13M>;
	};

	eintc: eintc@10050000 {
		compatible = "mediatek,mt-eic";
		reg = <0 0x10050000 0 0x1000>;
		interrupts = <GIC_SPI 186 IRQ_TYPE_LEVEL_HIGH>;
		mediatek,max_hw_deb_cnt = <16>;
		/* mediatek,builtin_eint_hw_deb = <145 8 0x90>; */
		/* mediatek,max_deint_cnt = <4>; */
		/* mediatek,deint_possible_irq = <191 192 193 194>; */
		#interrupt-cells = <2>;
		interrupt-controller;
		mediatek,max_eint_num = <232>;
		mediatek,mapping_table_entry = <0>;
		mediatek,debtime_setting_entry = <10>;
		mediatek,debtime_setting_array	= <0 128>,
						<1 256>,
						<2 512>,
						<3 1024>,
						<4 16384>,
						<5 32768>,
						<6 65536>,
						<7 131072>,
						<8 262144>,
						<9 524288>;
	};

	devapc_mpu_ao@10060000 {
		compatible = "mediatek,devapc_mpu_ao";
		reg = <0 0x10060000 0 0x1000>;
	};

	devapc_ao@10070000 {
		compatible = "mediatek,devapc_ao";
		reg = <0 0x10070000 0 0x1000>;
	};

	device_apc_ao_mm@10071000 {
		compatible = "mediatek,device_apc_ao_mm";
		reg = <0 0x10071000 0 0x1000>;
	};

	device_apc_ao_md@10072000 {
		compatible = "mediatek,device_apc_ao_md";
		reg = <0 0x10072000 0 0x1000>;
	};

	hacc@10080000 {
		compatible = "mediatek,hacc";
		reg = <0 0x10080000 0 0x1000>;
		interrupts = <GIC_SPI 212 IRQ_TYPE_LEVEL_LOW>;
	};

	rsvd@10090000 {
		compatible = "mediatek,rsvd";
		reg = <0 0x10090000 0 0x1000>;
	};

	topmisc@100a0000 {
		compatible = "mediatek,topmisc";
		reg = <0 0x100a0000 0 0x1000>;
	};

	aes_top0@100b0000 {
		compatible = "mediatek,aes_top0";
		reg = <0 0x100b0000 0 0x1000>;
	};

	aes_top1@100c0000 {
		compatible = "mediatek,aes_top1";
		reg = <0 0x100c0000 0 0x1000>;
	};

	modem_temp_share@100d0000 {
		compatible = "mediatek,modem_temp_share";
		reg = <0 0x100d0000 0 0x1000>;
	};

	sys_timer@100e0000 {
		compatible = "mediatek,sys_timer";
		reg = <0 0x100e0000 0 0x1000>;
		interrupts = <GIC_SPI 224 IRQ_TYPE_LEVEL_HIGH>;
	};

	apcldmain_ao@100f0000 {
		compatible = "mediatek,apcldmain_ao";
		reg = <0 0x100f0000 0 0x1000>;
	};

	apcldmaout_ao@100f0400 {
		compatible = "mediatek,apcldmaout_ao";
		reg = <0 0x100f0400 0 0x1000>;
	};

	apcldmamisc_ao@100f0800 {
		compatible = "mediatek,apcldmamisc_ao";
		reg = <0 0x100f0800 0 0x1000>;
	};

	mdcldmain_ao@10100000 {
		compatible = "mediatek,mdcldmain_ao";
		reg = <0 0x10100000 0 0x1000>;
	};

	mdcldmaout_ao@10100400 {
		compatible = "mediatek,mdcldmaout_ao";
		reg = <0 0x10100400 0 0x1000>;
	};

	mdcldmamisc_ao@10100800 {
		compatible = "mediatek,mdcldmamisc_ao";
		reg = <0 0x10100800 0 0x1000>;
	};

	sspm@10a40000 {
		compatible = "mediatek,sspm";
		reg = <0 0x10a40000 0 0x10000>;
		interrupts = <GIC_SPI 216 IRQ_TYPE_LEVEL_HIGH>;
	};

	sspm_mbox0@10a50000 {
		compatible = "mediatek,sspm_mbox0";
		reg = <0 0x10a50000 0 0x100>,
			<0 0x10a51000 0 0x8>;
		interrupts = <GIC_SPI 218 IRQ_TYPE_LEVEL_HIGH>;
	};
	sspm_mbox1@10a60000 {
		compatible = "mediatek,sspm_mbox1";
		reg = <0 0x10a60000 0 0x100>,
			<0 0x10a61000 0 0x8>;
		interrupts = <GIC_SPI 219 IRQ_TYPE_LEVEL_HIGH>;
	};
	sspm_mbox2@10a70000 {
		compatible = "mediatek,sspm_mbox2";
		reg = <0 0x10a70000 0 0x100>,
			<0 0x10a71000 0 0x8>;
		interrupts = <GIC_SPI 220 IRQ_TYPE_LEVEL_HIGH>;
	};
	sspm_mbox3@10a80000 {
		compatible = "mediatek,sspm_mbox3";
		reg = <0 0x10a80000 0 0x100>,
			<0 0x10a81000 0 0x8>;
		interrupts = <GIC_SPI 221 IRQ_TYPE_LEVEL_HIGH>;
	};
	sspm_mbox4@10a90000 {
		compatible = "mediatek,sspm_mbox4";
		reg = <0 0x10a90000 0 0x100>,
			<0 0x10a91000 0 0x8>;
		interrupts = <GIC_SPI 222 IRQ_TYPE_LEVEL_HIGH>;
	};

	sleep@10b00000 {
		compatible = "mediatek,sleep";
		reg = <0 0x10b00000 0 0x30000>;
		interrupts = <GIC_SPI 196 IRQ_TYPE_LEVEL_LOW>;
	};

	scp: scp@109C0000 {
		compatible = "mediatek,scp";
		status = "okay";
		do_addr_A = <0 0>;
		do_addr_B = <0 0>;
		reg = <0 0x10900000 0 0xC0000>,		/* sram */
		<0 0x109C0000 0 0x1000>,		/* cfgreg */
		<0 0x109C4000 0 0x1000>,		/* clkctrl */
		<0 0x109D4000 0 0x1000>;		/* clkctrldual */
		interrupts = <GIC_SPI 215 IRQ_TYPE_LEVEL_HIGH>,
		<GIC_SPI 388 IRQ_TYPE_LEVEL_HIGH>;
	};

	bpi_top@10350000 {
		compatible = "mediatek,bpi_top";
		reg = <0 0x10350000 0 0x1000>;
	};

	bsi_mm@10351000 {
		compatible = "mediatek,bsi_mm";
		reg = <0 0x10351000 0 0x1000>;
	};

	arbspi_rfic1@10353000 {
		compatible = "mediatek,arbspi_rfic1";
		reg = <0 0x10353000 0 0x1000>;
	};

	arbspi_rfic2@10353800 {
		compatible = "mediatek,arbspi_rfic2";
		reg = <0 0x10353800 0 0x1000>;
	};

	arbspi_pmic@10354000 {
		compatible = "mediatek,arbspi_pmic";
		reg = <0 0x10354000 0 0x1000>;
	};

	arbspi_mipi0@10354800 {
		compatible = "mediatek,arbspi_mipi0";
		reg = <0 0x10354800 0 0x1000>;
	};

	arbspi_mipi1@10355000 {
		compatible = "mediatek,arbspi_mipi1";
		reg = <0 0x10355000 0 0x1000>;
	};

	arbspi_mipi2@10355800 {
		compatible = "mediatek,arbspi_mipi2";
		reg = <0 0x10355800 0 0x1000>;
	};

	arbspi_mipi3@10356000 {
		compatible = "mediatek,arbspi_mipi3";
		reg = <0 0x10356000 0 0x1000>;
	};

	arbspi_mipi4@10356800 {
		compatible = "mediatek,arbspi_mipi4";
		reg = <0 0x10356800 0 0x1000>;
	};

	arbspi_mipi5@10357000 {
		compatible = "mediatek,arbspi_mipi5";
		reg = <0 0x10357000 0 0x1000>;
	};

	arbspi_mipi6@10357800 {
		compatible = "mediatek,arbspi_mipi6";
		reg = <0 0x10357800 0 0x1000>;
	};

	arbspi_mipi7@10358000 {
		compatible = "mediatek,arbspi_mipi7";
		reg = <0 0x10358000 0 0x1000>;
	};

	bsi_top_mbist@10359000 {
		compatible = "mediatek,bsi_top_mbist";
		reg = <0 0x10359000 0 0x1000>;
	};

	mcsi_reg@0c510000 {
		compatible = "mediatek,mcsi_reg";
		reg = <0 0x0c510000 0 0x1000>;
	};

	mcsi_top_dfp@0c51f000 {
		compatible = "mediatek,mcsi_top_dfp";
		reg = <0 0x0c51f000 0 0x1000>;
	};

	dbgapb@0d000000 {
		compatible = "mediatek,dbgapb";
		reg = <0 0x0d000000 0 0x1000>;
		interrupts = <GIC_SPI 150 IRQ_TYPE_LEVEL_LOW>;
	};

	dem@0d0a0000 {
		compatible = "mediatek,dem";
		reg = <0 0x0d0a0000 0 0x1000>;
	};

	mcucfg@10200000 {
		compatible = "mediatek,mcucfg";
		reg = <0 0x10200000 0 0x4000>;
		interrupts = <GIC_SPI 0 IRQ_TYPE_LEVEL_LOW>;
	};

	ocp_cfg@10200000 {
		compatible = "mediatek,ocp_cfg";
		reg = <0 0x10200000 0 0x4000>;
		interrupts = <GIC_SPI 429 IRQ_TYPE_LEVEL_HIGH>,
				<GIC_SPI 430 IRQ_TYPE_LEVEL_HIGH>,
				<GIC_SPI 431 IRQ_TYPE_LEVEL_HIGH>,
				<GIC_SPI 432 IRQ_TYPE_LEVEL_HIGH>,
				<GIC_SPI 433 IRQ_TYPE_LEVEL_HIGH>,
				<GIC_SPI 434 IRQ_TYPE_LEVEL_HIGH>,
				<GIC_SPI 435 IRQ_TYPE_LEVEL_HIGH>,
				<GIC_SPI 436 IRQ_TYPE_LEVEL_HIGH>,
				<GIC_SPI 437 IRQ_TYPE_LEVEL_HIGH>;
	};

	toprgu@10211000 {
		compatible = "mediatek,mt6799-toprgu";
		reg = <0 0x10211000 0 0x1000>;
		interrupts = <GIC_SPI 387 IRQ_TYPE_LEVEL_LOW>;
	};

	apmixed: apmixed@10212000 {
		compatible = "mediatek,mt6799-apmixedsys", "syscon";
		reg = <0 0x10212000 0 0x1000>;
		#clock-cells = <1>;
	};

	fhctl@10212e00 {
		compatible = "mediatek,fhctl";
		reg = <0 0x10212e00 0 0x1000>;
	};

	io_cfg_rb@11c10000 {
		compatible = "mediatek,io_cfg_rb";
		reg = <0 0x11c10000 0 0x1000>;
	};

	ufs_mphy@11d20000 {
		compatible = "mediatek,ufs_mphy";
		reg = <0 0x11d20000 0 0xc000>;
	};

	io_cfg_br@11d30000 {
		compatible = "mediatek,io_cfg_br";
		reg = <0 0x11d30000 0 0x1000>;
	};

	io_cfg_bl@11d40000 {
		compatible = "mediatek,io_cfg_bl";
		reg = <0 0x11d40000 0 0x1000>;
	};

	io_cfg_bm@11d50000 {
		compatible = "mediatek,io_cfg_bm";
		reg = <0 0x11d50000 0 0x1000>;
	};

	io_cfg_lb@11e60000 {
		compatible = "mediatek,io_cfg_lb";
		reg = <0 0x11e60000 0 0x1000>;
	};

	io_cfg_lt@11e10000 {
		compatible = "mediatek,io_cfg_lt";
		reg = <0 0x11e10000 0 0x1000>;
	};

	io_cfg_tr@11f00000 {
		compatible = "mediatek,io_cfg_tr";
		reg = <0 0x11f00000 0 0x1000>;
	};

	sramrom@10220000 {
		compatible = "mediatek,sramrom";
		reg = <0 0x10220000 0 0x1000>;
	};

	devapc@10222000 {
		compatible = "mediatek,devapc";
		reg = <0 0x10222000 0 0x1000>,
			<0 0x111a1000 0 0x1000>;
		interrupts = <GIC_SPI 159 IRQ_TYPE_LEVEL_LOW>,
			<GIC_SPI 156 IRQ_TYPE_LEVEL_LOW>;
		clocks = <&infracfg_ao CLK_INFRA_DEVICE_APC>,
			<&pericfg CLK_PERICFG_RG_DEVICE_APC_PERI>;
		clock-names = "devapc-infra-clock",
			"devapc-peri-clock";
	};

	trng@10223000 {
		compatible = "mediatek,trng";
		reg = <0 0x10223000 0 0x1000>;
		interrupts = <GIC_SPI 165 IRQ_TYPE_LEVEL_LOW>;
	};

	dxcc_pub@11b10000 {
		compatible = "mediatek,dxcc_pub";
		reg = <0 0x11b10000 0 0x1000>;
		interrupts = <GIC_SPI 155 IRQ_TYPE_LEVEL_HIGH>;
		clocks = <&pericfg CLK_PERICFG_RG_DXCC_PUB>;
		clock-names = "dxcc-pubcore-clock";
	};

	dxcc_sec@11b20000 {
		compatible = "mediatek,dxcc_sec";
		reg = <0 0x11b20000 0 0x1000>;
		interrupts = <GIC_SPI 154 IRQ_TYPE_LEVEL_HIGH>;
	};

	emi@10230000 {
		compatible = "mediatek,emi";
		reg = <0 0x10230000 0 0x1000>;
		interrupts = <GIC_SPI 161 IRQ_TYPE_LEVEL_LOW>;
	};

	lpdma@10231000 {
		compatible = "mediatek,lpdma";
		reg = <0 0x10231000 0 0x1000>;
		interrupts = <GIC_SPI 167 IRQ_TYPE_LEVEL_HIGH>;
	};

	lpdma_module@10231800 {
		compatible = "mediatek,lpdma_module";
		reg = <0 0x10231800 0 0x1000>;
	};

	emi_mpu@10232000 {
		compatible = "mediatek,emi_mpu";
		reg = <0 0x10232000 0 0x1000>;
	};

	infra_emi_dfp@10300000 {
		compatible = "mediatek,infra_emi_dfp";
		reg = <0 0x10300000 0 0x1000>;
	};

	fde_aes_core@11b40000 {
		compatible = "mediatek,fde_aes_core";
		reg = <0 0x11b40000 0 0x1000>;
	};

	fde_aes_wrapper@11b40800 {
		compatible = "mediatek,fde_aes_wrapper";
		reg = <0 0x11b40800 0 0x1000>;
		interrupts = <GIC_SPI 75 IRQ_TYPE_LEVEL_LOW>;
	};

	vad2_wrapper@11b70000 {
		compatible = "mediatek,vad2_wrapper";
		reg = <0 0x11b70000 0 0x1000>;
	};

	ap_ccif0@10240000 {
		compatible = "mediatek,ap_ccif0";
		reg = <0 0x10240000 0 0x1000>;
		interrupts = <GIC_SPI 164 IRQ_TYPE_LEVEL_LOW>;
	};

	ap_ccif1@10241000 {
		compatible = "mediatek,ap_ccif1";
		reg = <0 0x10241000 0 0x1000>;
		interrupts = <GIC_SPI 166 IRQ_TYPE_LEVEL_LOW>;
	};

	apcldmain@10242000 {
		compatible = "mediatek,apcldmain";
		reg = <0 0x10242000 0 0x1000>;
	};

	apcldmaout@10242400 {
		compatible = "mediatek,apcldmaout";
		reg = <0 0x10242400 0 0x1000>;
	};

	apcldmamisc@10242800 {
		compatible = "mediatek,apcldmamisc";
		reg = <0 0x10242800 0 0x1000>;
		interrupts = <GIC_SPI 362 IRQ_TYPE_LEVEL_HIGH>;
	};

	ap_ccif2@10250000 {
		compatible = "mediatek,ap_ccif2";
		reg = <0 0x10250000 0 0x1000>;
	};

	ap_ccif3@10251000 {
		compatible = "mediatek,ap_ccif3";
		reg = <0 0x10251000 0 0x1000>;
	};

	rccif_ps_c2k@90270000 {
		compatible = "mediatek,rccif_ps_c2k";
		reg = <0 0x90270000 0 0x1000>;
	};

	rccif_l1_c2k@90270400 {
		compatible = "mediatek,rccif_l1_c2k";
		reg = <0 0x90270400 0 0x1000>;
	};

	mdcldmain@10704000 {
		compatible = "mediatek,mdcldmain";
		reg = <0 0x10704000 0 0x1000>;
	};

	mdcldmaout@10704400 {
		compatible = "mediatek,mdcldmaout";
		reg = <0 0x10704400 0 0x1000>;
	};

	mdcldmamisc@10704800 {
		compatible = "mediatek,mdcldmamisc";
		reg = <0 0x10704800 0 0x1000>;
	};

	rccif_c2k_ps@902b0000 {
		compatible = "mediatek,rccif_c2k_ps";
		reg = <0 0x902b0000 0 0x1000>;
	};

	rccif_c2k_l1@902b0400 {
		compatible = "mediatek,rccif_c2k_l1";
		reg = <0 0x902b0400 0 0x1000>;
	};

	mdcldma:mdcldma@100f0000 {
		compatible = "mediatek,mdcldma";
		reg =	<0 0x100f0000 0 0x1000>, /*AP_CLDMA_AO*/
			<0 0x10100000 0 0x1000>, /*MD_CLDMA_AO*/
			<0 0x10242000 0 0x1000>, /*AP_CLDMA_PDN*/
			<0 0x10704000 0 0x1000>, /*MD_CLDMA_PDN*/
			<0 0x10240000 0 0x1000>, /*AP_CCIF_BASE*/
			<0 0x10700000 0 0x1000>; /*MD_CCIF_BASE*/
		interrupts = <GIC_SPI 172 IRQ_TYPE_LEVEL_HIGH>, /*IRQ_CLDMA*/
			     <GIC_SPI 164 IRQ_TYPE_LEVEL_LOW>, /*IRQ_CCIF*/
			     <GIC_SPI 361 IRQ_TYPE_EDGE_RISING>; /*IRQ_MDWDT*/
		mediatek,md_id = <0>;
		mediatek,cldma_capability = <6>;
		clocks =  <&scpsys SCP_SYS_MD1>,
			<&infracfg_ao CLK_INFRA_CLDMA_AP_TOP>,
			<&infracfg_ao CLK_INFRA_CLDMA_AO_TOP_HCLK>,
			<&infracfg_ao CLK_INFRA_CCIF0_AP>,
			<&infracfg_ao CLK_INFRA_CCIF0_MD>,
			<&infracfg_ao CLK_INFRA_CCIF1_AP>,
			<&infracfg_ao CLK_INFRA_CCIF1_MD>,
			<&infracfg_ao CLK_INFRA_CCIF2_AP>,
			<&infracfg_ao CLK_INFRA_CCIF2_MD>,
			<&infracfg_ao CLK_INFRA_CCIF3_AP>,
			<&infracfg_ao CLK_INFRA_CCIF3_MD>,
			<&infracfg_ao CLK_INFRA_MD2MD_CCIF_SET_0>,
			<&infracfg_ao CLK_INFRA_MD2MD_CCIF_SET_1_AND_MODEM_TEMP_SHARE>,
			<&infracfg_ao CLK_INFRA_MD2MD_CCIF_SET_2>,
			<&infracfg_ao CLK_INFRA_MD2MD_CCIF_MD_SET_3>,
			<&infracfg_ao CLK_INFRA_MD2MD_CCIF_MD_SET_4>,
			<&infracfg_ao CLK_INFRA_MD2MD_CCIF_MD_SET_5>;
		clock-names = "scp-sys-md1-main",
			"infra-cldma-ap",
			"infra-cldma-ap-hclk",
			"infra-ccif-ap",
			"infra-ccif-md",
			"infra-ap-c2k-ccif-0",
			"infra-ap-c2k-ccif-1",
			"infra-scp-md1-ccif-0",
			"infra-scp-md1-ccif-1",
			"infra-scp-c2k-ccif-0",
			"infra-scp-c2k-ccif-1",
			"infra-md2md-ccif-0",
			"infra-md2md-ccif-1",
			"infra-md2md-ccif-2",
			"infra-md2md-ccif-3",
			"infra-md2md-ccif-4",
			"infra-md2md-ccif-5";
	};

	ap2c2k_ccif@10241000 {
		compatible = "mediatek,ap2c2k_ccif";
		reg = <0 0x10241000 0 0x1000>; /* CCIF */
		interrupts = <GIC_SPI 166 IRQ_TYPE_LEVEL_LOW>, /* C2K_CCIF */
				<GIC_SPI 360 IRQ_TYPE_EDGE_FALLING>; /* C2K_WDT */
		cell-index = <2>;
		ccif,major = <169>;
		ccif,minor_base = <0>;
		ccif,capability = <2>;	/* tx busy stop */
		mediatek,md_smem_size = <0x400000>; /* md share memory size */
		clocks = <&scpsys SCP_SYS_C2K>;
		clock-names = "scp-sys-c2k-main";
	};

	sys_cirq@10270000 {
		compatible = "mediatek,sys_cirq";
		reg = <0 0x10270000 0 0x1000>;
		interrupts = <GIC_SPI 391 IRQ_TYPE_LEVEL_LOW>;
		mediatek,cirq_num = <320>;
		mediatek,spi_start_offset = <72>;
	};

	gce@10280000 {
		compatible = "mediatek,gce";
		reg = <0 0x10280000 0 0x1000>;
		interrupts = <GIC_SPI 176 IRQ_TYPE_LEVEL_LOW>,
					<GIC_SPI 177 IRQ_TYPE_LEVEL_LOW>;
		disp_mutex_reg = <0x14025000 0x1000>;
		g3d_config_base = <0x13000000 0 0xffff0000>;
		mmsys_config_base = <0x14000000 1 0xffff0000>;
		disp_dither_base = <0x14010000 2 0xffff0000>;
		mm_na_base = <0x14020000 3 0xffff0000>;
		imgsys_base = <0x15000000 4 0xffff0000>;
		vdec_gcon_base = <0x16000000 5 0xffff0000>;
		venc_gcon_base = <0x17000000 6 0xffff0000>;
		conn_peri_base = <0x18000000 7 0xffff0000>;
		topckgen_base = <0x10000000 8 0xffff0000>;
		kp_base = <0x10010000 9 0xffff0000>;
		scp_sram_base = <0x10020000 10 0xffff0000>;
		infra_na3_base = <0x10030000 11 0xffff0000>;
		infra_na4_base = <0x10040000 12 0xffff0000>;
		scp_base = <0x10050000 13 0xffff0000>;
		mcucfg_base = <0x10200000 14 0xffff0000>;
		gcpu_base = <0x10210000 15 0xffff0000>;
		usb0_base = <0x11200000 16 0xffff0000>;
		usb_sif_base = <0x11210000 17 0xffff0000>;
		audio_base = <0x11220000 18 0xffff0000>;
		vdec_base = <0x16010000 19 0xffff0000>;
		msdc2_base = <0x11250000 20 0xffff0000>;
		vdec1_base = <0x16020000 21 0xffff0000>;
		msdc3_base = <0x11260000 22 0xffff0000>;
		ap_dma_base = <0x11000000 23 0xffff0000>;
		gce_base = <0x102d0000 24 0xffff0000>;
		vdec2_base = <0x16030000 25 0xffff0000>;
		vdec3_base = <0x16040000 26 0xffff0000>;
		camsys_base = <0x1A000000 27 0xffff0000>;
		camsys1_base = <0x1A010000 28 0xffff0000>;
		camsys2_base = <0x1A040000 29 0xffff0000>;
		camsys3_base = <0x1A050000 30 0xffff0000>;
		imgsys1_base = <0x15020000 31 0xffff0000>;
		pwm_sw_base = <0x11140000 99 0xffff0000>;
		pwm1_sw_base = <0x11150000 99 0xffff0000>;
		disp_rdma0_sof = <0>;
		disp_rdma1_sof = <1>;
		disp_rdma2_sof = <2>;
		mdp_rdma0_sof = <3>;
		mdp_rdma1_sof = <4>;
		mdp_rsz0_sof = <5>;
		mdp_rsz1_sof = <6>;
		mdp_rsz2_sof = <7>;
		mdp_tdshp_sof = <8>;
		mdp_color_sof = <9>;
		mdp_wdma_sof = <10>;
		mdp_wrot0_sof = <11>;
		mdp_wrot1_sof = <12>;
		disp_ovl0_sof = <13>;
		disp_ovl1_sof = <14>;
		disp_2l_ovl0_sof = <15>;
		disp_2l_ovl1_sof = <16>;
		disp_wdma0_sof = <17>;
		disp_wdma1_sof = <18>;
		disp_color0_sof = <19>;
		disp_color1_sof = <20>;
		disp_ccorr0_sof = <21>;
		disp_ccorr1_sof = <22>;
		disp_aal0_sof = <23>;
		disp_aal1_sof = <24>;
		disp_gamma0_sof = <25>;
		disp_gamma1_sof = <26>;
		disp_od_sof = <27>;
		disp_dither0_sof = <28>;
		disp_dither1_sof = <29>;
		disp_ufoe_sof = <30>;
		disp_dsc_sof_1 = <31>;
		disp_dsc_sof_2 = <32>;
		disp_pwm0_sof = <33>;
		disp_pwm1_sof = <34>;
		disp_dsi0_sof = <35>;
		disp_dsi1_sof = <36>;
		disp_rsz0_sof = <37>;
		disp_rsz1_sof = <38>;
		disp_rdma0_frame_done = <39>;
		disp_rdma1_frame_done = <40>;
		disp_rdma2_frame_done = <41>;
		mdp_rdma0_frame_done = <42>;
		mdp_rdma1_frame_done = <43>;
		mdp_rsz0_frame_done = <44>;
		mdp_rsz1_frame_done = <45>;
		mdp_rsz2_frame_done = <46>;
		mdp_tdshp_frame_done = <47>;
		mdp_color_frame_done = <48>;
		mdp_wdma_frame_done = <49>;
		mdp_wrot0_write_frame_done = <50>;
		mdp_wrot0_read_frame_done = <51>;
		mdp_wrot1_write_frame_done = <52>;
		mdp_wrot1_read_frame_done = <53>;
		disp_ovl0_frame_done = <54>;
		disp_ovl1_frame_done = <55>;
		disp_2l_ovl0_frame_done = <56>;
		disp_2l_ovl1_frame_done = <57>;
		disp_wdma0_frame_done = <58>;
		disp_wdma1_frame_done = <59>;
		disp_color0_frame_done = <60>;
		disp_color1_frame_done = <61>;
		disp_ccorr0_frame_done = <62>;
		disp_ccorr1_frame_done = <63>;
		disp_aal0_frame_done = <64>;
		disp_aal1_frame_done = <65>;
		disp_gamma0_frame_done = <66>;
		disp_gamma1_frame_done = <67>;
		disp_od_frame_done = <68>;
		disp_dither0_frame_done = <69>;
		disp_dither1_frame_done = <70>;
		disp_ufoe_frame_done = <71>;
		disp_dsc_frame_done_0 = <72>;
		disp_dsc_frame_done_1 = <73>;
		disp_dsi0_frame_done = <74>;
		disp_dsi1_frame_done = <75>;
		disp_dpi0_frame_done = <76>;
		disp_rsz0_frame_done = <77>;
		disp_rsz1_frame_done = <78>;
		stream_done_0 = <130>;
		stream_done_1 = <131>;
		stream_done_2 = <132>;
		stream_done_3 = <133>;
		stream_done_4 = <134>;
		stream_done_5 = <135>;
		stream_done_6 = <136>;
		stream_done_7 = <137>;
		stream_done_8 = <138>;
		stream_done_9 = <139>;
		stream_done_10 = <140>;
		stream_done_11 = <141>;
		stream_done_12 = <142>;
		stream_done_13 = <143>;
		stream_done_14 = <144>;
		stream_done_15 = <145>;
		buf_underrun_event_0 = <146>;
		buf_underrun_event_1 = <147>;
		buf_underrun_event_2 = <148>;
		disp_od_rdma_frame_done = <149>;
		disp_od_wdma_frame_done = <150>;
		dsi0_te_event = <151>;
		dsi0_to_gce_mmck0 = <152>;
		dsi0_to_gce_mmck4 = <156>;
		dsi1_te_event = <157>;
		dsi1_to_gce_mmck0 = <158>;
		dsi1_to_gce_mmck4 = <162>;
		disp_wdma0_rst_done = <163>;
		disp_wdma1_rst_done = <164>;
		mdp_wrot1_rst_done = <165>;
		mdp_wrot0_rst_done = <166>;
		mdp_wdma_rst_done = <167>;
		mdp_rdma1_rst_done = <168>;
		mdp_rdma0_rst_done = <169>;
		disp_ovl0_frame_rst_done_pusle = <170>;
		disp_ovl1_frame_rst_done_pusle = <171>;
		disp_ovl0_2l_frame_rst_done_pusle = <172>;
		disp_ovl1_2l_frame_rst_done_pusle = <173>;
		disp_mutex_all_module_upd0 = <175>;
		disp_mutex_all_module_upd1 = <176>;
		disp_mutex_all_module_upd2 = <177>;
		disp_mutex_all_module_upd3 = <178>;
		disp_mutex_all_module_upd4 = <179>;
		disp_mutex_all_module_upd5 = <180>;
		disp_mutex_all_module_upd6 = <181>;
		disp_mutex_all_module_upd7 = <182>;
		disp_mutex_all_module_upd8 = <183>;
		disp_mutex_all_module_upd9 = <184>;
		disp_mutex_all_module_upd10 = <185>;
		disp_mutex_all_module_upd11 = <186>;
		disp_mutex_all_module_upd12 = <187>;
		disp_mutex_all_module_upd13 = <188>;
		disp_mutex_all_module_upd14 = <189>;
		disp_mutex_all_module_upd15 = <190>;
		disp_mutex_reg_upd_for_module0 = <191>;
		disp_mutex_reg_upd_for_module1 = <191>;
		disp_mutex_reg_upd_for_module2 = <193>;
		disp_mutex_reg_upd_for_module3 = <194>;
		disp_mutex_reg_upd_for_module4 = <195>;
		disp_mutex_reg_upd_for_module5 = <196>;
		disp_mutex_reg_upd_for_module6 = <197>;
		disp_mutex_reg_upd_for_module7 = <198>;
		disp_mutex_reg_upd_for_module8 = <199>;
		disp_mutex_reg_upd_for_module9 = <200>;
		disp_mutex_reg_upd_for_module10 = <201>;
		disp_mutex_reg_upd_for_module11 = <202>;
		disp_mutex_reg_upd_for_module12 = <203>;
		disp_mutex_reg_upd_for_module13 = <204>;
		disp_mutex_reg_upd_for_module14 = <205>;
		disp_mutex_reg_upd_for_module15 = <206>;
		disp_mutex_reg_upd_for_module16 = <207>;
		disp_mutex_reg_upd_for_module17 = <208>;
		disp_mutex_reg_upd_for_module18 = <209>;
		disp_mutex_reg_upd_for_module19 = <210>;
		disp_mutex_reg_upd_for_module20 = <211>;
		disp_mutex_reg_upd_for_module21 = <212>;
		disp_mutex_reg_upd_for_module22 = <213>;
		disp_mutex_reg_upd_for_module23 = <214>;
		disp_mutex_reg_upd_for_module24 = <215>;
		disp_mutex_reg_upd_for_module25 = <216>;
		disp_mutex_reg_upd_for_module26 = <217>;
		disp_mutex_reg_upd_for_module27 = <218>;
		disp_mutex_reg_upd_for_module28 = <219>;
		disp_mutex_reg_upd_for_module29 = <220>;
		disp_mutex_reg_upd_for_module30 = <221>;
		disp_mutex_reg_upd_for_module31 = <222>;
		disp_mutex_reg_upd_for_module32 = <223>;
		disp_mutex_reg_upd_for_module33 = <224>;
		disp_mutex_reg_upd_for_module34 = <225>;
		disp_mutex_reg_upd_for_module35 = <226>;
		disp_mutex_reg_upd_for_module36 = <227>;
		disp_mutex_reg_upd_for_module37 = <228>;
		disp_mutex_reg_upd_for_module38 = <229>;
		dip_cq_thread0_frame_done = <257>;
		dip_cq_thread1_frame_done = <258>;
		dip_cq_thread2_frame_done = <259>;
		dip_cq_thread3_frame_done = <260>;
		dip_cq_thread4_frame_done = <261>;
		dip_cq_thread5_frame_done = <262>;
		dip_cq_thread6_frame_done = <263>;
		dip_cq_thread7_frame_done = <264>;
		dip_cq_thread8_frame_done = <265>;
		dip_cq_thread9_frame_done = <266>;
		dip_cq_thread10_frame_done = <267>;
		dip_cq_thread11_frame_done = <268>;
		dip_cq_thread12_frame_done = <269>;
		dip_cq_thread13_frame_done = <270>;
		dip_cq_thread14_frame_done = <271>;
		dve_frame_done = <272>;
		wmf_frame_done = <273>;
		gepf_frame_done = <274>;
		gepf_temp_frame_done = <275>;
		gepf_bypass_frame_done = <276>;
		rsc_frame_done = <277>;
		wpe_a_frame_done = <278>;
		eaf_frame_done = <279>;
		venc_done = <289>;
		jpgdec_done = <290>;
		jpgenc_done = <291>;
		venc_mb_done = <292>;
		venc_128byte_cnt_done = <293>;
		venc_bsdma_full = <294>;
		isp_frame_done_a = <321>;
		isp_frame_done_b = <322>;
		camsv_0_pass1_done = <323>;
		camsv_1_pass1_done = <324>;
		camsv_2_pass1_done = <325>;
		tsf_done = <326>;
		seninf_0_fifo_full = <327>;
		seninf_1_fifo_full = <328>;
		seninf_2_fifo_full = <329>;
		seninf_3_fifo_full = <330>;
		seninf_4_fifo_full = <331>;
		seninf_5_fifo_full = <332>;
		seninf_6_fifo_full = <333>;
		seninf_7_fifo_full = <334>;
		ipu_done_0 = <353>;
		ipu_done_1 = <354>;
		ipu_done_2 = <355>;
		ipu_done_3 = <356>;
		max_prefetch_cnt = <4>;
		prefetch_size = <160 32 32 32>;
		clocks = <&infracfg_ao CLK_INFRA_GCE>;
		clock-names = "GCE";
	};

	cq_dma@11b30000 {
		compatible = "mediatek,mt-cqdma-v1";
		reg = <0 0x11b30000 0 0x80>,
			  <0 0x11b30080 0 0x80>,
			  <0 0x11b30100 0 0x80>;
		interrupts = <GIC_SPI 151 IRQ_TYPE_LEVEL_LOW>,
					 <GIC_SPI 152 IRQ_TYPE_LEVEL_LOW>,
					 <GIC_SPI 153 IRQ_TYPE_LEVEL_LOW>;
		nr_channel = <3>;
		clocks = <&pericfg CLK_PERICFG_RG_CQ_DMA>;
		clock-names = "cqdma";
	};

	infra_md_reg@10291000 {
		compatible = "mediatek,infra_md_reg";
		reg = <0 0x10291000 0 0x1000>;
	};

	ufozip@11b00000 {
		compatible = "mediatek,ufozip";
		reg = <0 0x11b00000 0 0x4000>;
		interrupts = <GIC_SPI 78 IRQ_TYPE_LEVEL_HIGH>;
		clocks =
			<&topckgen CLK_TOP_UFO_ENC_SEL>,
			<&topckgen CLK_TOP_UNIVPLL_D2>,
			<&topckgen CLK_TOP_UNIVPLL1_D2>,
			<&pericfg CLK_PERICFG_RG_UFOZIP>;
		clock-names = "ufo_sel", "clock_high_624", "clock_low_312", "ufo_clk";
	};

	dvfsrc@10110000 {
		compatible = "mediatek,dvfsrc";
		reg = <0 0x10110000 0 0x1000>;
	};

	cmcu@10302000 {
		compatible = "mediatek,mt6799-cmcu";
		reg = <0 0x108E0000 0 0x1000>,
			<0 0x0012a000 0 0x3000>;
	};

	mipi_rx_ana_csi0a@11e40000 {
		compatible = "mediatek,mipi_rx_ana_csi0a";
		reg = <0 0x11e40000 0 0x1000>;
	};

	mipi_rx_ana_csi0b@11e41000 {
		compatible = "mediatek,mipi_rx_ana_csi0b";
		reg = <0 0x11e41000 0 0x1000>;
	};

	mipi_rx_ana_csi1a@11e42000 {
		compatible = "mediatek,mipi_rx_ana_csi1a";
		reg = <0 0x11e42000 0 0x1000>;
	};

	mipi_rx_ana_csi1b@11e43000 {
		compatible = "mediatek,mipi_rx_ana_csi1b";
		reg = <0 0x11e43000 0 0x1000>;
	};

	mipi_rx_ana_csi2a@11e44000 {
		compatible = "mediatek,mipi_rx_ana_csi2a";
		reg = <0 0x11e44000 0 0x1000>;
	};

	mipi_rx_ana_csi2b@11e45000 {
		compatible = "mediatek,mipi_rx_ana_csi2b";
		reg = <0 0x11e45000 0 0x1000>;
	};

	mm_iommu@102b0000 {
		cell-index = <0>;
		compatible = "mediatek,mm_iommu";
		reg = <0 0x102b0000 0 0x1000>;
		interrupts = <GIC_SPI 180 IRQ_TYPE_LEVEL_LOW>;
		clocks = <&mmsys_config CLK_MM_CG2_B9>,
			<&mmsys_config CLK_MM_CG2_B10>,
			<&vdec_gcon CLK_VDEC_CKEN>,
			<&vdec_gcon CLK_VDEC_LARB1_CKEN>,
			<&imgsys CLK_IMG_LARB5>,
			<&camsys CLK_CAM_LARB6>,
			<&venc_global_con CLK_VENC_GLOBAL_CON_CKE0>,
			<&venc_global_con CLK_VENC_GLOBAL_CON_CKE1>,
			<&mjc_config CLK_MJC_SMI_LARB>,
			<&scpsys SCP_SYS_MM0>,
			<&scpsys SCP_SYS_VDE>,
			<&scpsys SCP_SYS_ISP>,
			<&scpsys SCP_SYS_CAM>,
			<&scpsys SCP_SYS_VEN>,
			<&scpsys SCP_SYS_MJC>;
		clock-names = "m4u_mm_smi_larb0",
			"m4u_mm_smi_larb1",
			"m4u_vdec_cken",
			"m4u_vdec_larb1_cken",
			"m4u_img_larb5",
			"m4u_cam_larb6",
			"m4u_venc_0",
			"m4u_venc_1",
			"m4u_mjc_smi_larb",
			"m4u_mtcmos_dis",
			"m4u_mtcmos_vde",
			"m4u_mtcmos_img",
			"m4u_mtcmos_cam",
			"m4u_mtcmos_ven",
			"m4u_mtcmos_mjc";
	};

	peri_m1_dfp@11ae0000 {
		compatible = "mediatek,peri_m1_dfp";
		reg = <0 0x11ae0000 0 0x1000>;
	};

	peri_m2_dfp@11ae1000 {
		compatible = "mediatek,peri_m2_dfp";
		reg = <0 0x11ae1000 0 0x1000>;
	};

	pio: pinctrl@102d0000 {
		compatible = "mediatek,mt6799-pinctrl";
		reg = <0 0x102d0000 0 0x1000>;
		mediatek,pctl-regmap = <&syscfg_pctl_a>;
		pins-are-numbered;
		gpio-controller;
		#gpio-cells = <2>;
	};

	gpio_usage_mapping:gpio {
		compatible = "mediatek,gpio_usage_mapping";
	};

	gpio@102d0000 {
		compatible = "mediatek,gpio";
		reg = <0 0x102d0000 0 0x1000>;
	};

	syscfg_pctl_a: syscfg_pctl_a@11c10000 {
		compatible = "mediatek,mt6799-pctl-a-syscfg", "syscon";
		reg = <0 0x11c10000 0 0x200>;
	};

	iocfg_rb@11c10000 {
		compatible = "mediatek,iocfg_rb";
		reg = <0 0x11c10000 0 0x200>;
	};

	iocfg_br@11d30000 {
		compatible = "mediatek,iocfg_br";
		reg = <0 0x11d30000 0 0x200>;
	};

	iocfg_bl@11d40000 {
		compatible = "mediatek,iocfg_bl";
		reg = <0 0x11d40000 0 0x200>;
	};

	iocfg_bm@11d50000 {
		compatible = "mediatek,iocfg_bm";
		reg = <0 0x11d50000 0 0x200>;
	};

	iocfg_lt@11e10000 {
		compatible = "mediatek,iocfg_lt";
		reg = <0 0x11e10000 0 0x200>;
	};

	iocfg_lb@11e60000 {
		compatible = "mediatek,iocfg_lb";
		reg = <0 0x11e60000 0 0x200>;
	};

	iocfg_tr@11f00000 {
		compatible = "mediatek,iocfg_tr";
		reg = <0 0x11f00000 0 0x200>;
	};

	bus_tracer@102e0000 {
		compatible = "mediatek,bus_tracer-v1";
		reg = <0 0x0d0a0000 0 0x1000>, /* dem base */
			<0 0x0d040000 0 0x10000>,/* funnel base */
			<0 0x102e0000 0 0x1000>, /* bus tracer base */
			<0 0x0d014000 0 0x1000>; /* bus tracer etb base */

		mediatek,num_tracer = <1>;
		mediatek,enabled_tracer = <1>;
		mediatek,at_id = <0x30>;
		mediatek,multi_user_etb_id = <0x0>;
	};

	ddrphy0ao@10330000 {
		compatible = "mediatek,ddrphy0ao";
		reg = <0 0x10330000 0 0x2000>;
	};

	dramc0_ao@10332000 {
		compatible = "mediatek,dramc0_ao";
		reg = <0 0x10332000 0 0x2000>;
	};

	dramc0nao@10334000 {
		compatible = "mediatek,dramc0nao";
		reg = <0 0x10334000 0 0x1000>;
	};

	chn0_emi@10335000 {
		compatible = "mediatek,chn0_emi";
		reg = <0 0x10335000 0 0x1000>;
	};

	ddrphy1ao@10338000 {
		compatible = "mediatek,ddrphy1ao";
		reg = <0 0x10338000 0 0x2000>;
	};

	dramc1_ao@1033a000 {
		compatible = "mediatek,dramc1_ao";
		reg = <0 0x1033a000 0 0x2000>;
	};

	dramc1nao@1033c000 {
		compatible = "mediatek,dramc1nao";
		reg = <0 0x1033c000 0 0x1000>;
	};

	chn1_emi@1033d000 {
		compatible = "mediatek,chn1_emi";
		reg = <0 0x1033d000 0 0x1000>;
	};

	ddrphy2ao@10340000 {
		compatible = "mediatek,ddrphy2ao";
		reg = <0 0x10340000 0 0x2000>;
	};

	dramc2_ao@10342000 {
		compatible = "mediatek,dramc2_ao";
		reg = <0 0x10342000 0 0x2000>;
	};

	dramc2nao@10344000 {
		compatible = "mediatek,dramc2nao";
		reg = <0 0x10344000 0 0x1000>;
	};

	chn2_emi@10345000 {
		compatible = "mediatek,chn2_emi";
		reg = <0 0x10345000 0 0x1000>;
	};

	ddrphy3ao@10348000 {
		compatible = "mediatek,ddrphy3ao";
		reg = <0 0x10348000 0 0x2000>;
	};

	dramc3_ao@1034a000 {
		compatible = "mediatek,dramc3_ao";
		reg = <0 0x1034a000 0 0x2000>;
	};

	dramc3nao@1034c000 {
		compatible = "mediatek,dramc3nao";
		reg = <0 0x1034c000 0 0x1000>;
	};

	chn3_emi@1034d000 {
		compatible = "mediatek,chn3_emi";
		reg = <0 0x1034d000 0 0x1000>;
	};

	ddrphy@10332000 {
		compatible = "mediatek,ddrphy";
		reg = <0 0x10332000 0 0x1000>;
	};

	auxadc: auxadc@10370000 {
		compatible = "mediatek,auxadc";
		reg = <0 0x10370000 0 0x1000>;
		interrupts = <GIC_SPI 390 IRQ_TYPE_EDGE_FALLING>;
		clocks = <&infracfg_ao CLK_INFRA_AUXADC>;
		clock-names = "auxadc-main";
	};

	infracfg@10260000 {
		compatible = "mediatek,infracfg";
		reg = <0 0x10260000 0 0x1000>;
	};

	bus_dbg@10261000 {
		compatible = "mediatek,bus_dbg-v2";
		reg = <0 0x10261000 0 0x1000>;
		interrupts = <GIC_SPI 158 IRQ_TYPE_LEVEL_LOW>;
	};

	infra_mbist@10262000 {
		compatible = "mediatek,infra_mbist";
		reg = <0 0x10262000 0 0x1000>;
	};

	md_ccif0@10700000 {
		compatible = "mediatek,md_ccif0";
		reg = <0 0x10700000 0 0x1000>;
	};

	md_ccif1@10701000 {
		compatible = "mediatek,md_ccif1";
		reg = <0 0x10701000 0 0x1000>;
	};

	md_ccif2@10702000 {
		compatible = "mediatek,md_ccif2";
		reg = <0 0x10702000 0 0x1000>;
	};

	md_ccif3@10703000 {
		compatible = "mediatek,md_ccif3";
		reg = <0 0x10703000 0 0x1000>;
	};

	therm_ctrl@102a0000 {
		compatible = "mediatek,mt6799-therm_ctrl";
		reg = <0 0x102a0000 0 0x1000>;
		interrupts = <GIC_SPI 184 IRQ_TYPE_LEVEL_LOW>;
		clocks = <&infracfg_ao CLK_INFRA_THERM_BCLK>;
		clock-names = "therm-main";
	};

	eem_fsm@102a0000 {
		compatible = "mediatek,eem_fsm";
		reg = <0 0x102a0000 0 0x1000>;
		interrupts = <GIC_SPI 183 IRQ_TYPE_LEVEL_LOW>;
		clocks = <&scpsys SCP_SYS_MFG0>, <&scpsys SCP_SYS_MFG1>, <&scpsys SCP_SYS_MFG2>,
			<&scpsys SCP_SYS_MFG3>;
		clock-names = "mtcmos-mfg-core0", "mtcmos-mfg-core1", "mtcmos-mfg-core2",
				"mtcmos-mfg-core3";
	};

	ap_dma@11000000 {
		compatible = "mediatek,ap_dma";
		reg = <0 0x11000000 0 0x1000>;
		interrupts = <GIC_SPI 124 IRQ_TYPE_LEVEL_LOW>;
	};

	apuart0: apuart0@11020000 {
		cell-index = <0>;
		compatible = "mediatek,mt6735-uart";
		reg = <0 0x11020000 0 0x1000>, /* UART base */
			  <0 0x11000580 0 0x1000>, /* DMA Tx base */
			  <0 0x11000600 0 0x80>; /* DMA Rx base */
		interrupts = <GIC_SPI 92 IRQ_TYPE_LEVEL_LOW>, /* UART IRQ */
				 <GIC_SPI 134 IRQ_TYPE_LEVEL_LOW>, /* DMA Tx IRQ */
				 <GIC_SPI 135 IRQ_TYPE_LEVEL_LOW>; /* DMA Rx IRQ */
		clock-frequency = <26000000>;
		clock-div = <1>;
		clocks = <&pericfg CLK_PERICFG_RG_UART0>, <&pericfg CLK_PERICFG_RG_AP_DM>;
		clock-names = "uart0-main", "uart-apdma";
	};

	apuart1: apuart1@11030000 {
		cell-index = <1>;
		compatible = "mediatek,mt6735-uart";
		reg = <0 0x11030000 0 0x1000>, /* UART base */
			  <0 0x11000680 0 0x80>, /* DMA Tx base */
			  <0 0x11000700 0 0x80>; /* DMA Rx base */
		interrupts = <GIC_SPI 93 IRQ_TYPE_LEVEL_LOW>, /* UART IRQ */
				 <GIC_SPI 136 IRQ_TYPE_LEVEL_LOW>, /* DMA Tx IRQ */
				 <GIC_SPI 137 IRQ_TYPE_LEVEL_LOW>; /* DMA Rx IRQ */
		clock-frequency = <26000000>;
		clock-div = <1>;
		clocks = <&pericfg CLK_PERICFG_RG_UART1>;
		clock-names = "uart1-main";
	};

	pwm@11070000 {
		compatible = "mediatek,pwm";
		reg = <0 0x11070000 0 0x1000>;
		interrupts = <GIC_SPI 77 IRQ_TYPE_LEVEL_LOW>;
			clocks = <&pericfg CLK_PERICFG_RG_PWM_FBCLK1>,
			<&pericfg CLK_PERICFG_RG_PWM_FBCLK2>,
			<&pericfg CLK_PERICFG_RG_PWM_FBCLK3>,
			<&pericfg CLK_PERICFG_RG_PWM_FBCLK4>,
			<&pericfg CLK_PERICFG_RG_PWM_FBCLK5>,
			<&pericfg CLK_PERICFG_RG_PWM_FBCLK6>,
			<&pericfg CLK_PERICFG_RG_PWM_FBCLK7>,
			<&pericfg CLK_PERICFG_RG_PWM_BCLK>;
		clock-names = "PWM1-main",
			"PWM2-main",
			"PWM3-main",
			"PWM4-main",
			"PWM5-main",
			"PWM6-main",
			"PWM7-main",
			"PWM-main";
	};

	i2c0: i2c@11080000 {
		compatible = "mediatek,mt6799-i2c";
		id = <0>;
		reg = <0 0x11080000 0 0x1000>,
			<0 0x11000080 0 0x80>;
		interrupts = <GIC_SPI 84 IRQ_TYPE_LEVEL_LOW>;
		clocks = <&pericfg CLK_PERICFG_RG_I2C0_BCLK>, <&pericfg CLK_PERICFG_RG_AP_DM>;
		clock-names = "main", "dma";
		clock-div = <5>;

		ext_buck_lp4x@50 {
			regulator-name = "ext_buck_lp4x";
			regulator-min-microvolt = <300000>;
			regulator-max-microvolt = <1850000>;
			regulator-always-on;
			//ramp_dly = <64>;
			pin_sel = <1>;
		};
	};

	i2c1: i2c@11090000 {
		compatible = "mediatek,mt6799-i2c";
		id = <1>;
		reg = <0 0x11090000 0 0x1000>,
			<0 0x11000100 0 0x80>;
		interrupts = <GIC_SPI 85 IRQ_TYPE_LEVEL_LOW>;
		clocks = <&pericfg CLK_PERICFG_RG_I2C1_BCLK>, <&pericfg CLK_PERICFG_RG_AP_DM>;
		clock-names = "main", "dma";
		clock-div = <5>;
	};

	i2c2: i2c@111e0000 {
		compatible = "mediatek,mt6799-i2c";
		id = <2>;
		reg = <0 0x111e0000 0 0x1000>,
			<0 0x11000480 0 0x80>;
		interrupts = <GIC_SPI 114 IRQ_TYPE_LEVEL_LOW>;
		clocks = <&pericfg CLK_PERICFG_RG_I2C8_BCLK>, <&pericfg CLK_PERICFG_RG_AP_DM>;
		clock-names = "main", "dma";
		clock-div = <5>;
	};

	i2c3: i2c@111f0000 {
		compatible = "mediatek,mt6799-i2c";
		id = <3>;
		reg = <0 0x111f0000 0 0x1000>,
			<0 0x11000500 0 0x80>;
		interrupts = <GIC_SPI 115 IRQ_TYPE_LEVEL_LOW>;
		clocks = <&pericfg CLK_PERICFG_RG_I2C9_BCLK>, <&pericfg CLK_PERICFG_RG_AP_DM>;
		clock-names = "main", "dma";
		clock-div = <5>;
	};

	i2c4: i2c@110c0000 {
		compatible = "mediatek,mt6799-i2c";
		id = <4>;
		reg = <0 0x110c0000 0 0x1000>,
			<0 0x11000280 0 0x80>;
		interrupts = <GIC_SPI 88 IRQ_TYPE_LEVEL_LOW>;
		clocks = <&pericfg CLK_PERICFG_RG_I2C4_BCLK>, <&pericfg CLK_PERICFG_RG_AP_DM>;
		clock-names = "main", "dma";
		clock-div = <5>;
	};

	i2c5: i2c@110d0000 {
		compatible = "mediatek,mt6799-i2c";
		id = <5>;
		reg = <0 0x110d0000 0 0x1000>,
			<0 0x11000300 0 0x80>;
		interrupts = <GIC_SPI 89 IRQ_TYPE_LEVEL_LOW>;
		clocks = <&pericfg CLK_PERICFG_RG_I2C5_BCLK>, <&pericfg CLK_PERICFG_RG_AP_DM>;
		clock-names = "main", "dma";
		clock-div = <5>;
	};

	i2c6: i2c@110e0000 {
		compatible = "mediatek,mt6799-i2c";
		id = <6>;
		reg = <0 0x110e0000 0 0x1000>,
			<0 0x11000380 0 0x80>;
		interrupts = <GIC_SPI 90 IRQ_TYPE_LEVEL_LOW>;
		clocks = <&pericfg CLK_PERICFG_RG_I2C6_BCLK>, <&pericfg CLK_PERICFG_RG_AP_DM>;
		clock-names = "main", "dma";
		clock-div = <5>;
		mediatek,appm_used;
	};

	i2c7: i2c@11190000 {
		compatible = "mediatek,mt6799-i2c";
		id = <7>;
		reg = <0 0x11190000 0 0x1000>,
			<0 0x11000400 0 0x80>;
		interrupts = <GIC_SPI 91 IRQ_TYPE_LEVEL_LOW>;
		clocks = <&pericfg CLK_PERICFG_RG_I2C7_BCLK>, <&pericfg CLK_PERICFG_RG_AP_DM>;
		clock-names = "main", "dma";
		clock-div = <3>;
	};

	i2c8: i2c@11b80000 {
		compatible = "mediatek,mt6799-i2c";
		id = <8>;
		reg = <0 0x11b80000 0 0x1000>,
			<0 0x11000180 0 0x80>;
		interrupts = <GIC_SPI 86 IRQ_TYPE_LEVEL_LOW>;
		clocks = <&pericfg CLK_PERICFG_RG_I2C2_BCLK>, <&pericfg CLK_PERICFG_RG_AP_DM>;
		clock-names = "main", "dma";
		clock-div = <5>;
		mediatek,buffermode_used;
	};

	i2c9: i2c@11100000 {
		compatible = "mediatek,mt6799-i2c";
		id = <9>;
		reg = <0 0x11100000 0 0x1000>,
			<0 0x11000200 0 0x80>;
		interrupts = <GIC_SPI 87 IRQ_TYPE_LEVEL_LOW>;
		clocks = <&pericfg CLK_PERICFG_RG_I2C3_BCLK>, <&pericfg CLK_PERICFG_RG_AP_DM>;
		clock-names = "main", "dma";
		clock-div = <5>;
		mediatek,buffermode_used;
	};

	disppwm0@11140000 {
		compatible = "mediatek,disppwm0";
		reg = <0 0x11140000 0 0x1000>;
		interrupts = <GIC_SPI 74 IRQ_TYPE_LEVEL_LOW>;
	};

	disppwm1@11150000 {
		compatible = "mediatek,disppwm1";
		reg = <0 0x11150000 0 0x1000>;
		interrupts = <GIC_SPI 99 IRQ_TYPE_LEVEL_LOW>;
	};

	spi0: spi@110f0000 {
		compatible = "mediatek,mt6799-spi";
		cell-index = <0>;
		spi-padmacro = <0>;
		reg = <0 0x110f0000 0 0x1000>;
		interrupts = <GIC_SPI 100 IRQ_TYPE_LEVEL_LOW>;
		clocks = <&pericfg CLK_PERICFG_RG_SPI0>;
		clock-names = "main";
		clock-frequency = <109000000>;
		clock-div = <1>;
	};

	spi1: spi@11160000 {
		compatible = "mediatek,mt6799-spi";
		cell-index = <1>;
		spi-padmacro = <0>;
		reg = <0 0x11160000 0 0x1000>;
		interrupts = <GIC_SPI 101 IRQ_TYPE_LEVEL_LOW>;
		clocks = <&pericfg CLK_PERICFG_RG_SPI1>;
		clock-names = "main";
		clock-frequency = <109000000>;
		clock-div = <1>;
	};

	spi2: spi@11170000 {
		compatible = "mediatek,mt6799-spi";
		cell-index = <2>;
		spi-padmacro = <0>;
		reg = <0 0x11170000 0 0x1000>;
		interrupts = <GIC_SPI 102 IRQ_TYPE_LEVEL_LOW>;
		clocks = <&pericfg CLK_PERICFG_RG_SPI2>;
		clock-names = "main";
		clock-frequency = <109000000>;
		clock-div = <1>;
	};

	spi3: spi@111b0000 {
		compatible = "mediatek,mt6799-spi";
		cell-index = <3>;
		spi-padmacro = <0>;
		reg = <0 0x111b0000 0 0x1000>;
		interrupts = <GIC_SPI 103 IRQ_TYPE_LEVEL_LOW>;
		clocks = <&pericfg CLK_PERICFG_RG_SPI3>;
		clock-names = "main";
		clock-frequency = <109000000>;
		clock-div = <1>;
	};

	spi4: spi@111c0000 {
		compatible = "mediatek,mt6799-spi";
		cell-index = <4>;
		spi-padmacro = <0>;
		reg = <0 0x111c0000 0 0x1000>;
		interrupts = <GIC_SPI 104 IRQ_TYPE_LEVEL_LOW>;
		clocks = <&pericfg CLK_PERICFG_RG_SPI4>;
		clock-names = "main";
		clock-frequency = <109000000>;
		clock-div = <1>;
	};

	spi5: spi@111d0000 {
		compatible = "mediatek,mt6799-spi";
		cell-index = <5>;
		spi-padmacro = <0>;
		reg = <0 0x111d0000 0 0x1000>;
		interrupts = <GIC_SPI 105 IRQ_TYPE_LEVEL_LOW>;
		clocks = <&pericfg CLK_PERICFG_RG_SPI5>;
		clock-names = "main";
		clock-frequency = <109000000>;
		clock-div = <1>;
	};

	spi6: spi@110b0000 {
		compatible = "mediatek,mt6799-spi";
		cell-index = <6>;
		spi-padmacro = <0>;
		reg = <0 0x110b0000 0 0x1000>;
		interrupts = <GIC_SPI 106 IRQ_TYPE_LEVEL_LOW>;
		clocks = <&pericfg CLK_PERICFG_RG_SPI6>;
		clock-names = "main";
		clock-frequency = <109000000>;
		clock-div = <1>;
	};

	spi7: spi@11130000 {
		compatible = "mediatek,mt6799-spi";
		cell-index = <7>;
		spi-padmacro = <0>;
		reg = <0 0x11130000 0 0x1000>;
		interrupts = <GIC_SPI 107 IRQ_TYPE_LEVEL_LOW>;
		clocks = <&pericfg CLK_PERICFG_RG_SPI7>;
		clock-names = "main";
		clock-frequency = <109000000>;
		clock-div = <1>;
	};

	spi8: spi@11110000 {
		compatible = "mediatek,mt6799-spi";
		cell-index = <8>;
		spi-padmacro = <0>;
		reg = <0 0x11110000 0 0x1000>;
		interrupts = <GIC_SPI 112 IRQ_TYPE_LEVEL_LOW>;
		clocks = <&pericfg CLK_PERICFG_RG_SPI8>;
		clock-names = "main";
		clock-frequency = <109000000>;
		clock-div = <1>;
	};

	spi9: spi@11b60000 {
		compatible = "mediatek,mt6799-spi";
		cell-index = <9>;
		spi-padmacro = <0>;
		reg = <0 0x11b60000 0 0x1000>;
		interrupts = <GIC_SPI 113 IRQ_TYPE_LEVEL_LOW>;
		clocks = <&pericfg CLK_PERICFG_RG_SPI9>;
		clock-names = "main";
		clock-frequency = <109000000>;
		clock-div = <1>;

		#address-cells = <1>;
		#size-cells = <0>;

		isl91302a@1 {
			compatible = "mediatek,isl91302a";
			spi-max-frequency = <1000000>;
			reg = <1>;
		};
	};

	peri_mbist@11ac0000 {
		compatible = "mediatek,peri_mbist";
		reg = <0 0x11ac0000 0 0x1000>;
	};

	fdeaes@11b40000 {
		compatible = "mediatek,fdeaes";
		reg = <0 0x11b40000 0 0x1000>;
	};

	pmdbg1@11ae0000 {
		compatible = "mediatek,pmdbg1";
		reg = <0 0x11ae0000 0 0x1000>;
	};

	pmdbg2@11ae1000 {
		compatible = "mediatek,pmdbg2";
		reg = <0 0x11ae1000 0 0x1000>;
	};

	irtx@11120000 {
		compatible = "mediatek,irtx";
		reg = <0 0x11120000 0 0x1000>;
		interrupts = <GIC_SPI 116 IRQ_TYPE_LEVEL_HIGH>;
	};

	devapc_ao_peri@111a0000 {
		compatible = "mediatek,devapc_ao_peri";
		reg = <0 0x111a0000 0 0x1000>;
	};

	spi_nor_ext@19800000 {
		compatible = "mediatek,spi_nor_ext";
		reg = <0 0x19800000 0 0x1000>;
	};

	flashif@11ab0000 {
		compatible = "mediatek,flashif";
		reg = <0 0x11ab0000 0 0x1000>;
	};

	usbphy0:usbphy@0 {
			compatible = "usb-nop-xceiv";
	};

	usb0:usb3@11200000 {
		 compatible = "mediatek,usb3";
		 reg = <0 0x11200000 0 0x10000>, <0 0x112A0000 0 0x10000>, <0 0x11C30000 0 0x10000>;
		 reg-names = "ssusb_base", "ssusb_sif", "ssusb_sif2";
		 interrupts = <GIC_SPI 111 IRQ_TYPE_LEVEL_LOW>, <GIC_SPI 110 IRQ_TYPE_LEVEL_LOW>;
		 interrupt-names = "musb-hdrc", "xhci";
		 debug_level = <6>;
		 fgpa_i2c_physical_base = <0x111E0000>;
	};

	usb3_phy {
		 compatible = "mediatek,usb3_phy";
		 clocks = <&pericfg CLK_PERICFG_RG_USB_P0>;
		 clock-names = "ssusb_clk";
	};

	xhci0:usb3_xhci@11200000 {
		compatible = "mediatek,mt67xx-xhci";
		reg = <0 0x11200000 0 0x10000>, <0 0x112A0700 0 0x100>;
		reg-names = "ssusb_base", "ssusb_ippc";
		interrupts = <GIC_SPI 110 IRQ_TYPE_LEVEL_LOW>;
		interrupt-names = "xhci";
	};

	usb1@11210000 {
		compatible = "mediatek,usb1";
		reg = <0 0x11210000 0 0x1000>;
		interrupts = <GIC_SPI 73 IRQ_TYPE_LEVEL_LOW>;
	};

	msdc_top@11d60000 {
		compatible = "mediatek,msdc_top";
		reg = <0 0x11d60000 0 0x1000>;
	};

	accdet: accdet@ {
		compatible = "mediatek,pmic-accdet";
	};
	audio: audio@10c00000 {
		compatible = "mediatek,audio", "syscon";
		reg = <0 0x10c00000 0 0x1000>;
		interrupts = <GIC_SPI 175 IRQ_TYPE_LEVEL_LOW>;
		#clock-cells = <1>;
	};

	audio_sram@10c01000 {
		compatible = "mediatek,audio_sram";
		reg = <0 0x10c01000 0 0xff00>;
	};

	audgpio: mt_soc_dl1_pcm@10c00000 {
		compatible = "mediatek,mt_soc_pcm_dl1";
		reg = <0 0x10c00000 0 0x1000>;
		interrupts = <GIC_SPI 175 IRQ_TYPE_LEVEL_LOW>;
		clocks = <&audio CLK_AUDIO_AFE>,
			<&audio CLK_AUDIO_DAC>,
			<&audio CLK_AUDIO_DAC_PREDIS>,
			<&audio CLK_AUDIO_ADC>,
			<&audio CLK_AUDIO_ADDA6_ADC>,
			<&audio CLK_AUDIO_22M>,
			<&audio CLK_AUDIO_24M>,
			<&audio CLK_AUDIO_APLL_TUNER>,
			<&audio CLK_AUDIO_APLL2_TUNER>,
			<&audio CLK_AUDIO_TML>,
			<&audio CLK_AUDIO_ADC_HIRES>,
			<&audio CLK_AUDIO_ADDA6_ADC_HIRES>,
			<&audio CLK_AUDIO_ADC_HIRES_TML>,
			<&scpsys SCP_SYS_AUDIO>,
			<&infracfg_ao CLK_INFRA_AUDIO>,
			<&infracfg_ao CLK_INFRA_ANC_MD32>,
			<&topckgen CLK_TOP_AUDIO_SEL>,
			<&topckgen CLK_TOP_SYSPLL3_D4>,
			<&topckgen CLK_TOP_AUD_INTBUS_SEL>,
			<&topckgen CLK_TOP_SYSPLL1_D4>,
			<&topckgen CLK_TOP_ANCMD32_SEL>,
			<&topckgen CLK_TOP_SYSPLL1_D2>,
			<&clk26m>;
		clock-names = "aud_afe_clk",
			"aud_dac_clk",
			"aud_dac_predis_clk",
			"aud_adc_clk",
			"aud_adda6_adc_clk",
			"aud_apll22m_clk",
			"aud_apll24m_clk",
			"aud_apll1_tuner_clk",
			"aud_apll2_tuner_clk",
			"aud_tml_clk",
			"aud_adc_hires_clk",
			"aud_adda6_adc_hires_clk",
			"aud_adc_hires_tml_clk",
			"scp_sys_audio",
			"aud_infra_clk",
			"aud_infra_anc_md32",
			"top_mux_audio",
			"top_sys_pll3_d4",
			"top_mux_audio_int",
			"top_sys_pll1_d4",
			"top_mux_anc_md32",
			"top_sys_pll1_d2",
			"top_clk26m_clk";
	};

	mt_soc_ul1_pcm {
		compatible = "mediatek,mt_soc_pcm_capture";
	};

	mt_soc_voice_md1 {
		compatible = "mediatek,mt_soc_pcm_voice_md1";
	};

	mt_soc_hdmi_pcm {
		compatible = "mediatek,mt_soc_pcm_hdmi";
	};

	mt_soc_uldlloopback_pcm {
		compatible = "mediatek,mt_soc_pcm_uldlloopback";
	};

	mt_soc_i2s0_pcm {
		compatible = "mediatek,mt_soc_pcm_dl1_i2s0";
	};

	mt_soc_mrgrx_pcm {
		compatible = "mediatek,mt_soc_pcm_mrgrx";
	};

	mt_soc_mrgrx_awb_pcm {
		compatible = "mediatek,mt_soc_pcm_mrgrx_awb";
	};

	mt_soc_fm_i2s_pcm {
		compatible = "mediatek,mt_soc_pcm_fm_i2s";
	};

	mt_soc_fm_i2s_awb_pcm {
		compatible = "mediatek,mt_soc_pcm_fm_i2s_awb";
	};

	mt_soc_i2s0dl1_pcm {
		compatible = "mediatek,mt_soc_pcm_dl1_i2s0dl1";
	};

	mt_soc_dl1_awb_pcm {
		compatible = "mediatek,mt_soc_pcm_dl1_awb";
	};

	mt_soc_voice_md1_bt {
		compatible = "mediatek,mt_soc_pcm_voice_md1_bt";
	};

	mt_soc_voip_bt_out {
		compatible = "mediatek,mt_soc_pcm_dl1_bt";
	};

	mt_soc_voip_bt_in {
		compatible = "mediatek,mt_soc_pcm_bt_dai";
	};

	mt_soc_tdmrx_pcm {
		compatible = "mediatek,mt_soc_tdm_capture";
	};

	mt_soc_fm_mrgtx_pcm {
		compatible = "mediatek,mt_soc_pcm_fmtx";
	};

	mt_soc_ul2_pcm {
		compatible = "mediatek,mt_soc_pcm_capture2";
	};

	mt_soc_i2s0_awb_pcm {
		compatible = "mediatek,mt_soc_pcm_i2s0_awb";
	};

	mt_soc_voice_md2 {
		compatible = "mediatek,mt_soc_pcm_voice_md2";
	};

	mt_soc_routing_pcm {
		compatible = "mediatek,mt_soc_pcm_routing";
		/*
		 * i2s1clk-gpio = <7 6>;
		 * i2s1dat-gpio = <5 6>;
		 * i2s1mclk-gpio = <9 6>;
		 * i2s1ws-gpio = <6 6>;
		 */
	};

	mt_soc_voice_md2_bt {
		compatible = "mediatek,mt_soc_pcm_voice_md2_bt";
	};

	mt_soc_hp_impedance_pcm {
		compatible = "mediatek,mt_soc_pcm_hp_impedance";
	};

	mt_soc_codec_name {
		compatible = "mediatek,mt_soc_codec_63xx";
		use_low_power_mode = <0>; /* select 1: low power, 0: hifi */
	};

	mt_soc_dummy_pcm {
		compatible = "mediatek,mt_soc_pcm_dummy";
	};

	mt_soc_codec_dummy_name {
		compatible = "mediatek,mt_soc_codec_dummy";
	};

	mt_soc_routing_dai_name {
		compatible = "mediatek,mt_soc_dai_routing";
	};

	mt_soc_dai_name {
		compatible = "mediatek,mt_soc_dai_stub";
	};

	mt_soc_dl2_pcm {
		compatible = "mediatek,mt_soc_pcm_dl2";
	};

	mt_soc_anc_pcm {
		compatible = "mediatek,mt_soc_pcm_anc";
	};

	mt_soc_pcm_voice_ultra {
		compatible = "mediatek,mt_soc_pcm_voice_ultra";
	};

	mt_soc_pcm_voice_usb {
		compatible = "mediatek,mt_soc_pcm_voice_usb";
	};

	mt_soc_pcm_voice_usb_echoref {
		compatible = "mediatek,mt_soc_pcm_voice_usb_echoref";
	};

	md32_anc@10b30000 {
		compatible = "mediatek,md32_anc";
		reg = <0 0x10b30000 0 0x1000>;
	};

	sw_mst@10c18000 {
		compatible = "mediatek,sw_mst";
		reg = <0 0x10c18000 0 0x1000>;
	};

	usb3_sif@112a0000 {
		compatible = "mediatek,usb3_sif";
		reg = <0 0x112a0000 0 0x1000>;
	};

	usb20_phy@11c40000 {
		compatible = "mediatek,usb20_phy";
		reg = <0 0x11c40000 0 0x1000>;
	};

	mipi_tx0@11cc0000 {
		compatible = "mediatek,mipi_tx0";
		reg = <0 0x11cc0000 0 0x1000>;
	};

	mipi_tx1@11cd0000 {
		compatible = "mediatek,mipi_tx1";
		reg = <0 0x11cd0000 0 0x1000>;
	};

	pcie_phy: pcie-phy@11e20000 {
		compatible = "mediatek,a60931";
		reg = <0 0x11e20000 0 0x1000>;
		#phy-cells = <1>;
	};

	pcie@193f0000 {
		compatible = "mediatek,pcie";
		device_type = "pci";
		reg = <0 0x193f0000 0 0x2000>;
		interrupts = <GIC_SPI 117 IRQ_TYPE_LEVEL_LOW>;
		bus-range = <0x00 0xff>;

		#address-cells = <3>;
		#size-cells = <2>;
		ranges = <0x82000000 0 0x19400000 0x0 0x19400000 0 0x00400000>;

		phys = <&pcie_phy 1>;
		phy-names = "pcie-phy";

		clocks = <&topckgen CLK_TOP_PCIE_MAC_SEL>,
			<&pericfg CLK_PERICFG_RG_MPCIE_P0>,
			<&pericfg CLK_PERICFG_RG_MPCIE_P0_OBFF_CLK>,
			<&pericfg CLK_PERICFG_RG_MPCIE_P0_AUX_CLK>,
			<&pericfg CLK_PERICFG_RG_MPCIE_P1>;
		clock-names = "pcie-mac","mpcie-p0","mpcie-obff","mpcie-aux","mpcie-p1";

		pcie0: pcie@1,0 {
			device_type = "pci";
			assigned-addresses = <0x82000800 0 0x19400000 0 0x400000>; /* non-prefetchable memory 4MB */
			reg = <0x0800 0 0 0 0>;
			#address-cells = <3>;
			#size-cells = <2>;
			#interrupt-cells = <1>;

			ranges;
			interrupt-map-mask = <0 0 0 7>;
			interrupt-map = <0 0 0 1 &pcie_intc1 1>,
					<0 0 0 2 &pcie_intc1 2>,
					<0 0 0 3 &pcie_intc1 3>,
					<0 0 0 4 &pcie_intc1 4>;
			pcie-port = <0>;
			num-lanes = <1>;
			status = "okay";

			pcie_intc1: interrupt-controller {
				interrupt-controller;
				#address-cells = <0>;
				#interrupt-cells = <1>;
			};
		};
	};

	efusec@11f10000 {
		compatible = "mediatek,efusec";
		reg = <0 0x11f10000 0 0x1000>;
	};

	efuse_sram_repair_rx@11f20000 {
		compatible = "mediatek,efuse_sram_repair_rx";
		reg = <0 0x11f20000 0 0x1000>;
	};

	idvfsapb@11ab0000 {
		compatible = "mediatek,idvfsapb";
		reg = <0 0x11ab0000 0 0x1000>;
	};

	ca9peri@10e00000 {
		compatible = "mediatek,ca9peri";
		reg = <0 0x10e00000 0 0x1000>;
	};

	l2c@10f00000 {
		compatible = "mediatek,l2c";
		reg = <0 0x10f00000 0 0x1000>;
	};

	smi_4x1_inst1@11b50000 {
		compatible = "mediatek,smi_4x1_inst1";
		reg = <0 0x11b50000 0 0x1000>;
	};

	smi_4x1_inst2@11b51000 {
		compatible = "mediatek,smi_4x1_inst2";
		reg = <0 0x11b51000 0 0x1000>;
	};

	mfg_dvfs_mon@13ffb000 {
		compatible = "mediatek,mfg_dvfs_mon";
		reg = <0 0x13ffb000 0 0x1000>;
	};

	mfg_cfg: mfg_cfg@13ffe000 {
		compatible = "mediatek,mt6799-mfg_cfg", "syscon";
		reg = <0 0x13ffe000 0 0x1000>;
		#clock-cells = <1>;
	};

	mfg_dfp_59@13fff000 {
		compatible = "mediatek,mfg_dfp_59";
		reg = <0 0x13fff000 0 0x1000>;
	};

	mfg_austin@13000000 {
		compatible = "mediatek,AUSTIN";
		reg = <0 0x13000000 0 0x80000>;
		interrupts = <GIC_SPI 336 IRQ_TYPE_LEVEL_LOW>;
		interrupt-names = "RGX";
		clock-frequency = <500000000>;
		clocks = <&mfg_cfg CLK_MFG_CFG_BAXI>, <&mfg_cfg CLK_MFG_CFG_BMEM>,
			<&mfg_cfg CLK_MFG_CFG_BG3D>, <&mfg_cfg CLK_MFG_CFG_B26M>,
			<&scpsys SCP_SYS_MFG0>,
			<&scpsys SCP_SYS_MFG1>,
			<&scpsys SCP_SYS_MFG2>,
			<&scpsys SCP_SYS_MFG3>;
		clock-names = "mfg-clk-baxi", "mfg-clk-bmem",
			"mfg-clk-bg3d", "mfg-clk-b26m",
			"mtcmos-mfg0",
			"mtcmos-mfg1",
			"mtcmos-mfg2",
			"mtcmos-mfg3";
	};

	gpufreq {
		compatible = "mediatek,mt6799-gpufreq";
	};

	mmsys_config: mmsys_config@14000000 {
		compatible = "mediatek,mt6799-mmsys_config", "syscon";
		reg = <0 0x14000000 0 0x1000>;
		interrupts = <GIC_SPI 275 IRQ_TYPE_LEVEL_LOW>;
		#clock-cells = <1>;
		clocks = <&mmsys_config CLK_MM_CG0_B0>;
		clock-names = "CAM_MDP";
	};

	mdp_rdma0@14001000 {
		compatible = "mediatek,mdp_rdma0";
		reg = <0 0x14001000 0 0x1000>;
		interrupts = <GIC_SPI 237 IRQ_TYPE_LEVEL_LOW>;
		clocks = <&mmsys_config CLK_MM_CG0_B1>;
		clock-names = "MDP_RDMA0";
	};

	mdp_rdma1@14002000 {
		compatible = "mediatek,mdp_rdma1";
		reg = <0 0x14002000 0 0x1000>;
		interrupts = <GIC_SPI 238 IRQ_TYPE_LEVEL_LOW>;
		clocks = <&mmsys_config CLK_MM_CG0_B2>;
		clock-names = "MDP_RDMA1";
	};

	mdp_rsz0@14003000 {
		compatible = "mediatek,mdp_rsz0";
		reg = <0 0x14003000 0 0x1000>;
		interrupts = <GIC_SPI 239 IRQ_TYPE_LEVEL_LOW>;
		clocks = <&mmsys_config CLK_MM_CG0_B3>;
		clock-names = "MDP_RSZ0";
	};

	mdp_rsz1@14004000 {
		compatible = "mediatek,mdp_rsz1";
		reg = <0 0x14004000 0 0x1000>;
		interrupts = <GIC_SPI 240 IRQ_TYPE_LEVEL_LOW>;
		clocks = <&mmsys_config CLK_MM_CG0_B4>;
		clock-names = "MDP_RSZ1";
	};

	mdp_rsz2@14005000 {
		compatible = "mediatek,mdp_rsz2";
		reg = <0 0x14005000 0 0x1000>;
		interrupts = <GIC_SPI 241 IRQ_TYPE_LEVEL_LOW>;
		clocks = <&mmsys_config CLK_MM_CG0_B5>;
		clock-names = "MDP_RSZ2";
	};

	mdp_wdma@14006000 {
		compatible = "mediatek,mdp_wdma";
		reg = <0 0x14006000 0 0x1000>;
		interrupts = <GIC_SPI 244 IRQ_TYPE_LEVEL_LOW>;
		clocks = <&mmsys_config CLK_MM_CG0_B8>;
		clock-names = "MDP_WDMA";
	};

	mdp_wrot0@14007000 {
		compatible = "mediatek,mdp_wrot0";
		reg = <0 0x14007000 0 0x1000>;
		interrupts = <GIC_SPI 245 IRQ_TYPE_LEVEL_LOW>;
		clocks = <&mmsys_config CLK_MM_CG0_B9>;
		clock-names = "MDP_WROT0";
	};

	mdp_wrot1@14008000 {
		compatible = "mediatek,mdp_wrot1";
		reg = <0 0x14008000 0 0x1000>;
		interrupts = <GIC_SPI 246 IRQ_TYPE_LEVEL_LOW>;
		clocks = <&mmsys_config CLK_MM_CG0_B10>;
		clock-names = "MDP_WROT1";
	};

	mdp_tdshp@14009000 {
		compatible = "mediatek,mdp_tdshp";
		reg = <0 0x14009000 0 0x1000>;
		interrupts = <GIC_SPI 242 IRQ_TYPE_LEVEL_LOW>;
		clocks = <&mmsys_config CLK_MM_CG0_B6>;
		clock-names = "MDP_TDSHP";
	};

	mdp_color@1400a000 {
		compatible = "mediatek,mdp_color";
		reg = <0 0x1400a000 0 0x1000>;
		interrupts = <GIC_SPI 243 IRQ_TYPE_LEVEL_LOW>;
		clocks = <&mmsys_config CLK_MM_CG0_B7>;
		clock-names = "MDP_COLOR";
	};

	mtkfb: mtkfb@0 {
		compatible = "mediatek,mtkfb";
	};

	dispsys: dispsys@14000000 {
		 compatible = "mediatek,dispsys";
		 reg = <0 0x14000000 0 0x1000>,  /*disp_sys		*/
		     <0 0x1400b000 0 0x1000>,  /*disp_ovl0		*/
		     <0 0x1400c000 0 0x1000>,  /*disp_ovl1		*/
		     <0 0x1400d000 0 0x1000>,  /*disp_ovl0_2l	*/
		     <0 0x1400e000 0 0x1000>,  /*disp_ovl1_2l	*/
		     <0 0x1400f000 0 0x1000>,  /*disp_rdma0	*/
		     <0 0x14010000 0 0x1000>,  /*disp_rdma1	*/
		     <0 0x14011000 0 0x1000>,  /*disp_rdma2	*/
		     <0 0x14012000 0 0x1000>,  /*disp_wdma0	*/
		     <0 0x14013000 0 0x1000>,  /*disp_wdma1	*/
		     <0 0x14014000 0 0x1000>,  /*disp_color0	*/
		     <0 0x14015000 0 0x1000>,  /*disp_color1	*/
		     <0 0x14016000 0 0x1000>,  /*disp_ccorr0	*/
		     <0 0x14017000 0 0x1000>,  /*disp_ccorr1	*/
		     <0 0x14018000 0 0x1000>,  /*disp_aal0		*/
		     <0 0x14019000 0 0x1000>,  /*disp_aal1		*/
		     <0 0x1401a000 0 0x1000>,  /*disp_gamma0	*/
		     <0 0x1401b000 0 0x1000>,  /*disp_gamma1	*/
		     <0 0x1401c000 0 0x1000>,  /*disp_od		*/
		     <0 0x1401d000 0 0x1000>,  /*disp_dither0	*/
		     <0 0x1401e000 0 0x1000>,  /*disp_dither1	*/
		     <0 0x1401f000 0 0x1000>,  /*disp_ufoe	*/
		     <0 0x14020000 0 0x1000>,  /*disp_dsc	*/
		     <0 0x14020400 0 0x1000>,  /*disp_dsc_2nd	*/
		     <0 0x14021000 0 0x1000>,  /*disp_split	*/
		     <0 0x14022000 0 0x1000>,  /*disp_dsi0	*/
		     <0 0x14023000 0 0x1000>,  /*disp_dsi1	*/
		     <0 0x14024000 0 0x1000>,  /*disp_dpi0	*/
		     <0 0x11140000 0 0x1000>,  /*disp_pwm0	*/
		     <0 0x11150000 0 0x1000>,  /*disp_pwm1	*/
		     <0 0x14025000 0 0x1000>,  /*disp_mm_mutex	*/
		     <0 0x14026000 0 0x1000>,  /*disp_smi_larb0	*/
		     <0 0x14027000 0 0x1000>,  /*disp_smi_larb1	*/
		     <0 0x14028000 0 0x1000>,  /*disp_smi_commom	*/
		     <0 0x1402b000 0 0x1000>,  /*disp_rsz0	*/
		     <0 0x1402c000 0 0x1000>,  /*disp_rsz1	*/
		     <0 0x11cc0000 0 0x1000>,  /*mipitx0 */
		     <0 0x11cd0000 0 0x1000>,  /*mipitx1 */
		     <0 0x10210000 0 0x1000>;  /*clock_mux */

		 interrupts = <GIC_SPI 0 IRQ_TYPE_LEVEL_LOW>, /*disp_sys */
			    <GIC_SPI 247 IRQ_TYPE_LEVEL_LOW>,  /*disp_ovl0		*/
			    <GIC_SPI 248 IRQ_TYPE_LEVEL_LOW>,  /*disp_ovl1		*/
			    <GIC_SPI 249 IRQ_TYPE_LEVEL_LOW>,  /*disp_ovl0_2l	*/
			    <GIC_SPI 250 IRQ_TYPE_LEVEL_LOW>,  /*disp_ovl1_2l	*/
			    <GIC_SPI 251 IRQ_TYPE_LEVEL_LOW>,  /*disp_rdma0	*/
			    <GIC_SPI 252 IRQ_TYPE_LEVEL_LOW>,  /*disp_rdma1	*/
			    <GIC_SPI 253 IRQ_TYPE_LEVEL_LOW>,  /*disp_rdma2	*/
			    <GIC_SPI 254 IRQ_TYPE_LEVEL_LOW>,  /*disp_wdma0	*/
			    <GIC_SPI 255 IRQ_TYPE_LEVEL_LOW>,  /*disp_wdma1	*/
			    <GIC_SPI 256 IRQ_TYPE_LEVEL_LOW>,  /*disp_color0	*/
			    <GIC_SPI 257 IRQ_TYPE_LEVEL_LOW>,  /*disp_color1	*/
			    <GIC_SPI 258 IRQ_TYPE_LEVEL_LOW>,  /*disp_ccorr0	*/
			    <GIC_SPI 259 IRQ_TYPE_LEVEL_LOW>,  /*disp_ccorr1	*/
			    <GIC_SPI 260 IRQ_TYPE_LEVEL_LOW>,  /*disp_aal0		*/
			    <GIC_SPI 261 IRQ_TYPE_LEVEL_LOW>,  /*disp_aal1		*/
			    <GIC_SPI 262 IRQ_TYPE_LEVEL_LOW>,  /*disp_gamma0	*/
			    <GIC_SPI 263 IRQ_TYPE_LEVEL_LOW>,  /*disp_gamma1	*/
			    <GIC_SPI 264 IRQ_TYPE_LEVEL_LOW>,  /*disp_od		*/
			    <GIC_SPI 265 IRQ_TYPE_LEVEL_LOW>,  /*disp_dither0	*/
			    <GIC_SPI 266 IRQ_TYPE_LEVEL_LOW>,  /*disp_dither1	*/
			    <GIC_SPI 267 IRQ_TYPE_LEVEL_LOW>,  /*disp_ufoe	*/
			    <GIC_SPI 268 IRQ_TYPE_LEVEL_LOW>,  /*disp_dsc	*/
			    <GIC_SPI 269 IRQ_TYPE_LEVEL_LOW>,  /*disp_dsc_2nd	*/
			    <GIC_SPI 0 IRQ_TYPE_LEVEL_LOW>,  /*disp_split	*/
			    <GIC_SPI 270 IRQ_TYPE_LEVEL_LOW>,  /*disp_dsi0	*/
			    <GIC_SPI 271 IRQ_TYPE_LEVEL_LOW>,  /*disp_dsi1	*/
			    <GIC_SPI 272 IRQ_TYPE_LEVEL_LOW>,  /*disp_dpi0	*/
			    <GIC_SPI 0 IRQ_TYPE_LEVEL_LOW>,  /*disp_pwm0	*/
			    <GIC_SPI 0 IRQ_TYPE_LEVEL_LOW>,  /*disp_pwm1	*/
			    <GIC_SPI 236 IRQ_TYPE_LEVEL_LOW>,  /*disp_mm_mutex	*/
			    <GIC_SPI 276 IRQ_TYPE_LEVEL_LOW>,  /*disp_smi_larb0	*/
			    <GIC_SPI 277 IRQ_TYPE_LEVEL_LOW>,  /*disp_smi_larb1	*/
			    <GIC_SPI 0 IRQ_TYPE_LEVEL_LOW>,  /*disp_smi_commom	*/
			    <GIC_SPI 273 IRQ_TYPE_LEVEL_LOW>,  /*disp_rsz0	*/
			    <GIC_SPI 274 IRQ_TYPE_LEVEL_LOW>,  /*disp_rsz1	*/
			    <GIC_SPI 0 IRQ_TYPE_LEVEL_LOW>,  /*mipitx0 */
			    <GIC_SPI 0 IRQ_TYPE_LEVEL_LOW>;  /*mipitx1 */

		clocks = <&scpsys SCP_SYS_MM0>, /*DISP_MTCMOS_CLK*/
			<&mmsys_config CLK_MM_CG2_B11>, /*DISP_SMI_COMMON*/
			<&mmsys_config CLK_MM_CG2_B12>, /*DISP_SMI_COMMON_2X*/
			<&mmsys_config CLK_MM_CG1_B12>, /*GALS_M0_2X*/
			<&mmsys_config CLK_MM_CG1_B13>, /*GALS_M1_2X*/
			<&mmsys_config CLK_MM_CG1_B14>, /*UPSZ0*/
			<&mmsys_config CLK_MM_CG1_B15>, /*UPSZ1*/
			<&mmsys_config CLK_MM_CG1_B16>, /*FIFO0*/
			<&mmsys_config CLK_MM_CG1_B17>, /*FIFO1*/
			<&mmsys_config CLK_MM_CG2_B9>, /*DISP_SMI_LARB0*/
			<&mmsys_config CLK_MM_CG2_B10>, /*DISP_SMI_LARB1*/
			<&mmsys_config CLK_MM_CG0_B11>, /*DISP_OVL0*/
			<&mmsys_config CLK_MM_CG0_B12>, /*DISP_OVL1*/
			<&mmsys_config CLK_MM_CG0_B13>, /*DISP_OVL0_2L*/
			<&mmsys_config CLK_MM_CG0_B14>, /*DISP_OVL1_2L*/
			<&mmsys_config CLK_MM_CG0_B15>, /*DISP_RDMA0*/
			<&mmsys_config CLK_MM_CG0_B16>, /*DISP_RDMA1*/
			<&mmsys_config CLK_MM_CG0_B17>, /*DISP_RDMA2*/
			<&mmsys_config CLK_MM_CG0_B18>, /*DISP_WDMA0*/
			<&mmsys_config CLK_MM_CG0_B19>, /*DISP_WDMA1*/
			<&mmsys_config CLK_MM_CG0_B20>, /*DISP_COLOR0*/
			<&mmsys_config CLK_MM_CG0_B21>, /*DISP_COLOR1*/
			<&mmsys_config CLK_MM_CG0_B22>, /*DISP_CCORR0*/
			<&mmsys_config CLK_MM_CG0_B23>, /*DISP_CCORR1*/
			<&mmsys_config CLK_MM_CG0_B24>, /*DISP_AAL0*/
			<&mmsys_config CLK_MM_CG0_B25>, /*DISP_AAL1*/
			<&mmsys_config CLK_MM_CG0_B26>, /*DISP_GAMMA0*/
			<&mmsys_config CLK_MM_CG0_B27>, /*DISP_GAMMA1*/
			<&mmsys_config CLK_MM_CG0_B28>, /*DISP_OD*/
			<&mmsys_config CLK_MM_CG0_B29>, /*DISP_DITHER0*/
			<&mmsys_config CLK_MM_CG0_B30>, /*DISP_DITHER1*/
			<&mmsys_config CLK_MM_CG0_B31>, /*DISP_UFOE*/

			<&mmsys_config CLK_MM_CG1_B0>, /*DISP_DPI_INTERFACE_CLOCK*/
			<&mmsys_config CLK_MM_CG1_B1>, /*DISP_DSC*/
			<&mmsys_config CLK_MM_CG1_B2>, /*DISP_SPLIT*/
			<&mmsys_config CLK_MM_CG1_B3>, /*DISP_OVL0_MOUT*/
			<&mmsys_config CLK_MM_CG1_B4>, /*DISP_RSZ0*/
			<&mmsys_config CLK_MM_CG1_B5>, /*DISP_RSZ1*/

			<&mmsys_config CLK_MM_CG2_B0>, /*DISP_DSI0_MM_CLOCK*/
			<&mmsys_config CLK_MM_CG2_B1>, /*DISP_DSI0_INTERFACE_CLOCK*/
			<&mmsys_config CLK_MM_CG2_B2>, /*DISP_DSI1_MM_CLOCK*/
			<&mmsys_config CLK_MM_CG2_B3>, /*DISP_DSI1_INTERFACE_CLOCK*/
			<&mmsys_config CLK_MM_CG2_B4>,	/*DISP_DPI_MM_CLOCK*/
			<&mmsys_config CLK_MM_CG2_B5>,	/*DISP_FAKE_ENG2*/
			<&mmsys_config CLK_MM_CG2_B6>,	/*DISP_FAKE_ENG*/

			<&mmsys_config CLK_MM_CG0_B9>,	/*MDP_WROT0*/
			<&mmsys_config CLK_MM_CG0_B10>,	/*MDP_WROT1*/

			<&topckgen CLK_TOP_DPI0_SEL>,	/*MUX_DPI0*/
			<&topckgen CLK_TOP_TVDPLL_D2>,	/*TVDPLL_D2*/
			<&topckgen CLK_TOP_TVDPLL_D4>,	/*TVDPLL_D4*/
			<&topckgen CLK_TOP_TVDPLL_D8>,	/*TVDPLL_D8*/
			<&topckgen CLK_TOP_TVDPLL_D16>,	/*TVDPLL_D16*/
			<&topckgen CLK_TOP_TVDPLL>,			/*DPI_CK*/
			<&pericfg CLK_PERICFG_RG_DISP_PWM0>,	/*DISP_CLK_PWM0*/
			<&pericfg CLK_PERICFG_RG_DISP_PWM1>,	/*DISP_CLK_PWM1*/
			<&topckgen CLK_TOP_DISPPWM_SEL>,	/*MUX_PWM*/
			<&clk26m>,	/*CLK26M*/
			<&topckgen CLK_TOP_ULPOSCPLL_D2>,	/*ULPOSC_D2*/
			<&topckgen CLK_TOP_ULPOSCPLL_D8>,	/*ULPOSC_D8*/
			<&topckgen CLK_TOP_UNIVPLL1_D2>;	/*UNIVPLL2_D4*/

		clock-names = "DISP_MTCMOS_CLK",
			"DISP_SMI_COMMON",
			"DISP_SMI_COMMON_2X",
			"GALS_M0_2X",
			"GALS_M1_2X",
			"UPSZ0",
			"UPSZ1",
			"FIFO0",
			"FIFO1",
			"DISP_SMI_LARB0",
			"DISP_SMI_LARB1",
			"DISP_OVL0",
			"DISP_OVL1",
			"DISP_OVL0_2L",
			"DISP_OVL1_2L",
			"DISP_RDMA0",
			"DISP_RDMA1",
			"DISP_RDMA2",
			"DISP_WDMA0",
			"DISP_WDMA1",
			"DISP_COLOR0",
			"DISP_COLOR1",
			"DISP_CCORR0",
			"DISP_CCORR1",
			"DISP_AAL0",
			"DISP_AAL1",
			"DISP_GAMMA0",
			"DISP_GAMMA1",
			"DISP_OD",
			"DISP_DITHER0",
			"DISP_DITHER1",
			"DISP_UFOE",

			"DISP_DPI_INTERFACE_CLOCK",
			"DISP_DSC",
			"DISP_SPLIT",
			"DISP_OVL0_MOUT",
			"DISP_RSZ0",
			"DISP_RSZ1",

			"DISP_DSI0_MM_CLOCK",
			"DISP_DSI0_INTERFACE_CLOCK",
			"DISP_DSI1_MM_CLOCK",
			"DISP_DSI1_INTERFACE_CLOCK",
			"DISP_DPI_MM_CLOCK",
			"DISP_FAKE_ENG2",
			"DISP_FAKE_ENG",

			"MUX_DPI0",
			"TVDPLL_D2",
			"TVDPLL_D4",
			"TVDPLL_D8",
			"TVDPLL_D16",
			"DPI_CK",
			"DISP_CLK_PWM0",
			"DISP_CLK_PWM1",
			"MUX_PWM",
			"CLK26M",
			"ULPOSC_D2",
			"ULPOSC_D8",
			"UNIVPLL2_D4";
	};

	dsi_te: dsi_te {
		compatible = "mediatek, dsi_te-eint";
		status = "disabled";
	};

	mhl:mhl@0 {
		compatible = "mediatek,extd_dev";
	};

	disp_ovl0@1400b000 {
		compatible = "mediatek,disp_ovl0";
		reg = <0 0x1400b000 0 0x1000>;
		interrupts = <GIC_SPI 247 IRQ_TYPE_LEVEL_LOW>;
	};

	disp_ovl1@1400c000 {
		compatible = "mediatek,disp_ovl1";
		reg = <0 0x1400c000 0 0x1000>;
		interrupts = <GIC_SPI 248 IRQ_TYPE_LEVEL_LOW>;
	};

	disp_ovl0_2l@1400d000 {
		compatible = "mediatek,disp_ovl0_2l";
		reg = <0 0x1400d000 0 0x1000>;
		interrupts = <GIC_SPI 249 IRQ_TYPE_LEVEL_LOW>;
	};

	disp_ovl1_2l@1400e000 {
		compatible = "mediatek,disp_ovl1_2l";
		reg = <0 0x1400e000 0 0x1000>;
		interrupts = <GIC_SPI 250 IRQ_TYPE_LEVEL_LOW>;
	};

	disp_rdma0@1400f000 {
		compatible = "mediatek,disp_rdma0";
		reg = <0 0x1400f000 0 0x1000>;
		interrupts = <GIC_SPI 251 IRQ_TYPE_LEVEL_LOW>;
	};

	disp_rdma1@14010000 {
		compatible = "mediatek,disp_rdma1";
		reg = <0 0x14010000 0 0x1000>;
		interrupts = <GIC_SPI 252 IRQ_TYPE_LEVEL_LOW>;
	};

	disp_rdma2@14011000 {
		compatible = "mediatek,disp_rdma2";
		reg = <0 0x14011000 0 0x1000>;
		interrupts = <GIC_SPI 253 IRQ_TYPE_LEVEL_LOW>;
	};

	disp_wdma0@14012000 {
		compatible = "mediatek,disp_wdma0";
		reg = <0 0x14012000 0 0x1000>;
		interrupts = <GIC_SPI 254 IRQ_TYPE_LEVEL_LOW>;
	};

	disp_wdma1@14013000 {
		compatible = "mediatek,disp_wdma1";
		reg = <0 0x14013000 0 0x1000>;
		interrupts = <GIC_SPI 255 IRQ_TYPE_LEVEL_LOW>;
	};

	disp_color0@14014000 {
		compatible = "mediatek,disp_color0";
		reg = <0 0x14014000 0 0x1000>;
		interrupts = <GIC_SPI 256 IRQ_TYPE_LEVEL_LOW>;
	};

	disp_color1@14015000 {
		compatible = "mediatek,disp_color1";
		reg = <0 0x14015000 0 0x1000>;
		interrupts = <GIC_SPI 257 IRQ_TYPE_LEVEL_LOW>;
	};

	disp_ccorr0@14016000 {
		compatible = "mediatek,disp_ccorr0";
		reg = <0 0x14016000 0 0x1000>;
		interrupts = <GIC_SPI 258 IRQ_TYPE_LEVEL_LOW>;
	};

	disp_ccorr1@14017000 {
		compatible = "mediatek,disp_ccorr1";
		reg = <0 0x14017000 0 0x1000>;
		interrupts = <GIC_SPI 259 IRQ_TYPE_LEVEL_LOW>;
	};

	disp_aal0@14018000 {
		compatible = "mediatek,disp_aal0";
		reg = <0 0x14018000 0 0x1000>;
		interrupts = <GIC_SPI 260 IRQ_TYPE_LEVEL_LOW>;
	};

	disp_aal1@14019000 {
		compatible = "mediatek,disp_aal1";
		reg = <0 0x14019000 0 0x1000>;
		interrupts = <GIC_SPI 261 IRQ_TYPE_LEVEL_LOW>;
	};

	disp_gamma0@1401a000 {
		compatible = "mediatek,disp_gamma0";
		reg = <0 0x1401a000 0 0x1000>;
		interrupts = <GIC_SPI 262 IRQ_TYPE_LEVEL_LOW>;
	};

	disp_gamma1@1401b000 {
		compatible = "mediatek,disp_gamma1";
		reg = <0 0x1401b000 0 0x1000>;
		interrupts = <GIC_SPI 263 IRQ_TYPE_LEVEL_LOW>;
	};

	disp_od@1401c000 {
		compatible = "mediatek,disp_od";
		reg = <0 0x1401c000 0 0x1000>;
		interrupts = <GIC_SPI 264 IRQ_TYPE_LEVEL_LOW>;
	};

	disp_dither0@1401d000 {
		compatible = "mediatek,disp_dither0";
		reg = <0 0x1401d000 0 0x1000>;
		interrupts = <GIC_SPI 265 IRQ_TYPE_LEVEL_LOW>;
	};

	disp_dither1@1401e000 {
		compatible = "mediatek,disp_dither1";
		reg = <0 0x1401e000 0 0x1000>;
		interrupts = <GIC_SPI 266 IRQ_TYPE_LEVEL_LOW>;
	};

	disp_ufoe@1401f000 {
		compatible = "mediatek,disp_ufoe";
		reg = <0 0x1401f000 0 0x1000>;
		interrupts = <GIC_SPI 267 IRQ_TYPE_LEVEL_LOW>;
	};

	disp_dsc@14020000 {
		compatible = "mediatek,disp_dsc";
		reg = <0 0x14020000 0 0x1000>;
	};

	disp_split@14021000 {
		compatible = "mediatek,disp_split";
		reg = <0 0x14021000 0 0x1000>;
	};

	dsi0@14022000 {
		compatible = "mediatek,dsi0";
		reg = <0 0x14022000 0 0x1000>;
		interrupts = <GIC_SPI 270 IRQ_TYPE_LEVEL_LOW>;
	};

	dsi1@14023000 {
		compatible = "mediatek,dsi1";
		reg = <0 0x14023000 0 0x1000>;
		interrupts = <GIC_SPI 271 IRQ_TYPE_LEVEL_LOW>;
	};

	dpi0@14024000 {
		compatible = "mediatek,dpi0";
		reg = <0 0x14024000 0 0x1000>;
		interrupts = <GIC_SPI 272 IRQ_TYPE_LEVEL_LOW>;
	};

	disp_mutex@14025000 {
		compatible = "mediatek,disp_mutex";
		reg = <0 0x14025000 0 0x1000>;
		interrupts = <GIC_SPI 236 IRQ_TYPE_LEVEL_LOW>;
	};

	smi_larb0@14026000 {
		compatible = "mediatek,smi_larb0";
		reg = <0 0x14026000 0 0x1000>;
		interrupts = <GIC_SPI 276 IRQ_TYPE_LEVEL_LOW>;
	};

	smi_larb1@14027000 {
		compatible = "mediatek,smi_larb1";
		reg = <0 0x14027000 0 0x1000>;
		interrupts = <GIC_SPI 277 IRQ_TYPE_LEVEL_LOW>;
	};

	smi_common@14028000 {
		compatible = "mediatek,smi_common";
		reg = <0 0x14028000 0 0x1000>, /* SMI COMMON */
				<0 0x14026000 0 0x1000>,   /* SMI LARB0 */
				<0 0x14027000 0 0x1000>,   /* SMI LARB1 */
				<0 0x1502f000 0 0x1000>,   /* SMI LARB2 */
				<0 0x18002000 0 0x1000>,   /* SMI LARB3 */
				<0 0x16010000 0 0x1000>,   /* SMI LARB4 */
				<0 0x15021000 0 0x1000>,   /* SMI LARB5 */
				<0 0x18001000 0 0x1000>,   /* SMI LARB6 */
				<0 0x17010000 0 0x1000>,   /* SMI LARB7 */
				<0 0x12002000 0 0x1000>,   /* SMI LARB8 */
				<0 0x14000000 0 0x1000>;   /* MMSYS */
		clocks = <&mmsys_config CLK_MM_CG1_B16>,
							<&mmsys_config CLK_MM_CG1_B17>,
							<&mmsys_config CLK_MM_CG1_B14>,
							<&mmsys_config CLK_MM_CG1_B15>,
							<&mmsys_config CLK_MM_CG1_B12>,
							<&mmsys_config CLK_MM_CG1_B13>,
							<&mmsys_config CLK_MM_CG2_B11>,
							<&mmsys_config CLK_MM_CG2_B12>,
							<&mmsys_config CLK_MM_CG2_B9>,
							<&mmsys_config CLK_MM_CG2_B10>,
							<&imgsys CLK_IMG_LARB2>,
							<&camsys CLK_CAM_LARB3>,
							<&vdec_gcon CLK_VDEC_LARB1_CKEN>,
							<&mmsys_config CLK_MM_CG1_B11>,
							<&imgsys CLK_IMG_LARB5>,
							<&mmsys_config CLK_MM_CG1_B10>,
							<&camsys CLK_CAM_LARB6>,
							<&mmsys_config CLK_MM_CG1_B9>,
							<&venc_global_con CLK_VENC_GLOBAL_CON_CKE0>,
							<&venc_global_con CLK_VENC_GLOBAL_CON_CKE1>,
							<&venc_global_con CLK_VENC_GLOBAL_CON_CKE4>,
							<&mmsys_config CLK_MM_CG1_B8>,
							<&mjc_config CLK_MJC_SMI_LARB>,
							<&mjc_config CLK_MJC_FAKE_ENGINE>,
							<&mmsys_config CLK_MM_CG1_B7>,
							<&scpsys SCP_SYS_MM0>,
							<&scpsys SCP_SYS_ISP>,
							<&scpsys SCP_SYS_CAM>,
							<&scpsys SCP_SYS_VDE>,
							<&scpsys SCP_SYS_VEN>,
							<&scpsys SCP_SYS_MJC>,
							<&topckgen CLK_TOP_MMPLL_D3>,
							<&topckgen CLK_TOP_MMPLL_D5>,
							<&topckgen CLK_TOP_MMPLL_D6>,
							<&topckgen CLK_TOP_SYSPLL_D2>,
							<&topckgen CLK_TOP_SYSPLL_D3>,
							<&topckgen CLK_TOP_SYSPLL_D5>,
							<&topckgen CLK_TOP_SYSPLL1_D2>,
							<&topckgen CLK_TOP_ULPOSCPLL>,
							<&topckgen CLK_TOP_UNIVPLL_D5>,
							<&topckgen CLK_TOP_UNIVPLL1_D2>,
							<&topckgen CLK_TOP_VCODECPLL_D6>,
							<&topckgen CLK_TOP_VCODECPLL_D7>,
							<&topckgen CLK_TOP_FSMIPLL_D3>,
							<&topckgen CLK_TOP_SMI0_2X_SEL>,
							<&topckgen CLK_TOP_MM_SEL>,
							<&topckgen CLK_TOP_CAM_SEL>,
							<&topckgen CLK_TOP_IMG_SEL>,
							<&topckgen CLK_TOP_VENC_SEL>,
							<&topckgen CLK_TOP_VDEC_SEL>,
							<&topckgen CLK_TOP_MJC_SEL>,
							<&topckgen CLK_TOP_DSP_SEL>;

		clock-names = "smi-common-FIFO0", "smi-common-FIFO1", "smi-common-UPSZ0", "smi-common-UPSZ1",
					"smi-common-GALS0", "smi-common-GALS1", "smi-common", "smi-common-2X",
					"smi-larb0", "smi-larb1", "smi-larb2", "smi-larb3", "smi-larb4-vdec",
					"smi-larb4-mm", "smi-larb5-img", "smi-larb5-mm", "smi-larb6-cam",
					"smi-larb6-mm", "smi-larb7-venc-0", "smi-larb7-venc-1", "smi-larb7-venc-2",
					"smi-larb7-mm", "smi-larb8-mjc-0", "smi-larb8-mjc-1", "smi-larb8-mm",
					"mtcmos-mm", "mtcmos-img", "mtcmos-cam", "mtcmos-vde", "mtcmos-ven",
					"mtcmos-mjc",
					"MMDVFS_CLK_TOP_MMPLL_D3", "MMDVFS_CLK_TOP_MMPLL_D5",
					"MMDVFS_CLK_TOP_MMPLL_D6", "MMDVFS_CLK_TOP_SYSPLL_D2",
					"MMDVFS_CLK_TOP_SYSPLL_D3",	"MMDVFS_CLK_TOP_SYSPLL_D5",
					"MMDVFS_CLK_TOP_SYSPLL1_D2", "MMDVFS_CLK_TOP_ULPOSCPLL",
					"MMDVFS_CLK_TOP_UNIVPLL_D5", "MMDVFS_CLK_TOP_UNIVPLL1_D2",
					"MMDVFS_CLK_TOP_VCODECPLL_D6", "MMDVFS_CLK_TOP_VCODECPLL_D7",
					"MMDVFS_CLK_TOP_FSMIPLL_D3", "MMDVFS_CLK_MUX_TOP_SMI0_2X_SEL",
					"MMDVFS_CLK_MUX_TOP_MM_SEL", "MMDVFS_CLK_MUX_TOP_CAM_SEL",
					"MMDVFS_CLK_MUX_TOP_IMG_SEL",	"MMDVFS_CLK_MUX_TOP_VENC_SEL",
					"MMDVFS_CLK_MUX_TOP_VDEC_SEL", "MMDVFS_CLK_MUX_TOP_MJC_SEL",
					"MMDVFS_CLK_MUX_TOP_DSP_SEL";
	};


	met_mcsi_b_pmu: met_mcsi_b_pmu@0c500000 {
		compatible = "mediatek,met_mcsi_b_pmu";
		reg = <0 0x0c500000 0 0x100>,		/* control registers */
			<0 0x0c508000 0 0x1000>;	/* counter registers */
	};

	mmsys_vad@14029000 {
		compatible = "mediatek,mmsys_vad";
		reg = <0 0x14029000 0 0x1000>;
	};

	mmsys_dfp@1402a000 {
		compatible = "mediatek,mmsys_dfp";
		reg = <0 0x1402a000 0 0x1000>;
	};

	disp_rsz0@1402b000 {
		compatible = "mediatek,disp_rsz0";
		reg = <0 0x1402b000 0 0x1000>;
		interrupts = <GIC_SPI 273 IRQ_TYPE_LEVEL_LOW>;
	};

	disp_rsz1@1402c000 {
		compatible = "mediatek,disp_rsz1";
		reg = <0 0x1402c000 0 0x1000>;
		interrupts = <GIC_SPI 274 IRQ_TYPE_LEVEL_LOW>;
	};

	disp_dbi@1402e000 {
		compatible = "mediatek,disp_dbi";
		reg = <0 0x1402e000 0 0x1000>;
	};

	i2c@1402f000 {
		compatible = "mediatek,i2c";
		reg = <0 0x1402f000 0 0x1000>;
	};

	vdec@16020000 {
		compatible = "mediatek,vdec";
		reg = <0 0x16020000 0 0x10000>;
		interrupts = <GIC_SPI 312 IRQ_TYPE_LEVEL_LOW>;
	};

	vld@16020000 {
		compatible = "mediatek,vld";
		reg = <0 0x16020000 0 0x1000>;
	};

	vld_top@16020800 {
		compatible = "mediatek,vld_top";
		reg = <0 0x16020800 0 0x1000>;
	};

	mc@16021000 {
		compatible = "mediatek,mc";
		reg = <0 0x16021000 0 0x1000>;
	};

	avc_vld@16022000 {
		compatible = "mediatek,avc_vld";
		reg = <0 0x16022000 0 0x1000>;
	};

	avc_mv@16023000 {
		compatible = "mediatek,avc_mv";
		reg = <0 0x16023000 0 0x1000>;
	};

	vdec_pp@16024000 {
		compatible = "mediatek,vdec_pp";
		reg = <0 0x16024000 0 0x1000>;
	};

	vdtop@16025000 {
		compatible = "mediatek,vdtop";
		reg = <0 0x16025000 0 0x1000>;
	};

	vp6@16026000 {
		compatible = "mediatek,vp6";
		reg = <0 0x16026000 0 0x1000>;
	};

	vld2@16026800 {
		compatible = "mediatek,vld2";
		reg = <0 0x16026800 0 0x1000>;
	};

	vp8_vld@16027800 {
		compatible = "mediatek,vp8_vld";
		reg = <0 0x16027800 0 0x1000>;
	};

	hevc_vld@16028000 {
		compatible = "mediatek,hevc_vld";
		reg = <0 0x16028000 0 0x1000>;
	};

	vp9_vld@16028400 {
		compatible = "mediatek,vp9_vld";
		reg = <0 0x16028400 0 0x1000>;
	};

	smi_larb4@16010000 {
		compatible = "mediatek,smi_larb4";
		reg = <0 0x16010000 0 0x1000>;
		interrupts = <GIC_SPI 313 IRQ_TYPE_LEVEL_LOW>;
	};

	vdec_gcon: vdec_gcon@16000000 {
		compatible = "mediatek,mt6799-vdec_gcon", "syscon";
		reg = <0 0x16000000 0 0x1000>;
		clocks =
				<&mmsys_config CLK_MM_CG1_B12>,
				<&mmsys_config CLK_MM_CG1_B13>,
				<&mmsys_config CLK_MM_CG1_B14>,
				<&mmsys_config CLK_MM_CG1_B15>,
				<&mmsys_config CLK_MM_CG1_B16>,
				<&mmsys_config CLK_MM_CG1_B17>,
				<&mmsys_config CLK_MM_CG2_B11>,
				<&mmsys_config CLK_MM_CG2_B12>,
				<&mmsys_config CLK_MM_CG1_B11>,
				<&mmsys_config CLK_MM_CG1_B8>,
				<&vdec_gcon CLK_VDEC_CKEN>,
				<&vdec_gcon CLK_VDEC_LARB1_CKEN>,
				<&venc_global_con CLK_VENC_GLOBAL_CON_CKE0>,
				<&venc_global_con CLK_VENC_GLOBAL_CON_CKE1>,
				<&scpsys SCP_SYS_MM0>,
				<&scpsys SCP_SYS_VDE>,
				<&scpsys SCP_SYS_VEN>;
		clock-names =
				"MT_CG_GALS_M0_2X",
				"MT_CG_GALS_M1_2X",
				"MT_CG_UPSZ0",
				"MT_CG_UPSZ1",
				"MT_CG_FIFO0",
				"MT_CG_FIFO1",
				"MT_CG_SMI_COMMON",
				"MT_CG_SMI_COMMON_2X",
				"MT_CG_LARB4",
				"MT_CG_LARB7",
				"MT_CG_VDEC",
				"MT_CG_VDEC_LARB1",
				"MT_CG_VENC_LARB",
				"MT_CG_VENC_VENC",
				"MT_SCP_SYS_MM0",
				"MT_SCP_SYS_VDE",
				"MT_SCP_SYS_VEN";
		#clock-cells = <1>;
	};

	vdec_top_dfp@16040000 {
		compatible = "mediatek,vdec_top_dfp";
		reg = <0 0x16040000 0 0x1000>;
	};

	venc_global_con: venc_global_con@17000000 {
		compatible = "mediatek,mt6799-venc_global_con", "syscon";
		reg = <0 0x17000000 0 0x1000>;
		clocks =
				<&mmsys_config CLK_MM_CG1_B12>,
				<&mmsys_config CLK_MM_CG1_B13>,
				<&mmsys_config CLK_MM_CG1_B14>,
				<&mmsys_config CLK_MM_CG1_B15>,
				<&mmsys_config CLK_MM_CG1_B16>,
				<&mmsys_config CLK_MM_CG1_B17>,
				<&mmsys_config CLK_MM_CG2_B11>,
				<&mmsys_config CLK_MM_CG2_B12>,
				<&mmsys_config CLK_MM_CG1_B8>,
				<&venc_global_con CLK_VENC_GLOBAL_CON_CKE0>,
				<&venc_global_con CLK_VENC_GLOBAL_CON_CKE1>,
				<&scpsys SCP_SYS_MM0>,
				<&scpsys SCP_SYS_VEN>;
		clock-names =
				"MT_CG_GALS_M0_2X",
				"MT_CG_GALS_M1_2X",
				"MT_CG_UPSZ0",
				"MT_CG_UPSZ1",
				"MT_CG_FIFO0",
				"MT_CG_FIFO1",
				"MT_CG_SMI_COMMON",
				"MT_CG_SMI_COMMON_2X",
				"MT_CG_LARB7",
				"MT_CG_VENC_LARB",
				"MT_CG_VENC_VENC",
				"MT_CG_SCP_SYS_MM0",
				"MT_CG_SCP_SYS_VEN";
		#clock-cells = <1>;
	};

	smi_larb7@17010000 {
		compatible = "mediatek,smi_larb7";
		reg = <0 0x17010000 0 0x1000>;
		interrupts = <GIC_SPI 307 IRQ_TYPE_LEVEL_LOW>;
	};

	venc@17020000 {
		compatible = "mediatek,venc";
		reg = <0 0x17020000 0 0x1000>;
		interrupts = <GIC_SPI 306 IRQ_TYPE_LEVEL_LOW>;
	};

	venc_jpg@17030000 {
		compatible = "mediatek,venc_jpg";
		reg =	<0 0x17030000 0 0x1000>,
			<0 0x17040000 0 0x1000>;
		interrupts =	<GIC_SPI 308 IRQ_TYPE_LEVEL_LOW>,
				<GIC_SPI 311 IRQ_TYPE_LEVEL_LOW>;
			clocks =
				<&mmsys_config CLK_MM_CG1_B8>,
				<&mmsys_config CLK_MM_CG1_B12>,
				<&mmsys_config CLK_MM_CG1_B13>,
				<&mmsys_config CLK_MM_CG1_B14>,
				<&mmsys_config CLK_MM_CG1_B15>,
				<&mmsys_config CLK_MM_CG1_B16>,
				<&mmsys_config CLK_MM_CG1_B17>,
				<&mmsys_config CLK_MM_CG2_B11>,
				<&mmsys_config CLK_MM_CG2_B12>,
				<&scpsys SCP_SYS_MM0>,
				<&scpsys SCP_SYS_VEN>,
				<&venc_global_con CLK_VENC_GLOBAL_CON_CKE0>,
				<&venc_global_con CLK_VENC_GLOBAL_CON_CKE2>,
				<&venc_global_con CLK_VENC_GLOBAL_CON_CKE3>;

			clock-names =
				"MT_CG_MM_LARB7",
				"MT_CG_GALS_M0_2X",
				"MT_CG_GALS_M1_2X",
				"MT_CG_UPSZ0",
				"MT_CG_UPSZ1",
				"MT_CG_FIFO0",
				"MT_CG_FIFO1",
				"MT_CG_SMI_COMMON",
				"MT_CG_SMI_COMMON_2X",
				"MT_CG_SCP_SYS_MM0",
				"MT_CG_SCP_SYS_VEN",
				"MT_CG_VENC_LARB",
				"MT_CG_VENC_JPGENC",
				"MT_CG_VENC_JPGDEC";
	};

	venc_dfp@17050000 {
		compatible = "mediatek,venc_dfp";
		reg = <0 0x17050000 0 0x1000>;
	};

	venc_vad@17060000 {
		compatible = "mediatek,venc_vad";
		reg = <0 0x17060000 0 0x1000>;
	};

	mjc_config: mjc_config@12000000 {
		compatible = "mediatek,mjc_config", "syscon";
		reg = <0 0x12000000 0 0x1000>;
		interrupts = <GIC_SPI 320 IRQ_TYPE_LEVEL_LOW>;
		#clock-cells = <1>;
	};

	mjc_top@12001000 {
		compatible = "mediatek,mjc_top-v1";
		reg = <0 0x12001000 0 0x1000>;
		interrupts = <GIC_SPI 319 IRQ_TYPE_LEVEL_LOW>;
			clocks =
				<&mmsys_config CLK_MM_CG1_B12>,
				<&mmsys_config CLK_MM_CG1_B13>,
				<&mmsys_config CLK_MM_CG1_B14>,
				<&mmsys_config CLK_MM_CG1_B15>,
				<&mmsys_config CLK_MM_CG1_B16>,
				<&mmsys_config CLK_MM_CG1_B17>,
				<&mmsys_config CLK_MM_CG2_B11>,
				<&mmsys_config CLK_MM_CG2_B12>,
				<&mmsys_config CLK_MM_CG1_B7>,
				<&mjc_config CLK_MJC_SMI_LARB>,
				<&mjc_config CLK_MJC_TOP0>,
				<&mjc_config CLK_MJC_TOP1>,
				<&mjc_config CLK_MJC_TOP2>,
				<&mjc_config CLK_MJC_GALS_AXI>,
				<&mjc_config CLK_MJC_FAKE_ENGINE>,
				<&mjc_config CLK_MJC_METER>,
				<&scpsys SCP_SYS_MM0>,
				<&scpsys SCP_SYS_MJC>,
				<&topckgen CLK_TOP_MJC_SEL>,
				<&topckgen CLK_TOP_SYSPLL_D5>,
				<&topckgen CLK_TOP_VCODECPLL_D7>;
			clock-names =
				"MT_CG_GALS_M0_2X",
				"MT_CG_GALS_M1_2X",
				"MT_CG_UPSZ0",
				"MT_CG_UPSZ1",
				"MT_CG_FIFO0",
				"MT_CG_FIFO1",
				"MT_CG_SMI_COMMON",
				"MT_CG_SMI_COMMON_2X",
				"MT_CG_LARB8",
				"mjc-smi-larb",
				"top-clk-0",
				"top-clk-1",
				"top-clk-2",
				"mjc-gals-axi",
				"mjc-fake-engine",
				"mjc-meter",
				"mtcmos-mm0",
				"mtcmos-mjc",
				"mux_mjc",
				"syspll_d5",
				"vcodecpll_d7";
	};

	smi_larb8@12002000 {
		compatible = "mediatek,smi_larb8";
		reg = <0 0x12002000 0 0x1000>;
		interrupts = <GIC_SPI 318 IRQ_TYPE_LEVEL_LOW>;
	};

	mjc_dfp_pwr@12003000 {
		compatible = "mediatek,mjc_dfp_pwr";
		reg = <0 0x12003000 0 0x1000>;
	};

	mjc_dfp_vad@12004000 {
		compatible = "mediatek,mjc_dfp_vad";
		reg = <0 0x12004000 0 0x1000>;
	};

	imgsys1_dfp@1502e000 {
		compatible = "mediatek,imgsys1_dfp";
		reg = <0 0x1502e000 0 0x1000>;
	};

	imgsys: imgsys@15020000 {
		compatible = "mediatek,mt6799-imgsys", "syscon";
		reg = <0 0x15020000 0 0x1000>;
		#clock-cells = <1>;
		clocks = <&scpsys SCP_SYS_MM0>,
			<&mmsys_config CLK_MM_CG2_B11>,
			<&mmsys_config CLK_MM_CG2_B12>,
			<&mmsys_config CLK_MM_CG1_B12>,
			<&mmsys_config CLK_MM_CG1_B13>,
			<&mmsys_config CLK_MM_CG1_B14>,
			<&mmsys_config CLK_MM_CG1_B15>,
			<&mmsys_config CLK_MM_CG1_B16>,
			<&mmsys_config CLK_MM_CG1_B17>,
			<&mmsys_config CLK_MM_CG1_B9>,
			<&mmsys_config CLK_MM_CG1_B10>,
			<&mmsys_config CLK_MM_CG0_B0>,
			<&mmsys_config CLK_MM_CG2_B13>,
			<&scpsys SCP_SYS_ISP>,
			<&scpsys SCP_SYS_CAM>,
			<&imgsys CLK_IMG_LARB5>,
			<&imgsys CLK_IMG_DIP>,
			<&imgsys CLK_IMG_RSC>,
			<&camsys CLK_CAM_LARB6>,
			<&camsys CLK_CAM>,
			<&camsys CLK_CAMTG>,
			<&camsys CLK_CAM_SENINF>,
			<&camsys CLK_CAMSV0>,
			<&camsys CLK_CAMSV1>,
			<&camsys CLK_CAMSV2>;
		clock-names = "ISP_SCP_SYS_DIS",
			"ISP_MMSYS_SMI_COMMON",
			"ISP_CLK_MM_CG2_B12",
			"ISP_CLK_MM_CG1_B12",
			"ISP_CLK_MM_CG1_B13",
			"ISP_CLK_MM_CG1_B14",
			"ISP_CLK_MM_CG1_B15",
			"ISP_CLK_MM_CG1_B16",
			"ISP_CLK_MM_CG1_B17",
			"ISP_CLK_MM_CG1_B9",
			"ISP_CLK_MM_CG1_B10",
			"ISP_CLK_MM_CG0_B0",
			"ISP_CLK_MM_CG2_B13",
			"ISP_SCP_SYS_ISP",
			"ISP_SCP_SYS_CAM",
			"ISP_IMG_LARB5",
			"ISP_IMG_DIP",
			"ISP_IMG_RSC",
			"ISP_CAMSYS_LARB6_CGPDN",
			"ISP_CAMSYS_CAMSYS_CGPDN",
			"ISP_CAMSYS_CAMTG_CGPDN",
			"ISP_CAMSYS_SENINF_CGPDN",
			"ISP_CAMSYS_CAMSV0_CGPDN",
			"ISP_CAMSYS_CAMSV1_CGPDN",
			"ISP_CAMSYS_CAMSV2_CGPDN";
	};

	imgsyscq@15020000 {
		compatible = "mediatek,imgsyscq";
		reg = <0 0x15020000 0 0x10>;
	};

	smi_larb5@15021000 {
		compatible = "mediatek,smi_larb5";
		reg = <0 0x15021000 0 0x1000>;
		interrupts = <GIC_SPI 321 IRQ_TYPE_LEVEL_LOW>;
	};

	dip@15022000 {
		compatible = "mediatek,dip";
		reg = <0 0x15022000 0 0x3000>;
		interrupts = <GIC_SPI 322 IRQ_TYPE_LEVEL_LOW>;
	};

	dip1@15022000 {
		compatible = "mediatek,dip1";
		reg = <0 0x15022000 0 0x1000>;
	};

	dip2@15023000 {
		compatible = "mediatek,dip2";
		reg = <0 0x15023000 0 0x1000>;
	};

	dip3@15024000 {
		compatible = "mediatek,dip3";
		reg = <0 0x15024000 0 0x1000>;
	};

	dpe_dma@15028000 {
		compatible = "mediatek,dpe_dma";
		reg = <0 0x15028000 0 0x1000>;
	};

	dpe@15028000 {
		compatible = "mediatek,dpe";
		reg = <0 0x15028000 0 0x1000>;
		interrupts = <GIC_SPI 324 IRQ_TYPE_LEVEL_LOW>;

		clocks = <&scpsys SCP_SYS_MM0>,
			<&mmsys_config CLK_MM_CG2_B11>,
			<&mmsys_config CLK_MM_CG2_B12>,
			<&mmsys_config CLK_MM_CG1_B12>,
			<&mmsys_config CLK_MM_CG1_B13>,
			<&mmsys_config CLK_MM_CG1_B14>,
			<&mmsys_config CLK_MM_CG1_B15>,
			<&mmsys_config CLK_MM_CG1_B16>,
			<&mmsys_config CLK_MM_CG1_B17>,
			<&mmsys_config CLK_MM_CG1_B10>,
			<&scpsys SCP_SYS_ISP>,
			<&imgsys CLK_IMG_LARB5>,
			<&imgsys CLK_IMG_DIP>;
		clock-names = "DPE_SCP_SYS_MM0",
			"DPE_CLK_MM_CG2_B11",
			"DPE_CLK_MM_CG2_B12",
			"DPE_CLK_MM_CG1_B12",
			"DPE_CLK_MM_CG1_B13",
			"DPE_CLK_MM_CG1_B14",
			"DPE_CLK_MM_CG1_B15",
			"DPE_CLK_MM_CG1_B16",
			"DPE_CLK_MM_CG1_B17",
			"DPE_CLK_MM_CG1_B10",
			"DPE_SCP_SYS_ISP",
			"DPE_CLK_IMGSYS_LARB5",
			"DPE_CLK_IMGSYS_DPE";
	};

	rsc@15029000 {
		compatible = "mediatek,rsc";
		reg = <0 0x15029000 0 0x1000>;
		interrupts = <GIC_SPI 325 IRQ_TYPE_LEVEL_LOW>;
		clocks = <&scpsys SCP_SYS_MM0>,
			<&mmsys_config CLK_MM_CG2_B11>,
			<&mmsys_config CLK_MM_CG2_B12>,
			<&mmsys_config CLK_MM_CG1_B12>,
			<&mmsys_config CLK_MM_CG1_B13>,
			<&mmsys_config CLK_MM_CG1_B14>,
			<&mmsys_config CLK_MM_CG1_B15>,
			<&mmsys_config CLK_MM_CG1_B16>,
			<&mmsys_config CLK_MM_CG1_B17>,
			<&mmsys_config CLK_MM_CG1_B10>,
			<&scpsys SCP_SYS_ISP>,
			<&imgsys CLK_IMG_LARB5>,
			<&imgsys CLK_IMG_RSC>;
		clock-names = "RSC_SCP_SYS_MM0",
			"RSC_CLK_MM_CG2_B11",
			"RSC_CLK_MM_CG2_B12",
			"RSC_CLK_MM_CG1_B12",
			"RSC_CLK_MM_CG1_B13",
			"RSC_CLK_MM_CG1_B14",
			"RSC_CLK_MM_CG1_B15",
			"RSC_CLK_MM_CG1_B16",
			"RSC_CLK_MM_CG1_B17",
			"RSC_CLK_MM_CG1_B10",
			"RSC_SCP_SYS_ISP",
			"RSC_CLK_IMG_LARB",
			"RSC_CLK_IMG_RSC";
	};

	tsf@180b1000 {
		compatible = "mediatek,tsf";
		reg = <0 0x180b1000 0 0x1000>;
		interrupts = <GIC_SPI 357 IRQ_TYPE_LEVEL_LOW>;
		clocks = <&scpsys SCP_SYS_MM0>,
			<&mmsys_config CLK_MM_CG2_B11>,
			<&mmsys_config CLK_MM_CG2_B12>,
			<&mmsys_config CLK_MM_CG1_B12>,
			<&mmsys_config CLK_MM_CG1_B13>,
			<&mmsys_config CLK_MM_CG1_B14>,
			<&mmsys_config CLK_MM_CG1_B15>,
			<&mmsys_config CLK_MM_CG1_B16>,
			<&mmsys_config CLK_MM_CG1_B17>,
			<&mmsys_config CLK_MM_CG1_B9>,
			<&scpsys SCP_SYS_CAM>,
			<&camsys CLK_CAM_LARB6>,
			<&camsys CLK_CAM>,
			<&camsys CLK_CAM_CCU>;
		clock-names = "TSF_SCP_SYS_MM0",
			"TSF_CLK_MM_CG2_B11",
			"TSF_CLK_MM_CG2_B12",
			"TSF_CLK_MM_CG1_B12",
			"TSF_CLK_MM_CG1_B13",
			"TSF_CLK_MM_CG1_B14",
			"TSF_CLK_MM_CG1_B15",
			"TSF_CLK_MM_CG1_B16",
			"TSF_CLK_MM_CG1_B17",
			"TSF_CLK_MM_CG1_B9",
			"TSF_SCP_SYS_CAM",
			"TSF_CAMSYS_LARB6",
			"TSF_CAMSYS_CAMSYS",
			"TSF_CLK_CAM_CCU";
	};

	wpe@1502a000 {
		compatible = "mediatek,wpe";
		reg = <0 0x1502a000 0 0x1000>;
		interrupts = <GIC_SPI 326 IRQ_TYPE_LEVEL_LOW>;
		clocks = <&scpsys SCP_SYS_MM0>,
			<&mmsys_config CLK_MM_CG2_B11>,
			<&mmsys_config CLK_MM_CG2_B12>,
			<&mmsys_config CLK_MM_CG1_B12>,
			<&mmsys_config CLK_MM_CG1_B13>,
			<&mmsys_config CLK_MM_CG1_B14>,
			<&mmsys_config CLK_MM_CG1_B15>,
			<&mmsys_config CLK_MM_CG1_B16>,
			<&mmsys_config CLK_MM_CG1_B17>,
			<&mmsys_config CLK_MM_CG1_B10>,
			<&scpsys SCP_SYS_ISP>,
			<&imgsys CLK_IMG_LARB5>,
			<&imgsys CLK_IMG_WPE>;
		clock-names = "WPE_SCP_SYS_MM0",
			"WPE_CLK_MM_CG2_B11",
			"WPE_CLK_MM_CG2_B12",
			"WPE_CLK_MM_CG1_B12",
			"WPE_CLK_MM_CG1_B13",
			"WPE_CLK_MM_CG1_B14",
			"WPE_CLK_MM_CG1_B15",
			"WPE_CLK_MM_CG1_B16",
			"WPE_CLK_MM_CG1_B17",
			"WPE_CLK_MM_CG1_B10",
			"WPE_SCP_SYS_ISP",
			"WPE_CLK_IMG_LARB5",
			"WPE_CLK_IMG_WPE";
	};

	fdvt_dma@1502b000 {
		compatible = "mediatek,fdvt_dma";
		reg = <0 0x1502b000 0 0x1000>;
	};

	fdvt@1502b000 {
		compatible = "mediatek,fdvt";
		reg = <0 0x1502b000 0 0x1000>;
		interrupts = <GIC_SPI 323 IRQ_TYPE_LEVEL_LOW>;
		clocks = <&scpsys SCP_SYS_MM0>,
			<&mmsys_config CLK_MM_CG2_B11>,
			<&mmsys_config CLK_MM_CG2_B12>,
			<&mmsys_config CLK_MM_CG1_B12>,
			<&mmsys_config CLK_MM_CG1_B13>,
			<&mmsys_config CLK_MM_CG1_B14>,
			<&mmsys_config CLK_MM_CG1_B15>,
			<&mmsys_config CLK_MM_CG1_B16>,
			<&mmsys_config CLK_MM_CG1_B17>,
			<&mmsys_config CLK_MM_CG1_B10>,
			<&scpsys SCP_SYS_ISP>,
			<&imgsys CLK_IMG_LARB5>,
			<&imgsys CLK_IMG_FDVT>;
		clock-names = "FD_SCP_SYS_MM0",
			"FD_CLK_MM_CG2_B11",
			"FD_CLK_MM_CG2_B12",
			"FD_CLK_MM_CG1_B12",
			"FD_CLK_MM_CG1_B13",
			"FD_CLK_MM_CG1_B14",
			"FD_CLK_MM_CG1_B15",
			"FD_CLK_MM_CG1_B16",
			"FD_CLK_MM_CG1_B17",
			"FD_CLK_MM_CG1_B10",
			"FD_SCP_SYS_ISP",
			"FD_CLK_IMG_LARB5",
			"FD_CLK_IMG_FDVT";
	};

	gepf_dma@1502c000 {
		compatible = "mediatek,gepf_dma";
		reg = <0 0x1502c000 0 0x1000>;
	};

	gepf@1502c000 {
		compatible = "mediatek,gepf";
		reg = <0 0x1502c000 0 0x1000>;
		interrupts = <GIC_SPI 328 IRQ_TYPE_LEVEL_LOW>;
		clocks = <&scpsys SCP_SYS_MM0>,
			<&mmsys_config CLK_MM_CG2_B11>,
			<&mmsys_config CLK_MM_CG2_B12>,
			<&mmsys_config CLK_MM_CG1_B12>,
			<&mmsys_config CLK_MM_CG1_B13>,
			<&mmsys_config CLK_MM_CG1_B14>,
			<&mmsys_config CLK_MM_CG1_B15>,
			<&mmsys_config CLK_MM_CG1_B16>,
			<&mmsys_config CLK_MM_CG1_B17>,
			<&mmsys_config CLK_MM_CG1_B10>,
			<&scpsys SCP_SYS_ISP>,
			<&imgsys CLK_IMG_LARB5>,
			<&imgsys CLK_IMG_GEPF>;
		clock-names = "GEPF_SCP_SYS_MM0",
			"GEPF_CLK_MM_CG2_B11",
			"GEPF_CLK_MM_CG2_B12",
			"GEPF_CLK_MM_CG1_B12",
			"GEPF_CLK_MM_CG1_B13",
			"GEPF_CLK_MM_CG1_B14",
			"GEPF_CLK_MM_CG1_B15",
			"GEPF_CLK_MM_CG1_B16",
			"GEPF_CLK_MM_CG1_B17",
			"GEPF_CLK_MM_CG1_B10",
			"GEPF_SCP_SYS_ISP",
			"GEPF_CLK_IMG_LARB",
			"GEPF_CLK_IMG_GEPF";
	};

	eaf_dma@1502d000 {
		compatible = "mediatek,eaf_dma";
		reg = <0 0x1502d000 0 0x1000>;
	};

	eaf@1502d000 {
		compatible = "mediatek,eaf";
		reg = <0 0x1502d000 0 0x1000>;
		interrupts = <GIC_SPI 327 IRQ_TYPE_LEVEL_LOW>;
	};

	imgsys1_vad@1502e000 {
		compatible = "mediatek,imgsys1_vad";
		reg = <0 0x1502e000 0 0x1000>;
	};

	smi_larb2@1502f000 {
		compatible = "mediatek,smi_larb2";
		reg = <0 0x1502f000 0 0x1000>;
		interrupts = <GIC_SPI 329 IRQ_TYPE_LEVEL_LOW>;
	};

	camsys: camsys@18000000 {
		compatible = "mediatek,mt6799-camsys", "syscon";
		reg = <0 0x18000000 0 0x1000>;
		#clock-cells = <1>;
	};

	ipusys: ipusys@18800000 {
		compatible = "mediatek,mt6799-ipusys", "syscon";
		reg = <0 0x18800000 0 0x1000>;
		#clock-cells = <1>;
	};

	ipu@18841000 {
		compatible = "mediatek,ipu";
		reg = <0 0x18841000 0 0x1000>;
		interrupts = <GIC_SPI 332 IRQ_TYPE_LEVEL_LOW>;
		vimvo-supply = <&mt_pmic_vimvo_buck_reg>;
		clocks = <&topckgen CLK_TOP_DSP_SEL>,
			<&topckgen CLK_TOP_IPU_IF_SEL>,
			<&ipusys CLK_IPU>,
			<&ipusys CLK_IPU_ISP>,
			<&ipusys CLK_IPU_JTAG>,
			<&ipusys CLK_IPU_AXI>,
			<&ipusys CLK_IPU_AHB>,
			<&ipusys CLK_IPU_MM_AXI>,
			<&ipusys CLK_IPU_CAM_AXI>,
			<&ipusys CLK_IPU_IMG_AXI>,
			<&topckgen CLK_TOP_SYSPLL_D3>,
			<&topckgen CLK_TOP_MMPLL_D5>,
			<&mmsys_config CLK_MM_CG1_B6>,
			<&mmsys_config CLK_MM_CG1_B12>,
			<&mmsys_config CLK_MM_CG1_B13>,
			<&mmsys_config CLK_MM_CG1_B14>,
			<&mmsys_config CLK_MM_CG1_B15>,
			<&mmsys_config CLK_MM_CG1_B16>,
			<&mmsys_config CLK_MM_CG1_B17>,
			<&mmsys_config CLK_MM_CG2_B11>,
			<&mmsys_config CLK_MM_CG2_B12>,
			<&scpsys SCP_SYS_MM0>,
			<&scpsys SCP_SYS_IPU_SHUTDOWN>;
		clock-names = "clk_top_dsp_sel",
			"clk_top_ipu_if_sel",
			"clk_ipu",
			"clk_ipu_isp",
			"clk_ipu_jtag",
			"clk_ipu_axi",
			"clk_ipu_ahb",
			"clk_ipu_mm_axi",
			"clk_ipu_cam_axi",
			"clk_ipu_img_axi",
			"clk_top_syspll_d3",
			"clk_top_mmpll_d5",
			"clk_mm_ipu",
			"clk_mm_gals_m0_2x",
			"clk_mm_gals_m1_2x",
			"clk_mm_upsz0",
			"clk_mm_upsz1",
			"clk_mm_fifo0",
			"clk_mm_fifo1",
			"clk_mm_smi_common",
			"clk_mm_smi_common_2x",
			"mtcmos_mm0",
			"mtcmos_ipu";
	};

	smi_larb6@18001000 {
		compatible = "mediatek,smi_larb6";
		reg = <0 0x18001000 0 0x1000>;
		interrupts = <GIC_SPI 343 IRQ_TYPE_LEVEL_LOW>;
	};

	smi_larb3@18002000 {
		compatible = "mediatek,smi_larb3";
		reg = <0 0x18002000 0 0x1000>;
		interrupts = <GIC_SPI 358 IRQ_TYPE_LEVEL_LOW>;
	};

	cam1@18003000 {
		compatible = "mediatek,cam1";
		reg = <0 0x18003000 0 0x1000>;
		interrupts = <GIC_SPI 345 IRQ_TYPE_LEVEL_LOW>;
	};

	cam2@18004000 {
		compatible = "mediatek,cam2";
		reg = <0 0x18004000 0 0x1000>;
		interrupts = <GIC_SPI 346 IRQ_TYPE_LEVEL_LOW>;
	};

	cam3@18005000 {
		compatible = "mediatek,cam3";
		reg = <0 0x18005000 0 0x1000>;
		interrupts = <GIC_SPI 347 IRQ_TYPE_LEVEL_LOW>;
	};

	cam4@18006000 {
		compatible = "mediatek,cam4";
		reg = <0 0x18006000 0 0x1000>;
		interrupts = <GIC_SPI 348 IRQ_TYPE_LEVEL_LOW>;
	};

	cam5@18007000 {
		compatible = "mediatek,cam5";
		reg = <0 0x18007000 0 0x1000>;
		interrupts = <GIC_SPI 349 IRQ_TYPE_LEVEL_LOW>;
	};

	camsv_top@18050000 {
		compatible = "mediatek,camsv_top";
		reg = <0 0x18050000 0 0x1000>;
	};

	camsv@18050000 {
		compatible = "mediatek,camsv";
		reg = <0 0x18050000 0 0x1000>;
		interrupts = <GIC_SPI 350 IRQ_TYPE_LEVEL_LOW>;
	};

	camsv1@18051000 {
		compatible = "mediatek,camsv1";
		reg = <0 0x18051000 0 0x1000>;
		interrupts = <GIC_SPI 351 IRQ_TYPE_LEVEL_LOW>;
	};

	camsv2@18052000 {
		compatible = "mediatek,camsv2";
		reg = <0 0x18052000 0 0x1000>;
		interrupts = <GIC_SPI 352 IRQ_TYPE_LEVEL_LOW>;
	};

	camsv3@18053000 {
		compatible = "mediatek,camsv3";
		reg = <0 0x18053000 0 0x1000>;
		interrupts = <GIC_SPI 353 IRQ_TYPE_LEVEL_LOW>;
	};

	camsv4@18054000 {
		compatible = "mediatek,camsv4";
		reg = <0 0x18054000 0 0x1000>;
		interrupts = <GIC_SPI 354 IRQ_TYPE_LEVEL_LOW>;
	};

	camsv5@18055000 {
		compatible = "mediatek,camsv5";
		reg = <0 0x18055000 0 0x1000>;
		interrupts = <GIC_SPI 355 IRQ_TYPE_LEVEL_LOW>;
	};

	camsys_dfp@18008000 {
		compatible = "mediatek,camsys_dfp";
		reg = <0 0x18008000 0 0x1000>;
	};
	kd_camera_hw1:kd_camera_hw1@18040000 {
		compatible = "mediatek,camera_hw";
		reg = <0 0x18040000 0 0x1000>;  /* SENINF_ADDR */

		/* Camera Common Clock Framework (CCF) */
		clocks = <&topckgen CLK_TOP_CAMTG_SEL>,
		<&topckgen CLK_TOP_UNIVPLL_D26>,
		<&topckgen CLK_TOP_UNIVPLL2_D2>,
		<&topckgen CLK_TOP_CAM_SEL>,
		<&camsys CLK_CAMTG>,
		<&camsys CLK_CAM_SENINF>;
		clock-names = "TOP_CAMTG_SEL",
			"TOP_UNIVPLL_D26",
			"TOP_UNIVPLL2_D2",
			"TOP_CAM_SEL",
			"CG_CAMTG",
			"CG_CAM_SENINF";
	};
	kd_camera_hw2:kd_camera_hw2@18040000 {
		compatible = "mediatek,camera_hw2";
		reg = <0 0x18040000 0 0x1000>;  /* SENINF_ADDR */
	};

	seninf1_csi2@18040000 {
		compatible = "mediatek,seninf1_csi2";
		reg = <0 0x18040000 0 0x1000>;
	};

	seninf2_csi2@18041000 {
		compatible = "mediatek,seninf2_csi2";
		reg = <0 0x18041000 0 0x1000>;
	};

	seninf3_csi2@18042000 {
		compatible = "mediatek,seninf3_csi2";
		reg = <0 0x18042000 0 0x1000>;
	};

	seninf4_csi2@18043000 {
		compatible = "mediatek,seninf4_csi2";
		reg = <0 0x18043000 0 0x1000>;
	};

	seninf5_csi2@18044000 {
		compatible = "mediatek,seninf5_csi2";
		reg = <0 0x18044000 0 0x1000>;
	};

	seninf1@18040000 {
		compatible = "mediatek,seninf1";
		reg = <0 0x18040000 0 0x1000>;
	};

	seninf2@18041000 {
		compatible = "mediatek,seninf2";
		reg = <0 0x18041000 0 0x1000>;
	};

	seninf3@18042000 {
		compatible = "mediatek,seninf3";
		reg = <0 0x18042000 0 0x1000>;
	};

	seninf4@18043000 {
		compatible = "mediatek,seninf4";
		reg = <0 0x18043000 0 0x1000>;
	};

	seninf5@18044000 {
		compatible = "mediatek,seninf5";
		reg = <0 0x18044000 0 0x1000>;
	};

	seninf1_tg@18040000 {
		compatible = "mediatek,seninf1_tg";
		reg = <0 0x18040000 0 0x1000>;
	};

	seninf2_tg@18041000 {
		compatible = "mediatek,seninf2_tg";
		reg = <0 0x18041000 0 0x1000>;
	};

	seninf3_tg@18042000 {
		compatible = "mediatek,seninf3_tg";
		reg = <0 0x18042000 0 0x1000>;
	};

	seninf4_tg@18043000 {
		compatible = "mediatek,seninf4_tg";
		reg = <0 0x18043000 0 0x1000>;
	};

	seninf5_tg@18044000 {
		compatible = "mediatek,seninf5_tg";
		reg = <0 0x18044000 0 0x1000>;
	};

	seninf_top@18040000 {
		compatible = "mediatek,seninf_top";
		reg = <0 0x18040000 0 0x1000>;
	};

	seninf1_mux@18040000 {
		compatible = "mediatek,seninf1_mux";
		reg = <0 0x18040000 0 0x1000>;
	};

	seninf2_mux@18041000 {
		compatible = "mediatek,seninf2_mux";
		reg = <0 0x18041000 0 0x1000>;
	};

	seninf3_mux@18042000 {
		compatible = "mediatek,seninf3_mux";
		reg = <0 0x18042000 0 0x1000>;
	};

	seninf4_mux@18043000 {
		compatible = "mediatek,seninf4_mux";
		reg = <0 0x18043000 0 0x1000>;
	};

	seninf5_mux@18044000 {
		compatible = "mediatek,seninf5_mux";
		reg = <0 0x18044000 0 0x1000>;
	};

	seninf6_mux@18045000 {
		compatible = "mediatek,seninf6_mux";
		reg = <0 0x18045000 0 0x1000>;
	};

	seninf7_mux@18046000 {
		compatible = "mediatek,seninf7_mux";
		reg = <0 0x18046000 0 0x1000>;
	};

	seninf8_mux@18047000 {
		compatible = "mediatek,seninf8_mux";
		reg = <0 0x18047000 0 0x1000>;
	};

	mipi_rx_config_csi0@18040000 {
		compatible = "mediatek,mipi_rx_config_csi0";
		reg = <0 0x18040000 0 0x1000>;
	};

	mipi_rx_config_csi1@18041000 {
		compatible = "mediatek,mipi_rx_config_csi1";
		reg = <0 0x18041000 0 0x1000>;
	};

	mipi_rx_config_csi2@18042000 {
		compatible = "mediatek,mipi_rx_config_csi2";
		reg = <0 0x18042000 0 0x1000>;
	};

	mipi_rx_config_csi3@18043000 {
		compatible = "mediatek,mipi_rx_config_csi3";
		reg = <0 0x18043000 0 0x1000>;
	};

	mipi_rx_config_csi4@18044000 {
		compatible = "mediatek,mipi_rx_config_csi4";
		reg = <0 0x18044000 0 0x1000>;
	};

	cphy_tx_config@18040000 {
		compatible = "mediatek,cphy_tx_config";
		reg = <0 0x18040000 0 0x1000>;
	};

	scam@18044000 {
		compatible = "mediatek,scam";
		reg = <0 0x18044000 0 0x1000>;
	};

	ccir656@18044000 {
		compatible = "mediatek,ccir656";
		reg = <0 0x18044000 0 0x1000>;
	};

	n3d_ctl_a@18040000 {
		compatible = "mediatek,n3d_ctl_a";
		reg = <0 0x18040000 0 0x1000>;
	};

	n3d_ctl_b@18041000 {
		compatible = "mediatek,n3d_ctl_b";
		reg = <0 0x18041000 0 0x1000>;
	};

	ccu@18080000 {
		compatible = "mediatek,ccu";
		reg = <0 0x18080000 0 0x1000>;
		interrupts = <GIC_SPI 356 IRQ_TYPE_LEVEL_LOW>;
	};

	alc@60000000 {
		compatible = "mediatek,alc";
		reg = <0 0x60000000 0 0x1000>;
	};

	c2ksys@38000000 {
		compatible = "mediatek,c2ksys";
		reg = <0 0x38000000 0 0x1000>;
		interrupts = <GIC_SPI 360 IRQ_TYPE_EDGE_FALLING>;
	};

	mdcfgctl@a0000000 {
		compatible = "mediatek,mdcfgctl";
		reg = <0 0xa0000000 0 0x1000>;
	};

	mduart0@a0010000 {
		compatible = "mediatek,mduart0";
		reg = <0 0xa0010000 0 0x1000>;
	};

	mdgdma@a0020000 {
		compatible = "mediatek,mdgdma";
		reg = <0 0xa0020000 0 0x1000>;
	};

	mdgptm@a0030000 {
		compatible = "mediatek,mdgptm";
		reg = <0 0xa0030000 0 0x1000>;
	};

	usim1@a0040000 {
		compatible = "mediatek,usim1";
		reg = <0 0xa0040000 0 0x1000>;
	};

	usim2@a0050000 {
		compatible = "mediatek,usim2";
		reg = <0 0xa0050000 0 0x1000>;
	};

	mdperimisc@a0060000 {
		compatible = "mediatek,mdperimisc";
		reg = <0 0xa0060000 0 0x1000>;
	};

	mdcirq@a0070000 {
		compatible = "mediatek,mdcirq";
		reg = <0 0xa0070000 0 0x1000>;
	};

	dbgsys_1@a0080000 {
		compatible = "mediatek,dbgsys_1";
		reg = <0 0xa0080000 0 0x1000>;
	};

	dbgsys_2@a0090000 {
		compatible = "mediatek,dbgsys_2";
		reg = <0 0xa0090000 0 0x1000>;
	};

	dbgsys_3@a00a0000 {
		compatible = "mediatek,dbgsys_3";
		reg = <0 0xa00a0000 0 0x1000>;
	};

	dbgsys_4@a00b0000 {
		compatible = "mediatek,dbgsys_4";
		reg = <0 0xa00b0000 0 0x1000>;
	};

	ptp_therm_ctrl@a00c0000 {
		compatible = "mediatek,ptp_therm_ctrl";
		reg = <0 0xa00c0000 0 0x1000>;
	};

	mdtopsm@a00d0000 {
		compatible = "mediatek,mdtopsm";
		reg = <0 0xa00d0000 0 0x1000>;
	};

	mdostimer@a00e0000 {
		compatible = "mediatek,mdostimer";
		reg = <0 0xa00e0000 0 0x1000>;
	};

	mdrgu@a00f0000 {
		compatible = "mediatek,mdrgu";
		reg = <0 0xa00f0000 0 0x1000>;
	};

	i2c@a0100000 {
		compatible = "mediatek,i2c";
		reg = <0 0xa0100000 0 0x1000>;
	};

	mdeint@a0110000 {
		compatible = "mediatek,mdeint";
		reg = <0 0xa0110000 0 0x1000>;
	};

	mdsys_clkctl@a0120000 {
		compatible = "mediatek,mdsys_clkctl";
		reg = <0 0xa0120000 0 0x1000>;
	};

	mdtop_glbcon@a0130000 {
		compatible = "mediatek,mdtop_glbcon";
		reg = <0 0xa0130000 0 0x1000>;
	};

	mdtop_pllmixed@a0140000 {
		compatible = "mediatek,mdtop_pllmixed";
		reg = <0 0xa0140000 0 0x1000>;
	};

	mdtop_clksw@a0150000 {
		compatible = "mediatek,mdtop_clksw";
		reg = <0 0xa0150000 0 0x1000>;
	};

	mddbgmon@a0160000 {
		compatible = "mediatek,mddbgmon";
		reg = <0 0xa0160000 0 0x1000>;
	};

	md_lite_gptimer@a0170000 {
		compatible = "mediatek,md_lite_gptimer";
		reg = <0 0xa0170000 0 0x1000>;
	};

	mdperi_mbist@a0180000 {
		compatible = "mediatek,mdperi_mbist";
		reg = <0 0xa0180000 0 0x1000>;
	};

	sdf_top@a0190000 {
		compatible = "mediatek,sdf_top";
		reg = <0 0xa0190000 0 0x1000>;
	};

	mdgptm_l1@a01a0000 {
		compatible = "mediatek,mdgptm_l1";
		reg = <0 0xa01a0000 0 0x1000>;
	};

	md_lite_gptimer_l1@a01b0000 {
		compatible = "mediatek,md_lite_gptimer_l1";
		reg = <0 0xa01b0000 0 0x1000>;
	};

	mdmcu_macro_misc_reg@a0200000 {
		compatible = "mediatek,mdmcu_macro_misc_reg";
		reg = <0 0xa0200000 0 0x1000>;
	};

	mdmcu_pdamon@a0210000 {
		compatible = "mediatek,mdmcu_pdamon";
		reg = <0 0xa0210000 0 0x1000>;
	};

	mcusys_macro_mbistg@a0220000 {
		compatible = "mediatek,mcusys_macro_mbistg";
		reg = <0 0xa0220000 0 0x1000>;
	};

	mcusys_iocu_elm@a0230000 {
		compatible = "mediatek,mcusys_iocu_elm";
		reg = <0 0xa0230000 0 0x1000>;
	};

	mcusys_mdasm@a0240000 {
		compatible = "mediatek,mcusys_mdasm";
		reg = <0 0xa0240000 0 0x1000>;
	};

	mcusys_uls@a0250000 {
		compatible = "mediatek,mcusys_uls";
		reg = <0 0xa0250000 0 0x1000>;
	};

	mdmcu_macro_ao_misc_reg@a0260000 {
		compatible = "mediatek,mdmcu_macro_ao_misc_reg";
		reg = <0 0xa0260000 0 0x1000>;
	};

	mdmcu_misc_reg@a0300000 {
		compatible = "mediatek,mdmcu_misc_reg";
		reg = <0 0xa0300000 0 0x1000>;
	};

	mdmcu_busmon@a0310000 {
		compatible = "mediatek,mdmcu_busmon";
		reg = <0 0xa0310000 0 0x1000>;
	};

	mcusys_mbistg@a0320000 {
		compatible = "mediatek,mcusys_mbistg";
		reg = <0 0xa0320000 0 0x1000>;
	};

	mcusys_emi_elm@a0330000 {
		compatible = "mediatek,mcusys_emi_elm";
		reg = <0 0xa0330000 0 0x1000>;
	};

	mcusys_mo_bus_recoder@a0340000 {
		compatible = "mediatek,mcusys_mo_bus_recoder";
		reg = <0 0xa0340000 0 0x1000>;
	};

	mcusys_mm_bus_recoder@a0350000 {
		compatible = "mediatek,mcusys_mm_bus_recoder";
		reg = <0 0xa0350000 0 0x1000>;
	};

	ppc@a0400000 {
		compatible = "mediatek,ppc";
		reg = <0 0xa0400000 0 0x1000>;
	};

	soe@a0410000 {
		compatible = "mediatek,soe";
		reg = <0 0xa0410000 0 0x1000>;
	};

	mdinfrabusmon@a0420000 {
		compatible = "mediatek,mdinfrabusmon";
		reg = <0 0xa0420000 0 0x1000>;
	};

	mduart1@a0430000 {
		compatible = "mediatek,mduart1";
		reg = <0 0xa0430000 0 0x1000>;
	};

	mduart2@a0440000 {
		compatible = "mediatek,mduart2";
		reg = <0 0xa0440000 0 0x1000>;
	};

	mdinfrasys_mbist_cfg@a0450000 {
		compatible = "mediatek,mdinfrasys_mbist_cfg";
		reg = <0 0xa0450000 0 0x1000>;
	};

	mdsys_mbist_cfg@a0460000 {
		compatible = "mediatek,mdsys_mbist_cfg";
		reg = <0 0xa0460000 0 0x1000>;
	};

	ca7mdm@a0470000 {
		compatible = "mediatek,ca7mdm";
		reg = <0 0xa0470000 0 0x1000>;
	};

	l1mdm@a0480000 {
		compatible = "mediatek,l1mdm";
		reg = <0 0xa0480000 0 0x1000>;
	};

	mdm@a0490000 {
		compatible = "mediatek,mdm";
		reg = <0 0xa0490000 0 0x1000>;
	};

	mdsmicfg@a04a0000 {
		compatible = "mediatek,mdsmicfg";
		reg = <0 0xa04a0000 0 0x1000>;
	};

	mdinframisc@a04b0000 {
		compatible = "mediatek,mdinframisc";
		reg = <0 0xa04b0000 0 0x1000>;
	};

	mdbusrecorder@a04c0000 {
		compatible = "mediatek,mdbusrecorder";
		reg = <0 0xa04c0000 0 0x1000>;
	};

	mdloggdma@a04d0000 {
		compatible = "mediatek,mdloggdma";
		reg = <0 0xa04d0000 0 0x1000>;
	};

	mdasm@a04e0000 {
		compatible = "mediatek,mdasm";
		reg = <0 0xa04e0000 0 0x1000>;
	};

	mdmcu0_ccif@a0500000 {
		compatible = "mediatek,mdmcu0_ccif";
		reg = <0 0xa0500000 0 0x1000>;
	};

	mdmcu1_ccif@a0510000 {
		compatible = "mediatek,mdmcu1_ccif";
		reg = <0 0xa0510000 0 0x1000>;
	};

	mdelm_dma@a0520000 {
		compatible = "mediatek,mdelm_dma";
		reg = <0 0xa0520000 0 0x1000>;
	};

	mdelm_l1@a0530000 {
		compatible = "mediatek,mdelm_l1";
		reg = <0 0xa0530000 0 0x1000>;
	};

	ltel2sys@a0800000 {
		compatible = "mediatek,ltel2sys";
		reg = <0 0xa0800000 0 0x1000>;
	};

	l2ulsbdma@a0800000 {
		compatible = "mediatek,l2ulsbdma";
		reg = <0 0xa0800000 0 0x1000>;
	};

	l2ulhbdma@a0810000 {
		compatible = "mediatek,l2ulhbdma";
		reg = <0 0xa0810000 0 0x1000>;
	};

	l2dlsbdma@a0820000 {
		compatible = "mediatek,l2dlsbdma";
		reg = <0 0xa0820000 0 0x1000>;
	};

	l2dlhbdma@a0830000 {
		compatible = "mediatek,l2dlhbdma";
		reg = <0 0xa0830000 0 0x1000>;
	};

	l2mbist@a0840000 {
		compatible = "mediatek,l2mbist";
		reg = <0 0xa0840000 0 0x1000>;
	};

	l2pseuphy@a0850000 {
		compatible = "mediatek,l2pseuphy";
		reg = <0 0xa0850000 0 0x1000>;
	};

	l2hwlog@a0854000 {
		compatible = "mediatek,l2hwlog";
		reg = <0 0xa0854000 0 0x1000>;
	};

	l2ullogdma@a0858000 {
		compatible = "mediatek,l2ullogdma";
		reg = <0 0xa0858000 0 0x1000>;
	};

	l2dllogdma@a085c000 {
		compatible = "mediatek,l2dllogdma";
		reg = <0 0xa085c000 0 0x1000>;
	};

	l2soindma@a0860000 {
		compatible = "mediatek,l2soindma";
		reg = <0 0xa0860000 0 0x1000>;
	};

	l2sooutdma@a0870000 {
		compatible = "mediatek,l2sooutdma";
		reg = <0 0xa0870000 0 0x1000>;
	};

	l2ullmac_ch0@a0880000 {
		compatible = "mediatek,l2ullmac_ch0";
		reg = <0 0xa0880000 0 0x1000>;
	};

	l2ullmac_ch1@a0888000 {
		compatible = "mediatek,l2ullmac_ch1";
		reg = <0 0xa0888000 0 0x1000>;
	};

	l2dllmac@a0890000 {
		compatible = "mediatek,l2dllmac";
		reg = <0 0xa0890000 0 0x1000>;
	};

	l2calmac@a0898000 {
		compatible = "mediatek,l2calmac";
		reg = <0 0xa0898000 0 0x1000>;
	};

	l2ulfifomng@a08a0000 {
		compatible = "mediatek,l2ulfifomng";
		reg = <0 0xa08a0000 0 0x1000>;
	};

	l2dlfifomng@a08a4000 {
		compatible = "mediatek,l2dlfifomng";
		reg = <0 0xa08a4000 0 0x1000>;
	};

	l2sofifomng@a08a8000 {
		compatible = "mediatek,l2sofifomng";
		reg = <0 0xa08a8000 0 0x1000>;
	};

	l2sec@a08b0000 {
		compatible = "mediatek,l2sec";
		reg = <0 0xa08b0000 0 0x1000>;
	};

	l2ulsecctl@a08b4000 {
		compatible = "mediatek,l2ulsecctl";
		reg = <0 0xa08b4000 0 0x1000>;
	};

	l2dlsecctl@a08b8000 {
		compatible = "mediatek,l2dlsecctl";
		reg = <0 0xa08b8000 0 0x1000>;
	};

	l2sosecctl@a08bc000 {
		compatible = "mediatek,l2sosecctl";
		reg = <0 0xa08bc000 0 0x1000>;
	};

	l2misc@a08c0000 {
		compatible = "mediatek,l2misc";
		reg = <0 0xa08c0000 0 0x1000>;
	};

	l2dbgmon@a08d0000 {
		compatible = "mediatek,l2dbgmon";
		reg = <0 0xa08d0000 0 0x1000>;
	};

	l2ulbufmng@a08e0000 {
		compatible = "mediatek,l2ulbufmng";
		reg = <0 0xa08e0000 0 0x1000>;
	};

	l2dlbufmng@a08f0000 {
		compatible = "mediatek,l2dlbufmng";
		reg = <0 0xa08f0000 0 0x1000>;
	};

	hspal2_mbist@a0900000 {
		compatible = "mediatek,hspal2_mbist";
		reg = <0 0xa0900000 0 0x1000>;
	};

	hspal2_upa@a0920000 {
		compatible = "mediatek,hspal2_upa";
		reg = <0 0xa0920000 0 0x1000>;
	};

	hspal2_mac@a0930000 {
		compatible = "mediatek,hspal2_mac";
		reg = <0 0xa0930000 0 0x1000>;
	};

	hspal2_rlc@a0940000 {
		compatible = "mediatek,hspal2_rlc";
		reg = <0 0xa0940000 0 0x1000>;
	};

	ps_peri_confg@a0a00000 {
		compatible = "mediatek,ps_peri_confg";
		reg = <0 0xa0a00000 0 0x1000>;
	};

	byc_acc@a0a30000 {
		compatible = "mediatek,byc_acc";
		reg = <0 0xa0a30000 0 0x1000>;
	};

	uea_uia_1@a0a40000 {
		compatible = "mediatek,uea_uia_1";
		reg = <0 0xa0a40000 0 0x1000>;
	};

	uea_uia_0@a0a50000 {
		compatible = "mediatek,uea_uia_0";
		reg = <0 0xa0a50000 0 0x1000>;
	};

	rccif_md1_c2k@c0705000 {
		compatible = "mediatek,rccif_md1_c2k";
		reg = <0 0xc0705000 0 0x1000>;
	};

	rccif_c2k_md1@c0706000 {
		compatible = "mediatek,rccif_c2k_md1";
		reg = <0 0xc0706000 0 0x1000>;
	};

	c2k_rccif_md1_c2k@a0705000 {
		compatible = "mediatek,c2k_rccif_md1_c2k";
		reg = <0 0xa0705000 0 0x1000>;
	};

	c2k_rccif_c2k_md1@a0706000 {
		compatible = "mediatek,c2k_rccif_c2k_md1";
		reg = <0 0xa0706000 0 0x1000>;
	};

	c2k_ccif1@a0701000 {
		compatible = "mediatek,c2k_ccif1";
		reg = <0 0xa0701000 0 0x1000>;
	};

	mt6336_chr:mt6336_chr {
		compatible = "mediatek,mt6336_chr";
	};

	scpdvfs: scpdvfs@10001000 {
		compatible = "mediatek,mt6799-scpdvfs";
		clocks =
			<&topckgen CLK_TOP_SCP_SEL>,
			<&clk26m>,
			<&topckgen CLK_TOP_SYSPLL1_D2>,
			<&topckgen CLK_TOP_UNIVPLL1_D2>,
			<&topckgen CLK_TOP_SYSPLL_D3>,
			<&topckgen CLK_TOP_UNIVPLL_D3>,
			<&topckgen CLK_TOP_VCODECPLL_D7>,
			<&topckgen CLK_TOP_UNIVPLL2_D2>,
			<&topckgen CLK_TOP_UNIVPLL2_D4>;


		clock-names =
			"clk_mux",
			"clk_pll_0",
			"clk_pll_1",
			"clk_pll_2",
			"clk_pll_3",
			"clk_pll_4",
			"clk_pll_5",
			"clk_pll_6",
			"clk_pll_7";
	};

	irtx_pwm:irtx_pwm {
		compatible = "mediatek,irtx-pwm";
		pwm_ch = <4>;
		pwm_data_invert = <0>;
	};

	charger: charger {
		compatible = "mediatek,charger";
		algorithm_name = "SwitchCharging";
		/* enable_sw_jeita; */
		enable_pe_plus;
		enable_pe_2;
		enable_pe_3;

		enable_min_charge_temperature;
		min_charge_temperature = <0 >;
		min_charge_temperature_plus_x_degree = <6 >;
		max_charge_temperature = <50 >;
		max_charge_temperature_minus_x_degree = <47 >;

		usb_charger_current_suspend = <0 >;
		usb_charger_current_unconfigured = <70000 >;
		usb_charger_current_configured = <500000 >;
		usb_charger_current = <500000 >;
		ac_charger_current = <2050000 >;
		ac_charger_input_current = <3200000 >;
		non_std_ac_charger_current = <500000 >;
		charging_host_charger_current = <500000 >;

	};

	mt6336_charger {
		compatible = "mediatek,mt6336_charger";
		charger_name = "PrimarySWCHG";
		alias_name = "MT6336";
	};

	bat_notify {
		compatible = "mediatek,bat_notify";
	};

	battery_dts {
		compatible = "mediatek,battery";
	};

	bat_metter {
		compatible = "mediatek,bat_meter";
		/* cust_charging.h */
		/* stop charging while in talking mode */
		stop_charging_in_takling = <1 >;
		talking_recharge_voltage = <3800 >;
		talking_sync_time = <60 >;

		/* Battery Temperature Protection */
		mtk_temperature_recharge_support = <1 >;
		max_charge_temperature = <50 >;
		max_charge_temperature_minus_x_degree = <47 >;
		min_charge_temperature = <0 >;
		min_charge_temperature_plus_x_degree = <6 >;
		err_charge_temperature = <0xff >;

		/* Linear Charging Threshold */
		v_pre2cc_thres = <3400 >;	/* unit: mV */
		v_cc2topoff_thres = <4050 >;
		recharging_voltage = <4110 >;
		charging_full_current = <100 >;	/* unit: mA */

		/* Charging Current Setting */
		config_usb_if = <0 >;
		usb_charger_current_suspend = <0 >;	/* Unit: 0.01 mA */
		usb_charger_current_unconfigured = <7000 >;	/* Unit: 0.01 mA */
		usb_charger_current_configured = <50000 >;	/* Unit: 0.01 mA */
		usb_charger_current = <50000 >;	/* Unit: 0.01 mA */
		ac_charger_current = <80000 >;	/* Unit: 0.01 mA */
		non_std_ac_charger_current = <50000 >;	/* Unit: 0.01 mA */
		charging_host_charger_current = <65000 >;	/* Unit: 0.01 mA */
		apple_0_5a_charger_current = <50000 >;	/* Unit: 0.01 mA */
		apple_1_0a_charger_current = <65000 >;	/* Unit: 0.01 mA */
		apple_2_1a_charger_current = <80000 >;	/* Unit: 0.01 mA */


		/* charger error check */
		bat_low_temp_protect_enable = <0 >;
		v_charger_enable = <0 >;	/* 1:on , 0:off */
		v_charger_max = <6500 >;	/* unit: mV */
		v_charger_min = <4400 >;

		/*  Tracking TIME */
		onehundred_percent_tracking_time = <10 >;	/* Unit: second */
		npercent_tracking_time = <20 >;	/* Unit: second */
		sync_to_real_tracking_time = <60 >;	/* Unit: second */
		v_0percent_tracking = <3450 >;	/* Unit: mV */

		/* High battery support */
		high_battery_voltage_support = <0 >;

		/* cust_battery_meter.h */
		/* ADC resistor  */
		r_bat_sense = <4 >;
		r_i_sense = <4 >;
		r_charger_1 = <330 >;
		r_charger_2 = <39 >;
		temperature_t0 = <110 >;
		temperature_t1 = <0 >;
		temperature_t2 = <25 >;
		temperature_t3 = <50 >;
		temperature_t = <255 >;	/* this should be fixed, never change the value */
		fg_meter_resistance = <0 >;

		/* Qmax for 0mA */
		q_max_pos_50 = <2743 >;
		q_max_pos_25 = <2707 >;
		q_max_pos_0 = <840 >;
		q_max_neg_10 = <807 >;
		/* Qmax for 400mA, said high current */
		q_max_pos_50_h_current = <2688 >;
		q_max_pos_25_h_current = <2653 >;
		q_max_pos_0_h_current = <823 >;
		q_max_neg_10_h_current = <791 >;
		/* Discharge percentage, 1: D5, 0: D2 */
		oam_d5 = <1 >;

		change_tracking_point = <1 >;
		/* SW OCV tracking setting */
		cust_tracking_point = <0 >;
		cust_r_sense = <56 >;
		cust_hw_cc = <0 >;
		aging_tuning_value = <103 >;
		cust_r_fg_offset = <0 >;
		ocv_board_compesate = <0 >;
		r_fg_board_base = <1000 >;
		r_fg_board_slope = <1000 >;
		car_tune_value = <118 >;

		/* HW Fuel gague  */
		current_detect_r_fg = <10 >;	/* Unit: mA */
		minerroroffset = <1000 >;
		fg_vbat_average_size = <18 >;
		r_fg_value = <10 >;	/* Unit: mOhm */

		/* HW Fuel gague 2.0*/
		difference_hwocv_rtc = <30 >;
		difference_hwocv_swocv = <10>;
		difference_swocv_rtc = <10>;
		max_swocv = <3>;

		difference_voltage_update = <20>;
		aging1_load_soc = <70>;
		aging1_update_soc = <30>;
		batterypseudo100 = <95>;
		batterypseudo1 = <11>;

		q_max_by_sys = <1>;			/*8. qmax variant by system drop voltage.*/
		q_max_sys_voltage = <3350>;
		shutdown_gauge0 = <1>;
		shutdown_gauge1_xmins = <1>;
		shutdown_gauge1_mins = <60>;

		shutdown_system_voltage = <3400>;
		charge_tracking_time = <60>;
		discharge_tracking_time = <10>;

		recharge_tolerance = <10>;

		sync_ui_soc_imm =<0>;
		mtk_enable_aging_algorithm = <1>;
		md_sleep_current_check = <1>;
		q_max_by_current = <0>;

		/* HW Fuel gague 1.0*/
		cust_poweron_delta_capacity_tolrance = <40 >;
		cust_poweron_low_capacity_tolrance = <5 >;
		cust_poweron_max_vbat_tolrance = <90 >;
		cust_poweron_delta_vbat_tolrance = <30 >;
		cust_poweron_delta_hw_sw_ocv_capacity_tolrance = <10 >;

		/* Fixed battery temperature */
		fixed_tbat_25 = <0 >;
		/* Dynamic change wake up period of battery thread when suspend */
		vbat_normal_wakeup = <3600 >;	/* Unit: mV */
		vbat_low_power_wakeup = <3500 >;	/* Unit: mV */
		normal_wakeup_period = <5400 >;	/* Unit: second */
		low_power_wakeup_period = <300 >;	/* Unit: second */
		close_poweroff_wakeup_period = <30 >;	/* Unit: second */

		rbat_pull_up_r = <24000 >;
		rbat_pull_up_volt = <1800 >;

		batt_temperature_table_num = <17 >;
		batt_temperature_table = <
				(-20) 68237
				(-15) 53650
				(-10) 42506
				(-5) 33892
				0 27219
				5 22021
				10 17926
				15 14674
				20 12081
				25 10000
				30 8315
				35 6948
				40 5834
				45 4917
				50 4161
				55 3535
				60 3014>;
		battery_profile_t0_num = <82 >;
		battery_profile_t0 = <0  4303
				6 4281
				13 4261
				18 4240
				25 4217
				31 4194
				38 4169
				44 4145
				51 4117
				56 4088
				62 4068
				69 4047
				75 4019
				82 3997
				87 3981
				94 3967
				100 3956
				107 3942
				113 3929
				118 3913
				125 3895
				128 3880
				135 3869
				141 3857
				147 3848
				154 3839
				159 3830
				166 3823
				172 3818
				179 3811
				185 3806
				192 3800
				197 3796
				203 3791
				210 3787
				216 3781
				223 3775
				228 3770
				235 3760
				241 3752
				248 3742
				254 3731
				259 3721
				266 3713
				272 3704
				279 3698
				285 3688
				292 3665
				297 3613
				304 3526
				307 3466
				310 3444
				313 3424
				313 3404>;
		battery_profile_t1_num = <82 >;
		battery_profile_t1 = <0  4316
				7 4283
				12 4244
				20 4210
				22 4185
				29 4164
				34 4144
				41 4128
				49 4109
				54 4093
				61 4080
				63 4069
				71 4047
				78 4023
				83 4003
				90 3989
				95 3977
				100 3967
				105 3955
				112 3940
				120 3923
				124 3907
				132 3891
				139 3877
				141 3864
				149 3855
				154 3846
				161 3837
				166 3831
				173 3823
				181 3815
				183 3811
				190 3804
				195 3799
				202 3794
				210 3790
				215 3785
				222 3782
				224 3778
				232 3773
				237 3768
				244 3761
				251 3753
				256 3742
				261 3727
				266 3712
				273 3704
				278 3701
				285 3698
				293 3692
				298 3680
				302 3625
				307 3528
				315 3472
				322 3403
				324 3323
				324 3267
				324 3230
				327 3203
				327 3180
				327 3157
				327 3141
				327 3124
				327 3109
				327 3096
				327 3084
				327 3079
				327 3067
				327 3058
				327 3047
				327 3041
				327 3032
				327 3029
				327 3018
				327 3008
				327 3002
				327 3003
				327 2995
				327 2985
				327 2983
				327 2979
				327 2967>;
		battery_profile_t2_num = <82 >;
		battery_profile_t2 = <0 4328
				2 4303
				4 4283
				5 4263
				7 4245
				9 4227
				11 4209
				13 4189
				14 4173
				16 4155
				19 4138
				21 4121
				22 4104
				24 4087
				26 4072
				28 4058
				30 4041
				31 4025
				33 4011
				35 3996
				37 3983
				39 3972
				40 3958
				42 3945
				44 3926
				46 3907
				48 3889
				49 3876
				52 3865
				54 3854
				56 3846
				57 3840
				59 3832
				61 3824
				63 3818
				65 3813
				66 3805
				68 3801
				70 3794
				72 3789
				74 3784
				75 3778
				77 3772
				79 3765
				81 3753
				84 3745
				85 3733
				87 3717
				89 3699
				91 3692
				92 3691
				94 3689
				96 3687
				98 3668
				100 3597
				101 3497
				103 3391
				104 3157
				105 3073
				105 3022
				105 2992
				105 2969
				105 2958
				105 2946
				105 2934
				105 2925
				105 2913
				105 2910
				105 2900
				105 2891
				105 2891
				105 2891
				105 2891
				105 2891
				105 2891
				105 2891
				105 2891
				105 2891
				105 2891
				105 2891
				105 2891
				105 2891>;
		battery_profile_t3_num = <82 >;
		battery_profile_t3 = <0 4331
				2 4305
				3 4284
				5 4265
				7 4244
				10 4225
				11 4206
				13 4188
				15 4170
				16 4153
				18 4135
				20 4119
				22 4102
				23 4085
				26 4069
				28 4054
				29 4038
				31 4023
				33 4010
				35 3996
				36 3984
				38 3970
				40 3958
				41 3947
				44 3934
				46 3921
				47 3904
				49 3884
				51 3868
				53 3857
				54 3848
				56 3838
				59 3832
				60 3824
				62 3817
				64 3811
				66 3806
				67 3800
				69 3794
				71 3790
				72 3784
				74 3777
				77 3763
				79 3758
				80 3750
				82 3742
				84 3733
				85 3723
				87 3709
				89 3694
				91 3678
				93 3676
				95 3675
				97 3674
				98 3669
				100 3625
				102 3547
				104 3495
				105 3458
				107 3331
				109 3140
				109 3078
				109 3033
				109 3001
				109 2980
				110 2960
				110 2944
				110 2932
				110 2921
				110 2913
				110 2903
				110 2899
				110 2889
				110 2889
				110 2889
				110 2889
				110 2889
				110 2889
				110 2889
				110 2889
				110 2889
				110 2889>;
		r_profile_t0_num = <82 >;
		r_profile_t0 = <408 4303
				408 4281
				415 4261
				425 4240
				430 4217
				440 4194
				463 4169
				490 4145
				525 4117
				573 4088
				615 4068
				650 4047
				675 4019
				685 3997
				705 3981
				713 3967
				720 3956
				733 3942
				728 3929
				738 3913
				725 3895
				735 3880
				745 3869
				748 3857
				760 3848
				773 3839
				783 3830
				803 3823
				820 3818
				835 3811
				863 3806
				888 3800
				903 3796
				925 3791
				955 3787
				975 3781
				1000 3775
				1035 3770
				1058 3760
				1090 3752
				1105 3742
				1135 3731
				1168 3721
				1210 3713
				1255 3704
				1345 3698
				1430 3688
				1518 3665
				1570 3613
				1618 3526
				1668 3466
				1613 3444
				1563 3424
				1510 3404
				1460 3381
				1400 3357
				1333 3332
				1283 3310
				1233 3291
				1198 3274
				1155 3259
				1128 3245
				1093 3234
				1075 3221
				1053 3212
				1023 3204
				1018 3193
				1005 3186
				978 3179
				960 3168
				940 3162
				895 3157
				890 3151
				863 3143
				925 3133
				893 3125
				893 3125
				893 3125
				893 3125
				893 3125
				893 3125
				893 3125>;
		r_profile_t1_num = <82 >;
		r_profile_t1 = <258 4316
				258 4283
				278 4244
				303 4210
				333 4185
				343 4164
				350 4144
				365 4128
				370 4109
				370 4093
				380 4080
				403 4069
				395 4047
				403 4023
				403 4003
				413 3989
				418 3977
				420 3967
				423 3955
				415 3940
				410 3923
				400 3907
				393 3891
				393 3877
				388 3864
				395 3855
				403 3846
				405 3837
				415 3831
				425 3823
				430 3815
				443 3811
				450 3804
				465 3799
				475 3794
				483 3790
				490 3785
				503 3782
				520 3778
				533 3773
				545 3768
				563 3761
				588 3753
				600 3742
				608 3727
				615 3712
				635 3704
				670 3701
				710 3698
				765 3692
				840 3680
				880 3625
				915 3528
				1080 3472
				1323 3403
				1315 3323
				1180 3267
				1080 3230
				1010 3203
				958 3180
				925 3157
				888 3141
				860 3124
				810 3109
				788 3096
				765 3084
				700 3079
				745 3067
				680 3058
				685 3047
				650 3041
				683 3032
				615 3029
				643 3018
				660 3008
				635 3002
				530 3003
				640 2995
				595 2985
				535 2983
				463 2979
				600 2967>;
		r_profile_t2_num = <82 >;
		r_profile_t2 = <155 4328
				155 4303
				155 4283
				158 4263
				158 4245
				163 4227
				165 4209
				165 4189
				170 4173
				170 4155
				173 4138
				173 4121
				173 4104
				178 4087
				180 4072
				185 4058
				188 4041
				190 4025
				200 4011
				200 3996
				205 3983
				218 3972
				215 3958
				215 3945
				200 3926
				188 3907
				173 3889
				168 3876
				163 3865
				160 3854
				163 3846
				168 3840
				170 3832
				170 3824
				170 3818
				178 3813
				175 3805
				183 3801
				180 3794
				183 3789
				185 3784
				183 3778
				185 3772
				183 3765
				173 3753
				173 3745
				173 3733
				173 3717
				173 3699
				170 3692
				175 3691
				185 3689
				198 3687
				205 3668
				208 3597
				240 3497
				273 3391
				908 3157
				705 3073
				595 3022
				513 2992
				465 2969
				413 2958
				380 2946
				368 2934
				360 2925
				335 2913
				275 2910
				315 2900
				283 2891
				283 2891
				283 2891
				283 2891
				283 2891
				283 2891
				283 2891
				283 2891
				283 2891
				283 2891
				283 2891
				283 2891
				283 2891>;
		r_profile_t3_num = <82 >;
		r_profile_t3 = <123 4331
				123 4305
				128 4284
				130 4265
				130 4244
				130 4225
				128 4206
				125 4188
				130 4170
				133 4153
				133 4135
				138 4119
				138 4102
				140 4085
				140 4069
				143 4054
				140 4038
				143 4023
				148 4010
				153 3996
				155 3984
				155 3970
				165 3958
				175 3947
				175 3934
				178 3921
				170 3904
				148 3884
				135 3868
				135 3857
				133 3848
				133 3838
				135 3832
				135 3824
				135 3817
				143 3811
				145 3806
				148 3800
				145 3794
				153 3790
				150 3784
				150 3777
				133 3763
				143 3758
				140 3750
				138 3742
				135 3733
				135 3723
				133 3709
				133 3694
				130 3678
				130 3676
				138 3675
				148 3674
				160 3669
				158 3625
				170 3547
				208 3495
				220 3458
				265 3331
				855 3140
				725 3078
				600 3033
				528 3001
				460 2980
				400 2960
				380 2944
				355 2932
				315 2921
				303 2913
				308 2903
				255 2899
				273 2889
				273 2889
				273 2889
				273 2889
				273 2889
				273 2889
				273 2889
				273 2889
				273 2889
				273 2889>;
	};

#if (CONFIG_MTK_GAUGE_VERSION == 30)
	#include "battery_prop.dtsi"
#endif

	mt_charger: mt_charger {
		compatible = "mediatek,mt-charger";
	};

	pmic_clock_buffer_ctrl:pmic_clock_buffer_ctrl {
		compatible = "mediatek,pmic_clock_buffer";
		mediatek,clkbuf-quantity = <7>;
		mediatek,clkbuf-config = <2 1 1 2 0 1 1>;
		mediatek,clkbuf-driving-current = <(-1) (-1) (-1) (-1) (-1) (-1) (-1)>;
	};

	nfc: nfc {
		compatible = "mediatek,mediatek,nfc-gpio-v2";
	};

	gps {
		compatible = "mediatek,gps";
	};

	goodix_fp: goodix_fp {
		compatible = "mediatek,fix_build_error";
	};

	irq_nfc: irq_nfc {
		compatible = "mediatek,irq_nfc-eint";
	};

	als: als_ps@0 {
		compatible = "mediatek,als_ps";
	};

	rgbw: rgbw@0 {
		compatible = "mediatek,rgbw";
	};

	mse: mse {
		compatible = "mediatek,fix_build_error";
	};

	vproc_buck: vproc_buck {
		compatible = "mediatek,fix_build_error";
	};

	touch: touch {
		compatible = "mediatek,mt6799-touch";
	};

	wifi: wifi {
		compatible = "mediatek,fix_build_error";
	};

	otg_iddig: otg_iddig {
		compatible = "mediatek,usb_iddig_bi_eint";
	};

	rt9465_slave_chr: rt9465_slave_chr {
		compatible = "richtek,rt9465";
	};

	rt1711_pd_ctrl: rt1711_pd_ctrl {
		compatible = "richtek,rt1711h_pd";
	};

	rt9750_chr_1: rt9750_chr_1 {
		compatible = "richtek,rt9750";
	};

	rt9750_chr_2: rt9750_chr_2 {
		compatible = "richtek,rt9750";
	};

	smart_pa: smart_pa {
		compatible = "mediatek,fix_build_error";
	};

	flashlight_core: flashlight_core {
		compatible = "mediatek,flashlight_core";
	};

	flashlights_mt6336: flashlights_mt6336 {
		compatible = "mediatek,flashlights_mt6336";
	};

	cam_cal_drv{
		compatible = "mediatek,cam_cal_drv";
		main_bus = <2>;
		sub_bus = <3>;
		main2_bus = <3>;
	};

	irlearning-spi {
		compatible = "mediatek,irlearning-spi";
		spi_clock = <109000000>;
		spi_data_invert = <0>;
		spi_cs_invert = <1>;
	};


};

#include "mt6335.dtsi"

#include "cust_mt6799_msdc.dtsi"
