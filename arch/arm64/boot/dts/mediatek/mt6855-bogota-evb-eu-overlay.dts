/* Copyright (c) 2019, Motorola Mobility Inc. All rights reserved.
 *
 * This program is free software; you can redistribute it and/or modify
 * it under the terms of the GNU General Public License version 2 and
 * only version 2 as published by the Free Software Foundation.
 *
 * This program is distributed in the hope that it will be useful,
 * but WITHOUT ANY WARRANTY; without even the implied warranty of
 * MERCHANTABILITY or FITNESS FOR A PARTICULAR PURPOSE.  See the
 * GNU General Public License for more details.
 */

/dts-v1/;
/plugin/;

#include "mediatek/mt6855-bogota-common-overlay.dtsi"
#define BOGOTA_RADIO_ID 6

/* Board match root node */
/ {
        fragment@model {
                target-path = "/";
                __overlay__ {
			mot,model = "bogota";
                        mot,board-id = <(BOGOTA_RADIO_ID << 8 | 0x4A) 0xA100>;
                };
        };
};
#include <bogota_evb/cust.dtsi>
#include "mediatek/bogota-charger-6000mah-overlay.dtsi"
/*End of this file, DO NOT ADD ANYTHING HERE*/

