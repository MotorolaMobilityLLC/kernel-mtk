/*
 * Copyright (C) 2016 MediaTek Inc.
 *
 * This program is free software; you can redistribute it and/or modify
 * it under the terms of the GNU General Public License version 2 as
 * published by the Free Software Foundation.
 *
 * This program is distributed in the hope that it will be useful,
 * but WITHOUT ANY WARRANTY; without even the implied warranty of
 * MERCHANTABILITY or FITNESS FOR A PARTICULAR PURPOSE.
 * See http://www.gnu.org/licenses/gpl-2.0.html for more details.
 */

bat_gm30 : battery
{
	compatible = "mediatek,bat_gm30";
	DIFFERENCE_FULLOCV_ITH = <(200)>; /*	Charging termination current.*/
	MTK_CHR_EXIST =
	    <(1)>; /*	Configures whether MTK charger exist or not.*/
	SHUTDOWN_1_TIME =
	    <(60)>; /*	Configures how long should ui_soc keep showing 1%.*/
	KEEP_100_PERCENT =
	    <(2)>;
	/* Configures how long should ui_soc keeps 100% after unplugged.*/
	R_FG_VALUE = <(10)>; /*	R_sense resistance.*/
	EMBEDDED_SEL =
	    <(0)>; /*	Configures whether using embedded battery or not.*/
	PMIC_SHUTDOWN_CURRENT = <(20)>; /* System shutdown current.*/
	FG_METER_RESISTANCE = <(75)>;   /* The resistance of PCB*/
	CAR_TUNE_VALUE = <(100)>;       /* Tune value for current measurement.*/
	TEMPERATURE_T0 = <(25)>;	/* Battery temperature T0*/
	TEMPERATURE_T1 = <(10)>;	/* Battery temperature T1*/
	TEMPERATURE_T2 = <(0)>;		/* Battery temperature T2*/
	TEMPERATURE_T3 = <(-10)>;       /* Battery temperature T3*/
	g_FG_PSEUDO100_T0 = <(98)>;     /* Pseudo 100% percentage at T0.*/
	g_FG_PSEUDO100_T1 = <(95)>;     /* Pseudo 100% percentage at T1.*/
	g_FG_PSEUDO100_T2 = <(90)>;     /* Pseudo 100% percentage at T2.*/
	g_FG_PSEUDO100_T3 = <(80)>;     /* Pseudo 100% percentage at T3.*/
	Q_MAX_SYS_VOLTAGE_BAT0 = <(3400)>; /*	System shut down voltage.*/
	Q_MAX_SYS_VOLTAGE_BAT1 = <(3400)>; /*	System shut down voltage.*/
	Q_MAX_SYS_VOLTAGE_BAT2 = <(3400)>; /*	System shut down voltage.*/
	Q_MAX_SYS_VOLTAGE_BAT3 = <(3400)>; /*	System shut down voltage.*/
	PSEUDO1_IQ_OFFSET_BAT0 = <(0)>;    /*	Pseudo1 offset.*/
	PSEUDO1_IQ_OFFSET_BAT1 = <(0)>;    /*	Pseudo1 offset.*/
	PSEUDO1_IQ_OFFSET_BAT2 = <(0)>;    /*	Pseudo1 offset.*/
	PSEUDO1_IQ_OFFSET_BAT3 = <(0)>;    /*	Pseudo1 offset.*/
#if (CONFIG_MTK_ADDITIONAL_BATTERY_TABLE == 1)
#include "mt6757_battery_table_ext.dtsi"
#else
#include "mt6757_battery_table.dtsi"
#endif
};
