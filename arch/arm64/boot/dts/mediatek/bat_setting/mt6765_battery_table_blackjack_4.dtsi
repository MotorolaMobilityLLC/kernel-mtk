&bat_gm30
{
	battery3_name ="JK50-SB18C46718-5000mah";

	battery3_profile_t0_num = <100>;
	battery3_profile_t0 =
	<
	0	43730	1030
	497	43591	1030
	995	43451	1020
	1492	43332	1050
	1989	43203	1050
	2486	43083	1050
	2984	42964	1050
	3481	42835	1050
	3978	42706	1021
	4476	42595	1077
	4973	42467	1052
	5470	42347	1050
	5968	42228	1078
	6465	42109	1052
	6962	41989	1078
	7459	41870	1052
	7957	41751	1077
	8454	41640	1080
	8951	41522	1080
	9449	41403	1080
	9946	41292	1080
	10443	41183	1080
	10940	41073	1080
	11438	40964	1097
	11935	40854	1074
	12432	40754	1079
	12930	40646	1097
	13427	40545	1100
	13924	40445	1100
	14422	40346	1100
	14919	40246	1100
	15416	40155	1100
	15913	40066	1125
	16411	39968	1105
	16908	39885	1141
	17405	39797	1174
	17903	39716	1180
	18400	39628	1172
	18897	39539	1194
	19394	39449	1200
	19892	39352	1200
	20389	39221	1146
	20886	39082	1084
	21384	38966	1055
	21881	38879	1050
	22378	38807	1073
	22876	38730	1058
	23373	38665	1050
	23870	38606	1072
	24367	38546	1058
	24865	38486	1050
	25362	38434	1050
	25859	38384	1050
	26357	38334	1050
	26854	38292	1064
	27351	38252	1070
	27848	38205	1077
	28346	38162	1080
	28843	38116	1059
	29340	38080	1084
	29838	38050	1120
	30335	38013	1110
	30832	37973	1100
	31329	37940	1100
	31827	37917	1133
	32324	37884	1137
	32821	37851	1143
	33319	37815	1150
	33816	37756	1118
	34313	37680	1087
	34811	37594	1061
	35308	37523	1050
	35805	37469	1068
	36302	37426	1080
	36800	37380	1080
	37297	37336	1092
	37794	37296	1088
	38292	37257	1080
	38789	37217	1080
	39286	37183	1109
	39783	37136	1096
	40281	37076	1087
	40778	37017	1083
	41275	36957	1087
	41773	36892	1100
	42270	36817	1062
	42767	36769	1041
	43265	36749	1013
	43762	36735	1043
	44259	36725	1126
	44756	36705	1176
	45254	36660	1225
	45751	36509	1190
	46248	36191	1140
	46746	35724	1160
	47243	35105	1209
	47740	34230	1288
	48237	33680	1330
	48735	33680	1330
	49232	33680	1330
	>;
	battery3_profile_t1_num = <100>;
	battery3_profile_t1 =
	<
	0	43980	1250
	497	43831	1250
	995	43691	1220
	1492	43572	1250
	1989	43442	1230
	2486	43323	1220
	2984	43203	1249
	3481	43074	1231
	3978	42954	1249
	4476	42835	1231
	4973	42716	1249
	5470	42596	1250
	5968	42467	1231
	6465	42357	1249
	6962	42238	1250
	7459	42118	1250
	7957	41999	1250
	8454	41880	1250
	8951	41769	1277
	9449	41660	1280
	9946	41541	1271
	10443	41431	1297
	10940	41321	1300
	11438	41212	1327
	11935	41102	1330
	12432	40993	1304
	12930	40892	1326
	13427	40801	1347
	13924	40712	1376
	14422	40605	1397
	14919	40495	1400
	15416	40386	1400
	15913	40276	1400
	16411	40175	1425
	16908	40084	1447
	17405	39995	1450
	17903	39905	1450
	18400	39824	1467
	18897	39761	1519
	19394	39676	1530
	19892	39579	1506
	20389	39479	1500
	20886	39364	1460
	21384	39244	1394
	21881	39117	1293
	22378	39011	1278
	22876	38927	1241
	23373	38848	1230
	23870	38776	1207
	24367	38721	1239
	24865	38656	1235
	25362	38602	1230
	25859	38560	1245
	26357	38505	1235
	26854	38460	1230
	27351	38413	1230
	27848	38370	1245
	28346	38331	1250
	28843	38291	1250
	29340	38251	1250
	29838	38211	1250
	30335	38171	1250
	30832	38139	1250
	31329	38109	1250
	31827	38086	1285
	32324	38052	1279
	32821	38026	1291
	33319	37999	1279
	33816	37976	1311
	34313	37950	1330
	34811	37920	1310
	35308	37883	1280
	35805	37843	1270
	36302	37804	1270
	36800	37764	1257
	37297	37731	1250
	37794	37688	1250
	38292	37644	1237
	38789	37611	1230
	39286	37575	1230
	39783	37541	1230
	40281	37505	1230
	40778	37459	1242
	41275	37403	1250
	41773	37344	1250
	42270	37290	1250
	42767	37228	1250
	43265	37147	1238
	43762	37081	1242
	44259	37048	1238
	44756	37034	1242
	45254	37024	1267
	45751	37009	1291
	46248	36977	1317
	46746	36904	1358
	47243	36671	1352
	47740	36239	1341
	48237	35649	1405
	48735	34830	1493
	49232	34390	1530
	>;
	battery3_profile_t2_num = <100>;
	battery3_profile_t2 =
	<
	0	43700	2620
	497	43580	2620
	995	43451	2570
	1492	43341	2600
	1989	43232	2600
	2486	43112	2551
	2984	42983	2570
	3481	42863	2551
	3978	42734	2473
	4476	42624	2547
	4973	42495	2502
	5470	42375	2500
	5968	42256	2471
	6465	42145	2546
	6962	42008	2484
	7459	41896	2499
	7957	41787	2547
	8454	41658	2503
	8951	41548	2528
	9449	41429	2530
	9946	41318	2530
	10443	41218	2594
	10940	41091	2573
	11438	40980	2597
	11935	40870	2600
	12432	40761	2582
	12930	40660	2598
	13427	40569	2627
	13924	40471	2648
	14422	40389	2765
	14919	40283	2798
	15416	40120	2756
	15913	39960	2706
	16411	39827	2726
	16908	39697	2704
	17405	39585	2639
	17903	39510	2690
	18400	39423	2674
	18897	39316	2593
	19394	39224	2572
	19892	39117	2494
	20389	39016	2438
	20886	38925	2388
	21384	38843	2397
	21881	38747	2342
	22378	38664	2330
	22876	38593	2305
	23373	38515	2324
	23870	38443	2289
	24367	38390	2296
	24865	38332	2300
	25362	38280	2324
	25859	38206	2282
	26357	38166	2317
	26854	38121	2330
	27351	38071	2330
	27848	38029	2346
	28346	37989	2350
	28843	37941	2373
	29340	37892	2357
	29838	37857	2388
	30335	37827	2400
	30832	37797	2423
	31329	37767	2445
	31827	37730	2413
	32324	37705	2459
	32821	37678	2473
	33319	37655	2514
	33816	37628	2508
	34313	37598	2500
	34811	37568	2478
	35308	37553	2492
	35805	37529	2479
	36302	37513	2491
	36800	37496	2521
	37297	37469	2565
	37794	37446	2580
	38292	37412	2580
	38789	37386	2615
	39286	37352	2609
	39783	37306	2586
	40281	37256	2594
	40778	37206	2647
	41275	37150	2690
	41773	37097	2720
	42270	37040	2730
	42767	36967	2796
	43265	36887	2830
	43762	36827	2876
	44259	36784	2932
	44756	36764	3047
	45254	36734	3151
	45751	36701	3288
	46248	36671	3489
	46746	36597	3746
	47243	36379	4019
	47740	35972	4344
	48237	35388	4876
	48735	34581	5832
	49232	34230	6280
	>;
	battery3_profile_t3_num = <100>;
	battery3_profile_t3 =
	<
	0	43910	7080
	497	43731	7080
	995	43571	7080
	1492	43442	7129
	1989	43302	7051
	2486	43173	7030
	2984	43043	6952
	3481	42914	6901
	3978	42794	6881
	4476	42674	6832
	4973	42555	6782
	5470	42436	6751
	5968	42307	6684
	6465	42196	6633
	6962	42077	6583
	7459	41958	6552
	7957	41848	6550
	8454	41738	6531
	8951	41619	6475
	9449	41509	6479
	9946	41390	6434
	10443	41271	6384
	10940	41160	6353
	11438	41051	6350
	11935	40950	6350
	12432	40851	6350
	12930	40760	6377
	13427	40653	6380
	13924	40534	6371
	14422	40380	6309
	14919	40212	6239
	15416	40051	6161
	15913	39892	6064
	16411	39758	6033
	16908	39646	6004
	17405	39554	6000
	17903	39472	6000
	18400	39393	6000
	18897	39313	5958
	19394	39233	5950
	19892	39162	5950
	20389	39092	5975
	20886	39014	5939
	21384	38943	5946
	21881	38865	5950
	22378	38793	5974
	22876	38732	5996
	23373	38664	6024
	23870	38602	6046
	24367	38543	6074
	24865	38483	6119
	25362	38423	6130
	25859	38371	6169
	26357	38321	6195
	26854	38271	6239
	27351	38229	6288
	27848	38182	6323
	28346	38140	6368
	28843	38100	6418
	29340	38060	6445
	29838	38028	6510
	30335	37990	6530
	30832	37958	6567
	31329	37928	6631
	31827	37905	6686
	32324	37885	6758
	32821	37866	6816
	33319	37839	6866
	33816	37816	6930
	34313	37803	7000
	34811	37786	7097
	35308	37766	7165
	35805	37746	7264
	36302	37719	7335
	36800	37696	7439
	37297	37676	7562
	37794	37650	7682
	38292	37620	7794
	38789	37583	7910
	39286	37550	8083
	39783	37507	8216
	40281	37464	8368
	40778	37417	8541
	41275	37368	8743
	41773	37318	8949
	42270	37262	9219
	42767	37195	9502
	43265	37132	9821
	43762	37079	10232
	44259	37029	10712
	44756	36979	11290
	45254	36935	12035
	45751	36883	12918
	46248	36818	13978
	46746	36712	15153
	47243	36546	16240
	47740	36286	17083
	48237	35877	17923
	48735	35309	18281
	49232	34450	16130
	>;

};
