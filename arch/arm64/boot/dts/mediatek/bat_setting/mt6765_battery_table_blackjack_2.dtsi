
&bat_gm30
{
	battery1_name ="JK50-SCUD-SB18C28956-5000mah";

	battery1_profile_t0_num = <100>;
	battery1_profile_t0 =
	<
	0	43868	1039
	506	43736	1038
	1012	43613	1038
	1518	43498	1054
	2024	43387	1066
	2530	43268	1054
	3036	43152	1054
	3542	43026	1067
	4048	42904	1062
	4555	42788	1082
	5061	42657	1056
	5567	42537	1076
	6073	42413	1070
	6579	42292	1070
	7085	42173	1075
	7591	42049	1074
	8097	41934	1085
	8603	41815	1085
	9109	41695	1080
	9615	41576	1085
	10121	41461	1096
	10627	41352	1109
	11133	41238	1102
	11639	41124	1104
	12145	41010	1108
	12652	40900	1101
	13158	40795	1114
	13664	40687	1108
	14170	40580	1120
	14676	40481	1132
	15182	40380	1132
	15688	40280	1136
	16194	40180	1147
	16700	40084	1158
	17206	39991	1173
	17712	39904	1179
	18218	39814	1205
	18724	39721	1209
	19230	39621	1211
	19736	39517	1212
	20242	39390	1186
	20748	39241	1126
	21255	39105	1087
	21761	39005	1085
	22267	38921	1082
	22773	38849	1084
	23279	38776	1076
	23785	38711	1070
	24291	38642	1055
	24797	38585	1080
	25303	38525	1075
	25809	38473	1085
	26315	38420	1085
	26821	38368	1085
	27327	38316	1085
	27833	38274	1097
	28339	38226	1092
	28845	38184	1098
	29352	38136	1085
	29858	38095	1100
	30364	38059	1116
	30870	38017	1116
	31376	37985	1125
	31882	37948	1120
	32388	37916	1132
	32894	37879	1132
	33400	37839	1132
	33906	37784	1100
	34412	37702	1074
	34918	37619	1070
	35424	37554	1071
	35930	37512	1097
	36436	37461	1085
	36942	37409	1083
	37448	37362	1082
	37955	37320	1085
	38461	37279	1088
	38967	37242	1101
	39473	37193	1092
	39979	37131	1078
	40485	37068	1101
	40991	37009	1101
	41497	36947	1101
	42003	36867	1085
	42509	36803	1059
	43015	36787	1075
	43521	36780	1102
	44027	36765	1128
	44533	36750	1161
	45039	36727	1211
	45545	36644	1225
	46052	36358	1147
	46558	35894	1137
	47064	35301	1190
	47570	34444	1227
	48076	33051	1349
	48582	32087	1534
	49088	32087	1534
	49594	32087	1534
	50100	32087	1534
	>;
	battery1_profile_t1_num = <100>;
	battery1_profile_t1 =
	<
	0	43818	1255
	506	43667	1277
	1012	43538	1282
	1518	43416	1287
	2024	43291	1287
	2530	43169	1295
	3036	43040	1287
	3542	42914	1287
	4048	42792	1271
	4555	42671	1288
	5061	42561	1301
	5567	42437	1286
	6073	42318	1287
	6579	42198	1285
	7085	42079	1284
	7591	41960	1280
	8097	41847	1287
	8603	41730	1283
	9109	41616	1285
	9615	41502	1302
	10121	41387	1299
	10627	41274	1299
	11133	41162	1317
	11639	41053	1329
	12145	40942	1342
	12652	40832	1338
	13158	40743	1363
	13664	40676	1414
	14170	40615	1446
	14676	40488	1396
	15182	40309	1377
	15688	40145	1371
	16194	40012	1379
	16700	39916	1390
	17206	39851	1410
	17712	39805	1426
	18218	39758	1440
	18724	39686	1426
	19230	39609	1444
	19736	39520	1432
	20242	39441	1464
	20748	39344	1455
	21255	39239	1443
	21761	39093	1363
	22267	38959	1304
	22773	38850	1241
	23279	38766	1246
	23785	38692	1223
	24291	38629	1240
	24797	38567	1230
	25303	38512	1230
	25809	38453	1223
	26315	38408	1229
	26821	38358	1237
	27327	38310	1240
	27833	38268	1240
	28339	38226	1248
	28845	38184	1255
	29352	38142	1242
	29858	38104	1240
	30364	38072	1259
	30870	38041	1270
	31376	38003	1256
	31882	37972	1255
	32388	37946	1272
	32894	37922	1303
	33400	37897	1303
	33906	37865	1285
	34412	37840	1286
	34918	37815	1287
	35424	37783	1288
	35930	37747	1274
	36436	37699	1256
	36942	37658	1240
	37448	37627	1242
	37955	37592	1255
	38461	37550	1241
	38967	37514	1240
	39473	37480	1250
	39979	37451	1270
	40485	37414	1272
	40991	37368	1255
	41497	37314	1261
	42003	37245	1255
	42509	37192	1270
	43015	37135	1280
	43521	37062	1285
	44027	36974	1274
	44533	36938	1277
	45039	36923	1289
	45545	36918	1315
	46052	36901	1325
	46558	36865	1320
	47064	36833	1424
	47570	36691	1392
	48076	36320	1373
	48582	35796	1409
	49088	35090	1464
	49594	34061	1584
	50100	32130	2123
	>;
	battery1_profile_t2_num = <100>;
	battery1_profile_t2 =
	<
	0	43533	2961
	506	43262	3035
	1012	43091	3122
	1518	42939	3147
	2024	42819	3185
	2530	42695	3186
	3036	42576	3178
	3542	42451	3153
	4048	42327	3147
	4555	42212	3162
	5061	42097	3149
	5567	41982	3147
	6073	41867	3127
	6579	41758	3159
	7085	41647	3141
	7591	41534	3131
	8097	41419	3116
	8603	41308	3116
	9109	41198	3116
	9615	41093	3114
	10121	40987	3085
	10627	40904	3076
	11133	40845	3138
	11639	40794	3243
	12145	40694	3255
	12652	40515	3198
	13158	40285	3107
	13664	40087	3069
	14170	39933	3038
	14676	39824	3038
	15182	39737	3057
	15688	39665	3074
	16194	39603	3100
	16700	39559	3131
	17206	39506	3157
	17712	39439	3146
	18218	39351	3109
	18724	39248	3078
	19230	39136	3034
	19736	39021	2980
	20242	38909	2922
	20748	38813	2883
	21255	38734	2883
	21761	38664	2900
	22267	38602	2911
	22773	38539	2899
	23279	38482	2905
	23785	38428	2899
	24291	38375	2914
	24797	38327	2914
	25303	38285	2945
	25809	38243	2961
	26315	38201	2961
	26821	38162	2998
	27327	38125	3008
	27833	38093	3047
	28339	38059	3062
	28845	38025	3058
	29352	37994	3084
	29858	37958	3085
	30364	37931	3103
	30870	37910	3130
	31376	37883	3140
	31882	37864	3151
	32388	37854	3177
	32894	37837	3188
	33400	37827	3214
	33906	37816	3240
	34412	37799	3277
	34918	37780	3308
	35424	37759	3351
	35930	37734	3379
	36436	37702	3424
	36942	37670	3461
	37448	37633	3513
	37955	37596	3566
	38461	37557	3637
	38967	37504	3701
	39473	37441	3769
	39979	37379	3837
	40485	37322	3919
	40991	37259	4008
	41497	37178	4086
	42003	37091	4171
	42509	37053	4306
	43015	37028	4432
	43521	37004	4583
	44027	36984	4795
	44533	36952	5045
	45039	36911	5359
	45545	36791	5699
	46052	36426	5985
	46558	35874	6544
	47064	35128	7332
	47570	33986	8512
	48076	31932	9874
	48582	30571	6471
	49088	30103	5301
	49594	30103	5301
	50100	30103	5301
	>;
	battery1_profile_t3_num = <100>;
	battery1_profile_t3 =
	<
	0	43514	4185
	506	43248	4249
	1012	42874	4605
	1518	42610	5135
	2024	42457	5231
	2530	42320	5308
	3036	42198	5350
	3542	42078	5363
	4048	41968	5410
	4555	41853	5438
	5061	41738	5439
	5567	41629	5481
	6073	41515	5495
	6579	41405	5533
	7085	41287	5528
	7591	41177	5534
	8097	41072	5549
	8603	40982	5560
	9109	40915	5613
	9615	40853	5692
	10121	40776	5751
	10627	40639	5742
	11133	40428	5665
	11639	40176	5547
	12145	39982	5518
	12652	39830	5485
	13158	39710	5485
	13664	39605	5479
	14170	39513	5496
	14676	39420	5472
	15182	39330	5437
	15688	39246	5425
	16194	39163	5395
	16700	39079	5353
	17206	39004	5348
	17712	38931	5347
	18218	38857	5332
	18724	38780	5323
	19230	38718	5334
	19736	38655	5348
	20242	38598	5379
	20748	38543	5415
	21255	38491	5454
	21761	38438	5465
	22267	38391	5503
	22773	38334	5503
	23279	38291	5543
	23785	38249	5574
	24291	38208	5611
	24797	38166	5637
	25303	38130	5684
	25809	38094	5720
	26315	38057	5746
	26821	38023	5773
	27327	37994	5814
	27833	37963	5840
	28339	37932	5866
	28845	37907	5893
	29352	37886	5932
	29858	37865	5953
	30364	37838	5974
	30870	37817	6013
	31376	37797	6063
	31882	37776	6131
	32388	37749	6183
	32894	37721	6230
	33400	37690	6304
	33906	37654	6372
	34412	37613	6435
	34918	37568	6523
	35424	37517	6610
	35930	37465	6705
	36436	37415	6818
	36942	37351	6920
	37448	37278	7024
	37955	37205	7147
	38461	37142	7286
	38967	37105	7430
	39473	37074	7587
	39979	37050	7783
	40485	37024	8022
	40991	36988	8283
	41497	36914	8555
	42003	36735	8837
	42509	36332	9074
	43015	35736	9524
	43521	34889	10174
	44027	33443	11272
	44533	33191	11471
	45039	33191	11471
	45545	33191	11471
	46052	33191	11471
	46558	33191	11471
	47064	33191	11471
	47570	33191	11471
	48076	33191	11471
	48582	33191	11471
	49088	33191	11471
	49594	33191	11471
	50100	33191	11471
	>;
};
