/* Copyright (c) 2023, Motorola Mobility Inc. All rights reserved.
 *
 * This program is free software; you can redistribute it and/or modify
 * it under the terms of the GNU General Public License version 2 and
 * only version 2 as published by the Free Software Foundation.
 *
 * This program is distributed in the hope that it will be useful,
 * but WITHOUT ANY WARRANTY; without even the implied warranty of
 * MERCHANTABILITY or FITNESS FOR A PARTICULAR PURPOSE.  See the
 * GNU General Public License for more details.
 */

#include "mediatek/mt6879-manaus-common-overlay.dtsi"
#include "mediatek/manaus-docomo-charger.dtsi"

#define MANAUS_DOCOMO_RADIO 4

&tboard_thermistor7 {
	compatible = "mediatek,mt6879-board-ntc";
	#thermal-sensor-cells = <0>;
	io-channels = <&mt6375_adc MT6375_ADC_TS>;
	io-channel-names = "USB_CONN_NTC";
	temperature-lookup-table = <
		(-40000) 195652
		(-39000) 184917
		(-38000) 174845
		(-37000) 165391
		(-36000) 156512
		(-35000) 148171
		(-34000) 140330
		(-33000) 132957
		(-32000) 126021
		(-31000) 119493
		(-30000) 113347
		(-29000) 107564
		(-28000) 102115
		(-27000) 96977
		(-26000) 92131
		(-25000) 87558
		(-24000) 83242
		(-23000) 79166
		(-22000) 75315
		(-21000) 71676
		(-20000) 68236
		(-19000) 64990
		(-18000) 61919
		(-17000) 59011
		(-16000) 56257
		(-15000) 53649
		(-14000) 51177
		(-13000) 48834
		(-12000) 46613
		(-11000) 44505
		(-10000) 42506
		(-9000) 40599
		(-8000) 38790
		(-7000) 37072
		(-6000) 35441
		(-5000) 33892
		(-4000) 32419
		(-3000) 31020
		(-2000) 29689
		(-1000) 28423
		0 27218
		1000 26076
		2000 24987
		3000 23950
		4000 22962
		5000 22021
		6000 21123
		7000 20266
		8000 19449
		9000 18669
		10000 17925
		11000 17213
		12000 16534
		13000 15885
		14000 15265
		15000 14673
		16000 14107
		17000 13566
		18000 13048
		19000 12554
		20000 12080
		21000 11628
		22000 11194
		23000 10779
		24000 10381
		25000 10000
		26000 9634
		27000 9283
		28000 8947
		29000 8624
		30000 8314
		31000 8018
		32000 7733
		33000 7460
		34000 7199
		35000 6947
		36000 6706
		37000 6475
		38000 6252
		39000 6039
		40000 5833
		41000 5635
		42000 5445
		43000 5262
		44000 5086
		45000 4916
		46000 4753
		47000 4597
		48000 4446
		49000 4300
		50000 4160
		51000 4026
		52000 3896
		53000 3771
		54000 3651
		55000 3535
		56000 3423
		57000 3315
		58000 3211
		59000 3111
		60000 3014
		61000 2922
		62000 2833
		63000 2748
		64000 2665
		65000 2586
		66000 2509
		67000 2435
		68000 2363
		69000 2294
		70000 2227
		71000 2162
		72000 2100
		73000 2039
		74000 1981
		75000 1924
		76000 1869
		77000 1817
		78000 1765
		79000 1716
		80000 1668
		81000 1622
		82000 1577
		83000 1534
		84000 1492
		85000 1452
		86000 1412
		87000 1374
		88000 1338
		89000 1302
		90000 1268
		91000 1234
		92000 1201
		93000 1170
		94000 1139
		95000 1109
		96000 1080
		97000 1052
		98000 1025
		99000 999
		100000 973
		101000 949
		102000 925
		103000 902
		104000 879
		105000 858
		106000 836
		107000 816
		108000 796
		109000 776
		110000 758
		111000 739
		112000 721
		113000 704
		114000 687
		115000 671
		116000 655
		117000 640
		118000 625
		119000 610
		120000 596
		121000 582
		122000 569
		123000 556
		124000 543
		125000 531>;
};

&thermal_zones {
	usb_conn_ntc: usb_conn_ntc {
		polling-delay = <0>; /* milliseconds */
		polling-delay-passive = <0>; /* milliseconds */
		thermal-sensors = <&tboard_thermistor7>;
	};
};
