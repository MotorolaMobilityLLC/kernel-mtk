/* Copyright (c) 2019, Motorola Mobility Inc. All rights reserved.
 *
 * This program is free software; you can redistribute it and/or modify
 * it under the terms of the GNU General Public License version 2 and
 * only version 2 as published by the Free Software Foundation.
 *
 * This program is distributed in the hope that it will be useful,
 * but WITHOUT ANY WARRANTY; without even the implied warranty of
 * MERCHANTABILITY or FITNESS FOR A PARTICULAR PURPOSE.  See the
 * GNU General Public License for more details.
 */

/dts-v1/;
/plugin/;

#include "mediatek/mt6879-manaus-row-common-overlay.dtsi"

/* Board match root node */
/ {
	fragment@model {
		target-path = "/";
		__overlay__ {
			mot,model = "manaus";
			mot,board-id = <0x47 0xB200>, <0x48 0xB200>;
		};
	};
};

&charger {
	/* typec otp */
	typecotp_charger = <1>;
};

&mt6375_chg {
	io-channels = <&mt6375_adc MT6375_ADC_CHGVIN>,
					<&mt6375_adc MT6375_ADC_VSYS>,
					<&mt6375_adc MT6375_ADC_VBAT>,
					<&mt6375_adc MT6375_ADC_IBUS>,
					<&mt6375_adc MT6375_ADC_IBAT>,
					<&mt6375_adc MT6375_ADC_TEMPJC>,
					<&mt6375_adc MT6375_ADC_USBDP>,
					<&mt6375_adc MT6375_ADC_USBDM>,
					<&mt6375_adc MT6375_ADC_VREFTS>,
					<&mt6375_adc MT6375_ADC_TS>;
	typecotp_chg = <1>;
};

&mt6375_typec {
	typecotp_tcpc = <1>;
};

#include <manaus_dvt2/cust.dtsi>
#include "mediatek/cust_mt6879_camera_v4l2_manaus.dtsi"
/*End of this file, DO NOT ADD ANYTHING HERE*/
