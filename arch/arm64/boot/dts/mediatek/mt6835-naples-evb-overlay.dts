/* Copyright (c) 2023, Motorola Mobility Inc. All rights reserved.
 *
 * This program is free software; you can redistribute it and/or modify
 * it under the terms of the GNU General Public License version 2 and
 * only version 2 as published by the Free Software Foundation.
 *
 * This program is distributed in the hope that it will be useful,
 * but WITHOUT ANY WARRANTY; without even the implied warranty of
 * MERCHANTABILITY or FITNESS FOR A PARTICULAR PURPOSE.  See the
 * GNU General Public License for more details.
 */

/dts-v1/;
/plugin/;

/* NOTE: copied from mt6835-kansas-dvt-overlay.dts for reusing Kansas DVT or later HW */

#include "mediatek/mt6835-naples-common-overlay.dtsi"
#include "mediatek/mt6835_naples_camera_overlay_evb.dtsi"
/* Board match root node */
/ {
	fragment@model {
		target-path = "/";
		__overlay__ {
			mot,model = "naples";
			mot,board-id = <0x41 0xA100>;
		};
	};
};

#include <naples_evb/cust.dtsi>
#include "mediatek/naples-charger.dtsi"
/*End of this file, DO NOT ADD ANYTHING HERE*/
