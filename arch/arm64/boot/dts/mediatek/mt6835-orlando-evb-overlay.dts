/* Copyright (c) 2023, Motorola Mobility Inc. All rights reserved.
 *
 * This program is free software; you can redistribute it and/or modify
 * it under the terms of the GNU General Public License version 2 and
 * only version 2 as published by the Free Software Foundation.
 *
 * This program is distributed in the hope that it will be useful,
 * but WITHOUT ANY WARRANTY; without even the implied warranty of
 * MERCHANTABILITY or FITNESS FOR A PARTICULAR PURPOSE.  See the
 * GNU General Public License for more details.
 */

/dts-v1/;
/plugin/;

/* NOTE: copied from mt6835-vegas-dvt2-overlay.dts for reusing Vegas DVT2 or later HW */

#include "mediatek/mt6835-vegas-common-overlay.dtsi"
#include "mediatek/vegas-audio-dvt2.dtsi"
#include "mediatek/mt6835_orlando_camera_overlay.dtsi"
#include "mediatek/orlando-charger.dtsi"
#include "mediatek/orlando-touch.dtsi"
#include "mediatek/orlando-sensor.dtsi"

#define ORLANDO_RADIO_ID	2

/* Board match root node */
/ {
	fragment@model {
		target-path = "/";
		__overlay__ {
			mot,model = "vegas";
			mot,hab_product = "orlando";
			mot,board-id = <(ORLANDO_RADIO_ID << 8 | 0x41) 0xA100>;
		};
	};
};

/* NOTE: orlando_evb.dws copied from vegas_dvt2.dws for reusing Vegas DVT2 or later HW */
#include <orlando_evb/cust.dtsi>
/*End of this file, DO NOT ADD ANYTHING HERE*/
