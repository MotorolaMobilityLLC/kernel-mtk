/*************************
 * Customized Battery Setting dtsi file
*************************/
&bat_comm {
	/* cust_charging.h */

	/* Charging Current Setting */
	usb_charger_current = <50000 >;	/* Unit: 0.01 mA */
	ac_charger_input_current = <200000 >; /* Unit: 0.01 mA */
	ac_charger_current = <80000 >;	/* Unit: 0.01 mA */
	non_std_ac_charger_current = <50000 >;	/* Unit: 0.01 mA */
	charging_host_charger_current = <65000 >;	/* Unit: 0.01 mA */

	/* charger error check */
	bat_low_temp_protect_enable = <0 >;
	v_charger_enable = <0 >;	/* 1:on , 0:off */
	v_charger_max = <6500 >;	/* unit: mV */
	v_charger_min = <4400 >;

	/*  Tracking TIME */
	onehundred_percent_tracking_time = <10 >;	/* Unit: second */
	npercent_tracking_time = <20 >;	/* Unit: second */
	sync_to_real_tracking_time = <60 >;	/* Unit: second */
	v_0percent_tracking = <3450 >;	/* Unit: mV */

	/* High battery support */
	high_battery_voltage_support = <0 >;
};

&bat_meter {
	/* cust_battery_meter.h */
	/* ADC resistor  */
	r_bat_sense = <4 >;
	r_i_sense = <4 >;
	r_charger_1 = <330 >;
	r_charger_2 = <39 >;
	temperature_t0 = <110 >;
	temperature_t1 = <0 >;
	temperature_t2 = <25 >;
	temperature_t3 = <50 >;
	temperature_t = <255 >;	/* this should be fixed, never change the value */
	fg_meter_resistance = <0 >;

	/* Qmax for 0mA */
	q_max_pos_50 = <1463 >;
	q_max_pos_25 = <1437 >;
	q_max_pos_0 = <1220 >;
	q_max_neg_10 = <1137 >;
	/* Qmax for 400mA, said high current */
	q_max_pos_50_h_current = <1511 >;
	q_max_pos_25_h_current = <1462 >;
	q_max_pos_0_h_current = <818 >;
	q_max_neg_10_h_current = <149 >;
	/* Discharge percentage, 1: D5, 0: D2 */
	oam_d5 = <1 >;

	change_tracking_point = <1 >;
	/* SW OCV tracking setting */
	cust_tracking_point = <0 >;
	cust_r_sense = <68 >;
	cust_hw_cc = <0 >;
	aging_tuning_value = <103 >;
	cust_r_fg_offset = <0 >;
	ocv_board_compesate = <0 >;
	r_fg_board_base = <1000 >;
	r_fg_board_slope = <1000 >;
	car_tune_value = <104 >;

	/* HW Fuel gague  */
	current_detect_r_fg = <10 >;	/* Unit: mA */
	minerroroffset = <1000 >;
	fg_vbat_average_size = <18 >;
	r_fg_value = <10 >;	/* Unit: mOhm */

	cust_poweron_delta_capacity_tolrance = <40 >;
	cust_poweron_low_capacity_tolrance = <5 >;
	cust_poweron_max_vbat_tolrance = <90 >;
	cust_poweron_delta_vbat_tolrance = <30 >;
	cust_poweron_delta_hw_sw_ocv_capacity_tolrance = <10 >;

	/* Fixed battery temperature */
	fixed_tbat_25 = <0 >;

	/* Battery remove detecton */
	vbat_remove_detection = <0>;

	/* Dynamic change wake up period of battery thread when suspend */
	vbat_normal_wakeup = <3600 >;	/* Unit: mV */
	vbat_low_power_wakeup = <3500 >;	/* Unit: mV */
	normal_wakeup_period = <5400 >;	/* Unit: second */
	low_power_wakeup_period = <300 >;	/* Unit: second */
	close_poweroff_wakeup_period = <30 >;	/* Unit: second */

	rbat_pull_up_r = <16900 >;
	rbat_pull_up_volt = <1800 >;

	batt_temperature_table_num = <17 >;
	batt_temperature_table = <
	    (-20) 68237
	    (-15) 53650
	    (-10) 42506
	    (-5) 33892
	    0 27219
	    5 22021
	    10 17926
	    15 14674
	    20 12081
	    25 10000
	    30 8315
	    35 6948
	    40 5834
	    45 4917
	    50 4161
	    55 3535
	    60 3014
	>;

	battery_profile_t0_num = <100 >;
	battery_profile_t0 = <
	    0 4048
	    2 4008
	    4 3989
	    5 3977
	    7 3966
	    9 3960
	    11 3950
	    12 3946
	    14 3938
	    16 3932
	    18 3926
	    19 3918
	    21 3910
	    23 3901
	    25 3894
	    26 3885
	    28 3874
	    30 3866
	    32 3856
	    33 3846
	    35 3838
	    37 3830
	    39 3823
	    40 3817
	    42 3814
	    44 3808
	    46 3806
	    47 3803
	    49 3801
	    51 3798
	    53 3795
	    54 3796
	    56 3795
	    58 3792
	    60 3792
	    61 3790
	    63 3789
	    65 3787
	    67 3785
	    68 3783
	    70 3781
	    72 3776
	    74 3772
	    75 3767
	    77 3763
	    79 3758
	    81 3751
	    82 3742
	    84 3734
	    86 3725
	    88 3719
	    90 3715
	    91 3712
	    93 3707
	    95 3702
	    97 3696
	    98 3678
	    100 3647
	    101 3612
	    102 3575
	    103 3537
	    103 3502
	    104 3472
	    104 3443
	    104 3419
	    105 3395
	    105 3373
	    105 3357
	    105 3341
	    105 3328
	    105 3317
	    105 3307
	    105 3300
	    105 3293
	    105 3288
	    105 3283
	    105 3275
	    105 3271
	    105 3267
	    105 3260
	    106 3256
	    106 3251
	    106 3243
	    106 3239
	    106 3233
	    106 3225
	    106 3218
	    106 3214
	    106 3209
	    106 3202
	    106 3196
	    106 3185
	    106 3171
	    106 3157
	    106 3142
	    106 3125
	    106 3114
	    106 3095
	    106 3095
	    106 3095
	>;

	battery_profile_t1_num = <100 >;
	battery_profile_t1 = <
	    0  4048
	    2  4008
	    3  3989
	    5  3977
	    7  3966
	    8  3960
	    10 3956
	    11 3951
	    13 3948
	    15 3941
	    16 3935
	    18 3928
	    20 3922
	    21 3914
	    23 3906
	    25 3898
	    26 3892
	    28 3882
	    29 3872
	    31 3860
	    33 3849
	    34 3839
	    36 3831
	    38 3824
	    39 3818
	    41 3815
	    43 3808
	    44 3805
	    46 3803
	    47 3798
	    49 3796
	    51 3793
	    52 3792
	    54 3790
	    56 3790
	    57 3788
	    59 3788
	    60 3787
	    62 3787
	    64 3785
	    65 3785
	    67 3784
	    69 3782
	    70 3779
	    72 3777
	    74 3774
	    75 3769
	    77 3766
	    79 3762
	    80 3756
	    82 3748
	    83 3742
	    85 3734
	    87 3724
	    88 3714
	    90 3708
	    92 3703
	    93 3701
	    95 3699
	    97 3696
	    98 3689
	    100 3662
	    101 3601
	    103 3533
	    104 3475
	    104 3418
	    105 3363
	    105 3315
	    105 3270
	    105 3238
	    105 3208
	    105 3191
	    106 3172
	    106 3159
	    106 3150
	    106 3137
	    106 3137
	    106 3137
	    106 3137
	    106 3137
	    106 3137
	    106 3137
	    106 3137
	    106 3137
	    106 3137
	    106 3137
	    106 3137
	    106 3137
	    106 3137
	    106 3137
	    106 3137
	    106 3137
	    106 3137
	    106 3137
	    106 3137
	    106 3137
	    106 3137
	    106 3137
	    106 3137
	    106 3137
	>;

	battery_profile_t2_num = <100 >;
	battery_profile_t2 = <
	    0  4165
	    1  4149
	    3  4136
	    4  4121
	    6  4110
	    7  4098
	    8  4086
	    10 4081
	    11 4077
	    13 4067
	    14 4047
	    15 4025
	    17 4006
	    18 3993
	    19 3983
	    21 3975
	    22 3971
	    24 3968
	    25 3964
	    26 3958
	    28 3949
	    29 3943
	    31 3934
	    32 3928
	    33 3920
	    35 3913
	    36 3906
	    38 3898
	    39 3890
	    40 3878
	    42 3865
	    43 3853
	    44 3843
	    46 3836
	    47 3829
	    49 3824
	    50 3820
	    51 3814
	    53 3812
	    54 3807
	    56 3803
	    57 3801
	    58 3796
	    60 3794
	    61 3791
	    62 3789
	    64 3786
	    65 3784
	    67 3782
	    68 3781
	    69 3779
	    71 3779
	    72 3777
	    74 3775
	    75 3772
	    76 3769
	    78 3765
	    79 3761
	    81 3757
	    82 3752
	    83 3747
	    85 3741
	    86 3733
	    87 3724
	    89 3717
	    90 3706
	    92 3697
	    93 3695
	    94 3694
	    96 3692
	    97 3690
	    99 3684
	    100 3651
	    101 3587
	    103 3498
	    104 3347
	    105 3207
	    105 3164
	    105 3128
	    105 3087
	    105 3063
	    105 3041
	    105 3029
	    105 3026
	    105 3023
	    105 3005
	    105 2998
	    106 2992
	    106 2981
	    106 2973
	    106 2974
	    106 2975
	    106 2960
	    106 2950
	    106 2949
	    106 2947
	    106 2944
	    106 2939
	    106 2936
	    106 2931
	>;

	battery_profile_t3_num = <100 >;
	battery_profile_t3 = <
	    0  4181
	    1  4167
	    3  4152
	    4  4139
	    5  4127
	    7  4114
	    8  4103
	    10 4090
	    11 4078
	    12 4067
	    14 4056
	    15 4049
	    16 4036
	    18 4022
	    19 4010
	    20 4001
	    22 3995
	    23 3986
	    25 3977
	    26 3969
	    27 3959
	    29 3952
	    30 3943
	    31 3935
	    33 3929
	    34 3920
	    35 3913
	    37 3906
	    38 3899
	    40 3893
	    41 3887
	    42 3879
	    44 3867
	    45 3851
	    46 3840
	    48 3833
	    49 3827
	    50 3820
	    52 3816
	    53 3812
	    55 3808
	    56 3803
	    57 3800
	    59 3797
	    60 3794
	    61 3791
	    63 3787
	    64 3785
	    65 3782
	    67 3779
	    68 3778
	    70 3776
	    71 3775
	    72 3772
	    74 3767
	    75 3759
	    76 3753
	    78 3751
	    79 3746
	    81 3742
	    82 3737
	    83 3732
	    85 3729
	    86 3724
	    87 3715
	    89 3708
	    90 3699
	    91 3689
	    93 3681
	    94 3680
	    95 3680
	    97 3678
	    98 3676
	    100 3664
	    101 3619
	    102 3553
	    104 3454
	    105 3279
	    106 3141
	    106 3081
	    106 3038
	    106 3012
	    106 2982
	    106 2976
	    106 2956
	    106 2947
	    106 2942
	    106 2936
	    106 2939
	    106 2926
	    106 2925
	    106 2922
	    106 2918
	    106 2910
	    106 2904
	    106 2897
	    106 2891
	    106 2881
	    106 2873
	    106 2876
	>;

	r_profile_t0_num = <100 >;
	r_profile_t0 = <
	    865 4048
	    865 4008
	    893 3989
	    915 3977
	    955 3966
	    1023 3960
	    1200 3950
	    1338 3946
	    1375 3938
	    1388 3932
	    1408 3926
	    1420 3918
	    1428 3910
	    1418 3901
	    1428 3894
	    1423 3885
	    1418 3874
	    1425 3866
	    1428 3856
	    1428 3846
	    1425 3838
	    1423 3830
	    1420 3823
	    1415 3817
	    1425 3814
	    1425 3808
	    1450 3806
	    1468 3803
	    1465 3801
	    1483 3798
	    1488 3795
	    1510 3796
	    1515 3795
	    1533 3792
	    1535 3792
	    1548 3790
	    1543 3789
	    1563 3787
	    1588 3785
	    1610 3783
	    1625 3781
	    1640 3776
	    1653 3772
	    1660 3767
	    1680 3763
	    1690 3758
	    1710 3751
	    1733 3742
	    1745 3734
	    1765 3725
	    1788 3719
	    1813 3715
	    1853 3712
	    1905 3707
	    1965 3702
	    2010 3696
	    2080 3678
	    2123 3647
	    2035 3612
	    1943 3575
	    1853 3537
	    1770 3502
	    1685 3472
	    1623 3443
	    1550 3419
	    1493 3395
	    1448 3373
	    1395 3357
	    1368 3341
	    1338 3328
	    1303 3317
	    1298 3307
	    1263 3300
	    1253 3293
	    1260 3288
	    1225 3283
	    1240 3275
	    1198 3271
	    1215 3267
	    1198 3260
	    1200 3256
	    1218 3251
	    1228 3243
	    1138 3239
	    1230 3233
	    1243 3225
	    1155 3218
	    1165 3214
	    1045 3209
	    1170 3202
	    1183 3196
	    1340 3185
	    1368 3171
	    1423 3157
	    1455 3142
	    1533 3125
	    1365 3114
	    1653 3095
	    1653 3095
	    1653 3095
	>;

	r_profile_t1_num = <100 >;
	r_profile_t1 = <
	    633 4048
	    633 4008
	    678 3989
	    685 3977
	    700 3966
	    713 3960
	    728 3956
	    748 3951
	    753 3948
	    763 3941
	    763 3935
	    768 3928
	    783 3922
	    775 3914
	    780 3906
	    790 3898
	    790 3892
	    793 3882
	    798 3872
	    778 3860
	    778 3849
	    770 3839
	    778 3831
	    770 3824
	    785 3818
	    795 3815
	    785 3808
	    805 3805
	    810 3803
	    815 3798
	    818 3796
	    835 3793
	    838 3792
	    840 3790
	    865 3790
	    863 3788
	    880 3788
	    893 3787
	    908 3787
	    928 3785
	    933 3785
	    960 3784
	    965 3782
	    990 3779
	    1003 3777
	    1033 3774
	    1045 3769
	    1070 3766
	    1098 3762
	    1113 3756
	    1145 3748
	    1185 3742
	    1208 3734
	    1248 3724
	    1295 3714
	    1333 3708
	    1405 3703
	    1465 3701
	    1560 3699
	    1643 3696
	    1745 3689
	    1815 3662
	    1863 3601
	    1840 3533
	    1688 3475
	    1560 3418
	    1418 3363
	    1313 3315
	    1200 3270
	    1100 3238
	    1060 3208
	    980 3191
	    1000 3172
	    955 3159
	    878 3150
	    960 3137
	    960 3137
	    960 3137
	    960 3137
	    960 3137
	    960 3137
	    960 3137
	    960 3137
	    960 3137
	    960 3137
	    960 3137
	    960 3137
	    960 3137
	    960 3137
	    960 3137
	    960 3137
	    960 3137
	    960 3137
	    960 3137
	    960 3137
	    960 3137
	    960 3137
	    960 3137
	    960 3137
	    960 3137
	>;

	r_profile_t2_num = <100 >;
	r_profile_t2 = <
	    250 4165
	    250 4149
	    243 4136
	    240 4121
	    250 4110
	    250 4098
	    248 4086
	    258 4081
	    273 4077
	    278 4067
	    263 4047
	    265 4025
	    263 4006
	    268 3993
	    263 3983
	    268 3975
	    283 3971
	    288 3968
	    290 3964
	    295 3958
	    288 3949
	    295 3943
	    295 3934
	    298 3928
	    298 3920
	    295 3913
	    298 3906
	    298 3898
	    293 3890
	    283 3878
	    270 3865
	    255 3853
	    243 3843
	    240 3836
	    240 3829
	    238 3824
	    238 3820
	    235 3814
	    243 3812
	    245 3807
	    245 3803
	    253 3801
	    243 3796
	    248 3794
	    250 3791
	    255 3789
	    253 3786
	    258 3784
	    258 3782
	    260 3781
	    258 3779
	    265 3779
	    268 3777
	    270 3775
	    265 3772
	    265 3769
	    273 3765
	    273 3761
	    270 3757
	    275 3752
	    278 3747
	    278 3741
	    278 3733
	    275 3724
	    285 3717
	    285 3706
	    273 3697
	    285 3695
	    303 3694
	    318 3692
	    340 3690
	    365 3684
	    368 3651
	    393 3587
	    458 3498
	    575 3347
	    1070 3207
	    933 3164
	    863 3128
	    830 3087
	    710 3063
	    663 3041
	    640 3029
	    570 3026
	    583 3023
	    655 3005
	    575 2998
	    675 2992
	    630 2981
	    665 2973
	    610 2974
	    528 2975
	    673 2960
	    703 2950
	    590 2949
	    473 2947
	    693 2944
	    725 2939
	    483 2936
	    480 2931
	>;

	r_profile_t3_num = <100 >;
	r_profile_t3 = <
	    138 4181
	    138 4167
	    138 4152
	    140 4139
	    140 4127
	    143 4114
	    143 4103
	    143 4090
	    140 4078
	    143 4067
	    145 4056
	    155 4049
	    153 4036
	    155 4022
	    155 4010
	    155 4001
	    160 3995
	    163 3986
	    163 3977
	    170 3969
	    163 3959
	    173 3952
	    173 3943
	    175 3935
	    180 3929
	    178 3920
	    178 3913
	    180 3906
	    180 3899
	    190 3893
	    190 3887
	    190 3879
	    180 3867
	    158 3851
	    145 3840
	    143 3833
	    140 3827
	    138 3820
	    138 3816
	    143 3812
	    145 3808
	    145 3803
	    145 3800
	    150 3797
	    153 3794
	    153 3791
	    158 3787
	    155 3785
	    160 3782
	    160 3779
	    160 3778
	    163 3776
	    168 3775
	    163 3772
	    158 3767
	    148 3759
	    145 3753
	    150 3751
	    148 3746
	    150 3742
	    150 3737
	    148 3732
	    155 3729
	    158 3724
	    150 3715
	    155 3708
	    153 3699
	    150 3689
	    143 3681
	    150 3680
	    160 3680
	    168 3678
	    180 3676
	    180 3664
	    170 3619
	    188 3553
	    205 3454
	    300 3279
	    858 3141
	    783 3081
	    653 3038
	    530 3012
	    515 2982
	    458 2976
	    498 2956
	    475 2947
	    440 2942
	    425 2936
	    383 2939
	    415 2926
	    330 2925
	    320 2922
	    325 2918
	    385 2910
	    340 2904
	    353 2897
	    358 2891
	    365 2881
	    385 2873
	    320 2876
	>;
};
